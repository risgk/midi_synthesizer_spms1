/* Generated by Spinel AOT compiler */
#include "sp_runtime.h"
extern void set_midi_note_on_pitch(uint8_t, uint8_t);
extern uint8_t get_midi_note_on_pitch(uint8_t);
extern void set_midi_note_on_state(uint8_t, uint8_t);
extern uint8_t get_midi_note_on_state(uint8_t);
extern void set_midi_pitch_bend(uint8_t, int32_t);
extern int32_t get_midi_pitch_bend(uint8_t);
extern void set_midi_cc_value(uint8_t, uint8_t, uint8_t);
extern uint8_t get_midi_cc_value(uint8_t, uint8_t);
extern void set_midi_nrpn_value(uint8_t, int32_t, uint8_t);
extern uint8_t get_midi_nrpn_value(uint8_t, int32_t);
extern void set_sample_rate(int32_t);
extern int32_t get_sample_rate(void);
extern void set_audio_buffers(int32_t);
extern int32_t get_audio_buffers(void);
extern void set_audio_buffer_words(int32_t);
extern int32_t get_audio_buffer_words(void);
extern void start_audio(void);
extern void stop_audio(void);
extern void write_to_audio_buffer(float, float);
extern void start_debug_measure(void);
extern void stop_debug_measure(void);
static const char *const sp_sym_names[52] = {(&("\xff" "initialize")[1]), (&("\xff" "set_waveform")[1]), (&("\xff" "set_modulation_amount")[1]), (&("\xff" "set_coarse_tune")[1]), (&("\xff" "set_fine_tune")[1]), (&("\xff" "process")[1]), (&("\xff" "pitch_to_freq_fast")[1]), (&("\xff" "poly_blep")[1]), (&("\xff" "set_cutoff")[1]), (&("\xff" "set_gain")[1]), (&("\xff" "set_resonance")[1]), (&("\xff" "cutoff_to_freq_fast")[1]), (&("\xff" "update_coefficients")[1]), (&("\xff" "soft_clip")[1]), (&("\xff" "set_attack")[1]), (&("\xff" "set_decay")[1]), (&("\xff" "set_sustain")[1]), (&("\xff" "update_coefficients_full")[1]), (&("\xff" "calculate_exp_fast")[1]), (&("\xff" "set_rate")[1]), (&("\xff" "rate_to_freq_fast")[1]), (&("\xff" "set_level_1")[1]), (&("\xff" "set_level_2")[1]), (&("\xff" "set_invert_1")[1]), (&("\xff" "set_invert_2")[1]), (&("\xff" "set_midi_note_on_pitch")[1]), (&("\xff" "uint8")[1]), (&("\xff" "void")[1]), (&("\xff" "get_midi_note_on_pitch")[1]), (&("\xff" "set_midi_note_on_state")[1]), (&("\xff" "get_midi_note_on_state")[1]), (&("\xff" "set_midi_pitch_bend")[1]), (&("\xff" "int32")[1]), (&("\xff" "get_midi_pitch_bend")[1]), (&("\xff" "set_midi_cc_value")[1]), (&("\xff" "get_midi_cc_value")[1]), (&("\xff" "set_midi_nrpn_value")[1]), (&("\xff" "get_midi_nrpn_value")[1]), (&("\xff" "set_sample_rate")[1]), (&("\xff" "get_sample_rate")[1]), (&("\xff" "set_audio_buffers")[1]), (&("\xff" "get_audio_buffers")[1]), (&("\xff" "set_audio_buffer_words")[1]), (&("\xff" "get_audio_buffer_words")[1]), (&("\xff" "start_audio")[1]), (&("\xff" "stop_audio")[1]), (&("\xff" "write_to_audio_buffer")[1]), (&("\xff" "float")[1]), (&("\xff" "start_debug_measure")[1]), (&("\xff" "stop_debug_measure")[1]), (&("\xff" "cc_to_ratio")[1]), (&("\xff" "cc_slot")[1])};
static const char *sp_dyn_syms[SP_DYN_SYMS_MAX]; static int sp_ndyn = 0;
static const char *sp_sym_to_s(sp_sym id){if(id>=0&&id<52)return sp_sym_names[id];if(id>=52&&id<52+sp_ndyn)return sp_dyn_syms[id-52];return "";}
static sp_sym sp_sym_intern(const char *s){for(int i=0;i<52;i++)if(strcmp(sp_sym_names[i],s)==0)return (sp_sym)i;for(int i=0;i<sp_ndyn;i++)if(strcmp(sp_dyn_syms[i],s)==0)return (sp_sym)(52+i);if(sp_ndyn<SP_DYN_SYMS_MAX){sp_dyn_syms[sp_ndyn]=sp_str_dup_external(s);return (sp_sym)(52+sp_ndyn++);}return (sp_sym)0;}

static const char *sp_class_to_s(sp_Class c){if(sp_class_nil_p(c))return SPL("nil");if(c.name)return c.name;switch(c.cls_id){case 0:return SPL("Spms1");case 1:return SPL("Spms1::Osc");case 2:return SPL("Spms1::Filter");case 3:return SPL("Spms1::Amp");case 4:return SPL("Spms1::EnvGen");case 5:return SPL("Spms1::LFO");case 6:return SPL("Spms1::Mixer");case 7:return SPL("Spms1::C");case -100:return SPL("Integer");case -101:return SPL("Float");case -102:return SPL("String");case -103:return SPL("Symbol");case -104:return SPL("Array");case -105:return SPL("Hash");case -106:return SPL("Range");case -107:return SPL("Time");case -108:return SPL("Module");case -109:return SPL("Class");case -110:return SPL("NilClass");case -111:return SPL("TrueClass");case -112:return SPL("FalseClass");case -113:return SPL("Numeric");case -114:return SPL("Comparable");case -115:return SPL("Enumerable");case -116:return SPL("Object");case -117:return SPL("BasicObject");case -118:return SPL("Proc");case -119:return SPL("Kernel");case -120:return SPL("IO");case -121:return SPL("File");case -122:return SPL("Exception");case -123:return SPL("StandardError");case -124:return SPL("RuntimeError");case -125:return SPL("TypeError");case -126:return SPL("ArgumentError");case -127:return SPL("NameError");case -128:return SPL("NoMethodError");case -129:return SPL("StopIteration");case -130:return SPL("Math");case -131:return SPL("Complex");case -132:return SPL("IndexError");case -133:return SPL("KeyError");case -134:return SPL("RangeError");case -135:return SPL("FloatDomainError");case -136:return SPL("ZeroDivisionError");case -137:return SPL("FrozenError");case -138:return SPL("IOError");case -139:return SPL("LocalJumpError");case -140:return SPL("NotImplementedError");case -141:return SPL("ScriptError");case -142:return SPL("Rational");case -143:return SPL("Regexp");case -144:return SPL("Enumerator");case -145:return SPL("Struct");case -146:return SPL("Data");case -147:return SPL("SyntaxError");case -148:return SPL("SecurityError");case -149:return SPL("RegexpError");case -150:return SPL("EncodingError");case -151:return SPL("SignalException");case -152:return SPL("Interrupt");case -153:return SPL("ThreadError");case -154:return SPL("FiberError");case -155:return SPL("ClosedQueueError");case -156:return SPL("UncaughtThrowError");case -157:return SPL("NoMatchingPatternError");case -158:return SPL("NoMatchingPatternKeyError");case -159:return SPL("EOFError");case -160:return SPL("Math::DomainError");case -161:return SPL("SystemExit");case -162:return SPL("Signal");case -163:return SPL("Process::Status");default:return "";} }

static const int sp_cls_is_module[8] = {1,0,0,0,0,0,0,1};
static int sp_class_is_module_val(sp_Class c){
  if(c.cls_id>=0&&c.cls_id<8)return sp_cls_is_module[c.cls_id];
  return(c.cls_id==-114||c.cls_id==-115||c.cls_id==-119||c.cls_id==-162);
}
static sp_Class sp_class_superclass(sp_Class c){
  switch(c.cls_id){
  case 0: return ((sp_Class){-116});
  case 1: return ((sp_Class){-116});
  case 2: return ((sp_Class){-116});
  case 3: return ((sp_Class){-116});
  case 4: return ((sp_Class){-116});
  case 5: return ((sp_Class){-116});
  case 6: return ((sp_Class){-116});
  case 7: return ((sp_Class){-116});
  default: return ((sp_Class){-116});
  }
}
static sp_Class sp_builtin_superclass(sp_Class c);
static int sp_class_is_ancestor(sp_Class anc, sp_Class desc);
static int sp_class_is_ancestor(sp_Class anc, sp_Class desc){
  sp_Class cur = desc;
  for(int _i=0;_i<48;_i++){
    if(cur.cls_id==anc.cls_id)return 1;
    if(cur.cls_id==-117)break;
    sp_Class next=cur.cls_id>=0?sp_class_superclass(cur):sp_builtin_superclass(cur);
    if(next.cls_id==cur.cls_id)break;
    cur=next;
  }
  return 0;
}
static sp_Class sp_builtin_superclass(sp_Class c){
  if(sp_class_nil_p(c))return SP_CLASS_NIL;
  switch(c.cls_id){
  case -100:case -101:case -131:case -142: return ((sp_Class){-113});
  case -102:case -103:case -104:case -105:case -106:case -107:case -113: return ((sp_Class){-116});
  case -122: return ((sp_Class){-116});
  case -123:case -141: return ((sp_Class){-122});
  case -124:case -125:case -126:case -127:case -132:case -134:case -136:case -138:case -139: return ((sp_Class){-123});
  case -129: return ((sp_Class){-132});
  case -133: return ((sp_Class){-132});
  case -135: return ((sp_Class){-134});
  case -137: return ((sp_Class){-124});
  case -140: return ((sp_Class){-141});
  case -128: return ((sp_Class){-127});
  case -149:case -150:case -153:case -154:case -157:case -160: return ((sp_Class){-123});
  case -147: return ((sp_Class){-141});
  case -148:case -151:case -161: return ((sp_Class){-122});
  case -152: return ((sp_Class){-151});
  case -155: return ((sp_Class){-129});
  case -156: return ((sp_Class){-126});
  case -158: return ((sp_Class){-157});
  case -159: return ((sp_Class){-138});
  case -110:case -111:case -112:case -118:case -145:case -146: return ((sp_Class){-116});
  case -108: return ((sp_Class){-116});
  case -109: return ((sp_Class){-108});
  case -116: return ((sp_Class){-117});
  case -117: return SP_CLASS_NIL;
  default: return ((sp_Class){-116});
  }
}
static int sp_class_lt(sp_Class a,sp_Class b){return a.cls_id!=b.cls_id&&sp_class_is_ancestor(b,a);}
static int sp_class_le(sp_Class a,sp_Class b){return sp_class_is_ancestor(b,a);}
static int sp_class_gt(sp_Class a,sp_Class b){return sp_class_lt(b,a);}
static int sp_class_ge(sp_Class a,sp_Class b){return sp_class_le(b,a);}
#define sp_class_lt3(A,B) ({ sp_Class _cx=(A),_cy=(B); _cx.cls_id==_cy.cls_id?sp_box_bool(0):(sp_class_le(_cx,_cy)?sp_box_bool(1):(sp_class_le(_cy,_cx)?sp_box_bool(0):sp_box_nil())); })
#define sp_class_le3(A,B) ({ sp_Class _cx=(A),_cy=(B); sp_class_le(_cx,_cy)?sp_box_bool(1):(sp_class_le(_cy,_cx)?sp_box_bool(0):sp_box_nil()); })
#define sp_class_gt3(A,B) sp_class_lt3(B,A)
#define sp_class_ge3(A,B) sp_class_le3(B,A)
#define sp_class_cmp3(A,B) ({ sp_Class _cx=(A),_cy=(B); _cx.cls_id==_cy.cls_id?sp_box_int(0):(sp_class_le(_cx,_cy)?sp_box_int(-1):(sp_class_le(_cy,_cx)?sp_box_int(1):sp_box_nil())); })
static sp_PolyArray *sp_class_ancestors(sp_Class c){
  sp_PolyArray *a=sp_PolyArray_new();
  sp_Class cur=c;
  for(int _i=0;_i<28;_i++){
    if(cur.cls_id<0){
      if(cur.cls_id==-114||cur.cls_id==-115||cur.cls_id==-119||cur.cls_id==-130){
        sp_PolyArray_push(a,sp_box_class(cur)); break;
      }
      while(1){
        sp_PolyArray_push(a,sp_box_class(cur));
        if(cur.cls_id==-113) sp_PolyArray_push(a,sp_box_class(((sp_Class){-114})));
        if(cur.cls_id==-104||cur.cls_id==-105||cur.cls_id==-106||cur.cls_id==-144||cur.cls_id==-145) sp_PolyArray_push(a,sp_box_class(((sp_Class){-115})));
        if(cur.cls_id==-102||cur.cls_id==-103) sp_PolyArray_push(a,sp_box_class(((sp_Class){-114})));
        if(cur.cls_id==-116) sp_PolyArray_push(a,sp_box_class(((sp_Class){-119})));
        sp_Class bn=sp_builtin_superclass(cur);
        if(sp_class_nil_p(bn)||bn.cls_id==cur.cls_id)break;
        cur=bn;
      }
      break;
    }
    sp_PolyArray_push(a,sp_box_class(cur));
    switch(cur.cls_id){
    }
    sp_Class next=sp_class_superclass(cur);
    if(next.cls_id==cur.cls_id)break;
    cur=next;
  }
  return a;
}

static sp_PolyArray *sp_class_included_modules(sp_Class c) __attribute__((unused));
static sp_PolyArray *sp_class_included_modules(sp_Class c){
  sp_PolyArray *a=sp_class_ancestors(c); SP_GC_ROOT(a);
  sp_PolyArray *r=sp_PolyArray_new(); SP_GC_ROOT(r);
  for(mrb_int i=0;a&&i<a->len;i++){ sp_Class m={a->data[i].v.i,NULL};
    if(sp_class_is_module_val(m)) sp_PolyArray_push(r,a->data[i]); }
  return r;
}

static int sp_class_le_mod(sp_Class a,sp_Class b){
  /* a<=b: b is an ancestor of a, so b must appear in a's ancestors */
  sp_PolyArray *ancs=sp_class_ancestors(a);
  for(mrb_int _i=0;_i<sp_PolyArray_length(ancs);_i++){
    sp_RbVal v=sp_PolyArray_get(ancs,_i);
    if(v.tag==7&&(int)v.cls_id==b.cls_id)return 1;
  }
  if(b.cls_id<0)return sp_class_is_ancestor(b,a);
  return 0;
}
#undef sp_class_le
#define sp_class_le sp_class_le_mod
#undef sp_class_lt
#define sp_class_lt(a,b) ((a).cls_id!=(b).cls_id&&sp_class_le_mod(a,b))
#undef sp_class_gt
#define sp_class_gt(a,b) ((a).cls_id!=(b).cls_id&&sp_class_le_mod(b,a))
#undef sp_class_ge
#define sp_class_ge(a,b) sp_class_le_mod(b,a)
static sp_Class sp_poly_get_class(sp_RbVal v){
  switch(v.tag){
  case SP_TAG_INT: return ((sp_Class){-100});
  case SP_TAG_STR: return ((sp_Class){-102});
  case SP_TAG_FLT: return ((sp_Class){-101});
  case SP_TAG_BOOL: return v.v.b?((sp_Class){-111}):((sp_Class){-112});
  case SP_TAG_NIL: return ((sp_Class){-110});
  case SP_TAG_SYM: return ((sp_Class){-103});
  case SP_TAG_OBJ: if(v.cls_id>=0)return ((sp_Class){v.cls_id});
    if(v.cls_id>=-12)return ((sp_Class){-104});
    if(v.cls_id>=-20||v.cls_id==-34)return ((sp_Class){-105});
    return ((sp_Class){-116});
  default: return ((sp_Class){-116});
  }
}
static int sp_poly_is_a(sp_RbVal obj,sp_Class klass){
  return sp_class_le(sp_poly_get_class(obj),klass);
}
static const char *sp_user_exc_parent(const char *cls){
  (void)cls;
  return 0;
}
typedef struct sp_Spms1_s sp_Spms1;
typedef struct sp_Osc_s sp_Osc;
typedef struct sp_Filter_s sp_Filter;
typedef struct sp_Amp_s sp_Amp;
typedef struct sp_EnvGen_s sp_EnvGen;
typedef struct sp_LFO_s sp_LFO;
typedef struct sp_Mixer_s sp_Mixer;
typedef struct sp_C_s sp_C;
struct sp_Spms1_s {
  mrb_int cls_id;
};
struct sp_Osc_s {
  mrb_int cls_id;
  mrb_int iv_sample_rate;
  mrb_float iv_inv_sample_rate;
  mrb_float iv_smoothing_target_blend;
  mrb_float iv_phase;
  mrb_float iv_waveform;
  mrb_float iv_current_waveform;
  mrb_float iv_modulation_amount;
  mrb_float iv_current_modulation_amount;
  mrb_float iv_coarse_tune;
  mrb_float iv_fine_tune;
  mrb_float iv_tune;
  mrb_float iv_current_tune;
  mrb_int iv_sample_counter;
};
struct sp_Filter_s {
  mrb_int cls_id;
  mrb_int iv_sample_rate;
  mrb_float iv_inv_sample_rate;
  mrb_float iv_smoothing_target_blend;
  mrb_float iv_cutoff;
  mrb_float iv_resonance;
  mrb_float iv_modulation_amount;
  mrb_float iv_gain;
  mrb_float iv_current_cutoff;
  mrb_float iv_current_resonance;
  mrb_float iv_current_modulation_amount;
  mrb_float iv_current_gain;
  mrb_float iv_b0;
  mrb_float iv_b1;
  mrb_float iv_b2;
  mrb_float iv_a1;
  mrb_float iv_a2;
  mrb_float iv_z1;
  mrb_float iv_z2;
  mrb_float iv_next_b0;
  mrb_float iv_next_b1;
  mrb_float iv_next_a1;
  mrb_float iv_next_a2;
  mrb_float iv_current_modulation_input;
  mrb_int iv_sample_counter;
  mrb_float iv_step_omega;
  mrb_float iv_step_q;
  mrb_float iv_step_sin_w;
  mrb_float iv_step_cos_w;
  mrb_float iv_step_two_q;
};
struct sp_Amp_s {
  mrb_int cls_id;
  mrb_int iv_sample_rate;
  mrb_float iv_smoothing_target_blend;
  mrb_float iv_gain;
  mrb_float iv_current_gain;
  mrb_int iv_sample_counter;
};
struct sp_EnvGen_s {
  mrb_int cls_id;
  mrb_int iv_sample_rate;
  mrb_float iv_effective_rate;
  mrb_int iv_state;
  mrb_float iv_current_level;
  mrb_float iv_attack;
  mrb_float iv_decay;
  mrb_float iv_sustain;
  mrb_bool iv_was_gate_on;
  mrb_float iv_attack_coef;
  mrb_float iv_decay_coef;
  mrb_int iv_sample_counter;
};
struct sp_LFO_s {
  mrb_int cls_id;
  mrb_int iv_sample_rate;
  mrb_float iv_inv_sample_rate;
  mrb_float iv_smoothing_target_blend;
  mrb_float iv_phase;
  mrb_float iv_rate;
  mrb_float iv_current_rate;
  mrb_float iv_dt;
  mrb_int iv_sample_counter;
};
struct sp_Mixer_s {
  mrb_int cls_id;
  mrb_int iv_sample_rate;
  mrb_float iv_smoothing_target_blend;
  mrb_float iv_level_1;
  mrb_float iv_level_2;
  mrb_float iv_polarity_1;
  mrb_float iv_polarity_2;
  mrb_float iv_target_1;
  mrb_float iv_target_2;
  mrb_float iv_current_1;
  mrb_float iv_current_2;
  mrb_int iv_sample_counter;
};
struct sp_C_s {
  mrb_int cls_id;
};

static mrb_int civ_Osc_sample_rate = SP_INT_NIL;
static mrb_float civ_Osc_inv_sample_rate = 0.0;
static mrb_float civ_Osc_smoothing_target_blend = 0.0;
static mrb_float civ_Osc_phase = 0.0;
static mrb_float civ_Osc_waveform = 0.0;
static mrb_float civ_Osc_current_waveform = 0.0;
static mrb_float civ_Osc_modulation_amount = 0.0;
static mrb_float civ_Osc_current_modulation_amount = 0.0;
static mrb_float civ_Osc_coarse_tune = 0.0;
static mrb_float civ_Osc_fine_tune = 0.0;
static mrb_float civ_Osc_tune = 0.0;
static mrb_float civ_Osc_current_tune = 0.0;
static mrb_int civ_Osc_sample_counter = SP_INT_NIL;
static mrb_int civ_Filter_sample_rate = SP_INT_NIL;
static mrb_float civ_Filter_inv_sample_rate = 0.0;
static mrb_float civ_Filter_smoothing_target_blend = 0.0;
static mrb_float civ_Filter_cutoff = 0.0;
static mrb_float civ_Filter_resonance = 0.0;
static mrb_float civ_Filter_modulation_amount = 0.0;
static mrb_float civ_Filter_gain = 0.0;
static mrb_float civ_Filter_current_cutoff = 0.0;
static mrb_float civ_Filter_current_resonance = 0.0;
static mrb_float civ_Filter_current_modulation_amount = 0.0;
static mrb_float civ_Filter_current_gain = 0.0;
static mrb_float civ_Filter_b0 = 0.0;
static mrb_float civ_Filter_b1 = 0.0;
static mrb_float civ_Filter_b2 = 0.0;
static mrb_float civ_Filter_a1 = 0.0;
static mrb_float civ_Filter_a2 = 0.0;
static mrb_float civ_Filter_z1 = 0.0;
static mrb_float civ_Filter_z2 = 0.0;
static mrb_float civ_Filter_next_b0 = 0.0;
static mrb_float civ_Filter_next_b1 = 0.0;
static mrb_float civ_Filter_next_a1 = 0.0;
static mrb_float civ_Filter_next_a2 = 0.0;
static mrb_float civ_Filter_current_modulation_input = 0.0;
static mrb_int civ_Filter_sample_counter = SP_INT_NIL;
static mrb_float civ_Filter_step_omega = 0.0;
static mrb_float civ_Filter_step_q = 0.0;
static mrb_float civ_Filter_step_sin_w = 0.0;
static mrb_float civ_Filter_step_cos_w = 0.0;
static mrb_float civ_Filter_step_two_q = 0.0;
static mrb_int civ_Amp_sample_rate = SP_INT_NIL;
static mrb_float civ_Amp_smoothing_target_blend = 0.0;
static mrb_float civ_Amp_gain = 0.0;
static mrb_float civ_Amp_current_gain = 0.0;
static mrb_int civ_Amp_sample_counter = SP_INT_NIL;
static mrb_int civ_EnvGen_sample_rate = SP_INT_NIL;
static mrb_float civ_EnvGen_effective_rate = 0.0;
static mrb_int civ_EnvGen_state = SP_INT_NIL;
static mrb_float civ_EnvGen_current_level = 0.0;
static mrb_float civ_EnvGen_attack = 0.0;
static mrb_float civ_EnvGen_decay = 0.0;
static mrb_float civ_EnvGen_sustain = 0.0;
static mrb_bool civ_EnvGen_was_gate_on = 0;
static mrb_float civ_EnvGen_attack_coef = 0.0;
static mrb_float civ_EnvGen_decay_coef = 0.0;
static mrb_int civ_EnvGen_sample_counter = SP_INT_NIL;
static mrb_int civ_LFO_sample_rate = SP_INT_NIL;
static mrb_float civ_LFO_inv_sample_rate = 0.0;
static mrb_float civ_LFO_smoothing_target_blend = 0.0;
static mrb_float civ_LFO_phase = 0.0;
static mrb_float civ_LFO_rate = 0.0;
static mrb_float civ_LFO_current_rate = 0.0;
static mrb_float civ_LFO_dt = 0.0;
static mrb_int civ_LFO_sample_counter = SP_INT_NIL;
static mrb_int civ_Mixer_sample_rate = SP_INT_NIL;
static mrb_float civ_Mixer_smoothing_target_blend = 0.0;
static mrb_float civ_Mixer_level_1 = 0.0;
static mrb_float civ_Mixer_level_2 = 0.0;
static mrb_float civ_Mixer_polarity_1 = 0.0;
static mrb_float civ_Mixer_polarity_2 = 0.0;
static mrb_float civ_Mixer_target_1 = 0.0;
static mrb_float civ_Mixer_target_2 = 0.0;
static mrb_float civ_Mixer_current_1 = 0.0;
static mrb_float civ_Mixer_current_2 = 0.0;
static mrb_int civ_Mixer_sample_counter = SP_INT_NIL;
static const char *sp_obj_inspect_sw(int cls_id, void *p) __attribute__((cold, noinline));
static const char *sp_obj_to_s_sw(int cls_id, void *p) __attribute__((cold, noinline));
static void sp_Osc_initialize(sp_Osc *self, mrb_int lv_sample_rate);
static mrb_float sp_Osc_set_waveform(sp_Osc *self, mrb_float lv_waveform);
static mrb_float sp_Osc_set_modulation_amount(sp_Osc *self, mrb_float lv_amount);
static mrb_float sp_Osc_set_coarse_tune(sp_Osc *self, mrb_float lv_coarse_tune);
static mrb_float sp_Osc_set_fine_tune(sp_Osc *self, mrb_float lv_fine_tune);
static mrb_float sp_Osc_process(sp_Osc *self, mrb_float lv_pitch_input, mrb_float lv_modulation_input);
static mrb_float sp_Osc_pitch_to_freq_fast(sp_Osc *self, mrb_float lv_pitch);
static mrb_float sp_Osc_poly_blep(sp_Osc *self, mrb_float lv_t, mrb_float lv_dt, mrb_float lv_dt_inv);
static void sp_Filter_initialize(sp_Filter *self, mrb_int lv_sample_rate);
static mrb_float sp_Filter_set_cutoff(sp_Filter *self, mrb_float lv_cutoff);
static mrb_float sp_Filter_set_modulation_amount(sp_Filter *self, mrb_float lv_amount);
static mrb_float sp_Filter_set_gain(sp_Filter *self, mrb_float lv_gain);
static mrb_float sp_Filter_set_resonance(sp_Filter *self, mrb_float lv_resonance);
static mrb_float sp_Filter_process(sp_Filter *self, mrb_float lv_audio_input, mrb_float lv_modulation_input);
static mrb_float sp_Filter_cutoff_to_freq_fast(sp_Filter *self, mrb_float lv_clamped_cutoff);
static mrb_float sp_Filter_update_coefficients(sp_Filter *self);
static mrb_float sp_Filter_soft_clip(sp_Filter *self, mrb_float lv_sample);
static void sp_Amp_initialize(sp_Amp *self, mrb_int lv_sample_rate);
static mrb_float sp_Amp_set_gain(sp_Amp *self, mrb_float lv_gain);
static mrb_float sp_Amp_process(sp_Amp *self, mrb_float lv_audio_input, mrb_float lv_modulation_input);
static void sp_EnvGen_initialize(sp_EnvGen *self, mrb_int lv_sample_rate);
static mrb_float sp_EnvGen_set_attack(sp_EnvGen *self, mrb_float lv_attack);
static mrb_float sp_EnvGen_set_decay(sp_EnvGen *self, mrb_float lv_decay);
static mrb_float sp_EnvGen_set_sustain(sp_EnvGen *self, mrb_float lv_sustain);
static mrb_float sp_EnvGen_process(sp_EnvGen *self, mrb_float lv_gate_input);
static mrb_float sp_EnvGen_update_coefficients_full(sp_EnvGen *self);
static mrb_float sp_EnvGen_calculate_exp_fast(sp_EnvGen *self, mrb_float lv_value);
static void sp_LFO_initialize(sp_LFO *self, mrb_int lv_sample_rate);
static mrb_float sp_LFO_set_rate(sp_LFO *self, mrb_float lv_rate);
static mrb_float sp_LFO_process(sp_LFO *self);
static mrb_float sp_LFO_rate_to_freq_fast(sp_LFO *self, mrb_float lv_rate);
static void sp_Mixer_initialize(sp_Mixer *self, mrb_int lv_sample_rate);
static mrb_float sp_Mixer_set_level_1(sp_Mixer *self, mrb_float lv_level);
static mrb_float sp_Mixer_set_level_2(sp_Mixer *self, mrb_float lv_level);
static mrb_float sp_Mixer_set_invert_1(sp_Mixer *self, mrb_float lv_invert);
static mrb_float sp_Mixer_set_invert_2(sp_Mixer *self, mrb_float lv_invert);
static mrb_float sp_Mixer_process(sp_Mixer *self, mrb_float lv_input_1, mrb_float lv_input_2);
static mrb_float sp_cc_to_ratio(mrb_int lv_value);
static mrb_int sp_cc_slot(mrb_int lv_cc_number, mrb_int lv_slot);
static sp_Spms1 *sp_Spms1_new(void);
static sp_Osc *sp_Osc_new(mrb_int);
static sp_Filter *sp_Filter_new(mrb_int);
static sp_Amp *sp_Amp_new(mrb_int);
static sp_EnvGen *sp_EnvGen_new(mrb_int);
static sp_LFO *sp_LFO_new(mrb_int);
static sp_Mixer *sp_Mixer_new(mrb_int);
static sp_C *sp_C_new(void);

static mrb_float cst_Spms1__Osc__SMOOTHING_TARGET_BLEND_BASE = 0.0;
static mrb_int cst_Spms1__Osc__CONTROL_RATE_DIVISOR = 0;
static mrb_float cst_MODULATION_RANGE = 0.0;
static mrb_float cst_COARSE_TUNE_RANGE = 0.0;
static mrb_float cst_FINE_TUNE_RANGE = 0.0;
static sp_FloatArray * cst_Spms1__Osc__FREQ_TABLE = NULL;
static mrb_float cst_SOFT_CLIP_CEILING = 0.0;
static mrb_float cst_SOFT_CLIP_INV_CEILING = 0.0;
static mrb_float cst_SOFT_CLIP_LIMIT = 0.0;
static mrb_float cst_SOFT_CLIP_CUBIC_SCALE = 0.0;
static mrb_float cst_Spms1__Filter__SMOOTHING_TARGET_BLEND_BASE = 0.0;
static mrb_int cst_Spms1__Filter__CONTROL_RATE_DIVISOR = 0;
static sp_FloatArray * cst_Spms1__Filter__FREQ_TABLE = NULL;
static sp_FloatArray * cst_Q_TABLE = NULL;
static mrb_float cst_BASE_Q = 0.0;
static mrb_float cst_Spms1__Amp__SMOOTHING_TARGET_BLEND_BASE = 0.0;
static mrb_int cst_Spms1__Amp__CONTROL_RATE_DIVISOR = 0;
static mrb_int cst_STATE_ATTACK = 0;
static mrb_int cst_STATE_SUSTAIN = 0;
static mrb_int cst_STATE_IDLE = 0;
static mrb_int cst_Spms1__EnvGen__CONTROL_RATE_DIVISOR = 0;
static sp_FloatArray * cst_EXP_TABLE = NULL;
static mrb_float cst_ATTACK_BASE = 0.0;
static mrb_float cst_DECAY_BASE = 0.0;
static mrb_float cst_ATTACK_TARGET = 0.0;
static mrb_float cst_Spms1__LFO__SMOOTHING_TARGET_BLEND_BASE = 0.0;
static mrb_int cst_Spms1__LFO__CONTROL_RATE_DIVISOR = 0;
static sp_FloatArray * cst_Spms1__LFO__FREQ_TABLE = NULL;
static mrb_float cst_Spms1__Mixer__SMOOTHING_TARGET_BLEND_BASE = 0.0;
static mrb_int cst_Spms1__Mixer__CONTROL_RATE_DIVISOR = 0;
static mrb_int cst_MIDI_CH = 0;
static mrb_int cst_SAMPLE_RATE = 0;
static mrb_int cst_AUDIO_BUFFERS = 0;
static mrb_int cst_AUDIO_BUFFER_WORDS = 0;
static mrb_int cst_MODULES_SIZE = 0;
static mrb_int cst_MODULE_NONE = 0;
static mrb_int cst_MODULE_LFO = 0;
static mrb_int cst_MODULE_ENV_GEN = 0;
static mrb_int cst_MODULE_OSC = 0;
static mrb_int cst_MODULE_FILTER = 0;
static mrb_int cst_MODULE_AMP = 0;
static mrb_int cst_MODULE_MIXER_1 = 0;
static mrb_int cst_MODULE_MIXER_2 = 0;
static mrb_int cst_MODULE_MIXER_3 = 0;
static mrb_int cst_MODULE_MIXER_4 = 0;
static mrb_int cst_MODULE_MIXER_5 = 0;
static mrb_int cst_SIGNAL_NONE = 0;
static mrb_int cst_SIGNAL_ONE = 0;
static mrb_int cst_SIGNAL_HALF = 0;
static mrb_int cst_SIGNAL_MINUS_HALF = 0;
static mrb_int cst_SIGNAL_MINUS_ONE = 0;
static mrb_int cst_SIGNAL_LFO_OUTPUT = 0;
static mrb_int cst_SIGNAL_ENV_GEN_OUTPUT = 0;
static mrb_int cst_SIGNAL_OSC_OUTPUT = 0;
static mrb_int cst_SIGNAL_FILTER_OUTPUT = 0;
static mrb_int cst_SIGNAL_AMP_OUTPUT = 0;
static mrb_int cst_SIGNAL_MIXER_1_OUTPUT = 0;
static mrb_int cst_SIGNAL_MIXER_2_OUTPUT = 0;
static mrb_int cst_SIGNAL_MIXER_3_OUTPUT = 0;
static mrb_int cst_SIGNAL_MIXER_4_OUTPUT = 0;
static mrb_int cst_SIGNAL_MIXER_5_OUTPUT = 0;
static mrb_int cst_SIGNAL_OSC_WAVEFORM = 0;
static mrb_int cst_SIGNAL_OSC_MOD_AMOUNT = 0;
static mrb_int cst_SIGNAL_OSC_COARSE_TUNE = 0;
static mrb_int cst_SIGNAL_OSC_FINE_TUNE = 0;
static mrb_int cst_SIGNAL_FILTER_CUTOFF = 0;
static mrb_int cst_SIGNAL_FILTER_RESONANCE = 0;
static mrb_int cst_SIGNAL_FILTER_MOD_AMOUNT = 0;
static mrb_int cst_SIGNAL_FILTER_GAIN = 0;
static mrb_int cst_SIGNAL_AMP_GAIN = 0;
static mrb_int cst_SIGNAL_ENV_GEN_ATTACK = 0;
static mrb_int cst_SIGNAL_ENV_GEN_DECAY = 0;
static mrb_int cst_SIGNAL_ENV_GEN_SUSTAIN = 0;
static mrb_int cst_SIGNAL_LFO_RATE = 0;
static mrb_int cst_SIGNAL_MIXER_1_LEVEL_1 = 0;
static mrb_int cst_SIGNAL_MIXER_1_INVERT_1 = 0;
static mrb_int cst_SIGNAL_MIXER_1_LEVEL_2 = 0;
static mrb_int cst_SIGNAL_MIXER_1_INVERT_2 = 0;
static mrb_int cst_SIGNAL_MIXER_2_LEVEL_1 = 0;
static mrb_int cst_SIGNAL_MIXER_2_INVERT_1 = 0;
static mrb_int cst_SIGNAL_MIXER_2_LEVEL_2 = 0;
static mrb_int cst_SIGNAL_MIXER_2_INVERT_2 = 0;
static mrb_int cst_SIGNAL_MIXER_3_LEVEL_1 = 0;
static mrb_int cst_SIGNAL_MIXER_3_INVERT_1 = 0;
static mrb_int cst_SIGNAL_MIXER_3_LEVEL_2 = 0;
static mrb_int cst_SIGNAL_MIXER_3_INVERT_2 = 0;
static mrb_int cst_SIGNAL_MIXER_4_LEVEL_1 = 0;
static mrb_int cst_SIGNAL_MIXER_4_INVERT_1 = 0;
static mrb_int cst_SIGNAL_MIXER_4_LEVEL_2 = 0;
static mrb_int cst_SIGNAL_MIXER_4_INVERT_2 = 0;
static mrb_int cst_SIGNAL_MIXER_5_LEVEL_1 = 0;
static mrb_int cst_SIGNAL_MIXER_5_INVERT_1 = 0;
static mrb_int cst_SIGNAL_MIXER_5_LEVEL_2 = 0;
static mrb_int cst_SIGNAL_MIXER_5_INVERT_2 = 0;
static mrb_int cst_SIGNAL_PITCH = 0;
static mrb_int cst_SIGNAL_GATE = 0;
static mrb_int cst_SIGNAL_BEND = 0;
static mrb_int cst_SIGNALS_SIZE = 0;
static mrb_int cst_SIGNAL_SINK = 0;
static mrb_int cst_NRPN_ACTIVE_MODULE_BASE = 0;
static mrb_int cst_NRPN_SOURCE_ENV_GEN_GATE = 0;
static mrb_int cst_NRPN_SOURCE_OSC_PITCH = 0;
static mrb_int cst_NRPN_SOURCE_OSC_MOD = 0;
static mrb_int cst_NRPN_SOURCE_FILTER_AUDIO = 0;
static mrb_int cst_NRPN_SOURCE_FILTER_MOD = 0;
static mrb_int cst_NRPN_SOURCE_AMP_AUDIO = 0;
static mrb_int cst_NRPN_SOURCE_AMP_MOD = 0;
static mrb_int cst_NRPN_SOURCE_MIXER_1_IN_1 = 0;
static mrb_int cst_NRPN_SOURCE_MIXER_1_IN_2 = 0;
static mrb_int cst_NRPN_SOURCE_MIXER_2_IN_1 = 0;
static mrb_int cst_NRPN_SOURCE_MIXER_2_IN_2 = 0;
static mrb_int cst_NRPN_SOURCE_MIXER_3_IN_1 = 0;
static mrb_int cst_NRPN_SOURCE_MIXER_3_IN_2 = 0;
static mrb_int cst_NRPN_SOURCE_MIXER_4_IN_1 = 0;
static mrb_int cst_NRPN_SOURCE_MIXER_4_IN_2 = 0;
static mrb_int cst_NRPN_SOURCE_MIXER_5_IN_1 = 0;
static mrb_int cst_NRPN_SOURCE_MIXER_5_IN_2 = 0;
static mrb_int cst_NRPN_SOURCE_OUTPUT = 0;
static mrb_int cst_NRPN_SOURCE_OSC_WAVEFORM = 0;
static mrb_int cst_NRPN_SOURCE_OSC_MOD_AMOUNT = 0;
static mrb_int cst_NRPN_SOURCE_OSC_COARSE_TUNE = 0;
static mrb_int cst_NRPN_SOURCE_OSC_FINE_TUNE = 0;
static mrb_int cst_NRPN_SOURCE_FILTER_CUTOFF = 0;
static mrb_int cst_NRPN_SOURCE_FILTER_RESONANCE = 0;
static mrb_int cst_NRPN_SOURCE_FILTER_MOD_AMOUNT = 0;
static mrb_int cst_NRPN_SOURCE_FILTER_GAIN = 0;
static mrb_int cst_NRPN_SOURCE_AMP_GAIN = 0;
static mrb_int cst_NRPN_SOURCE_ENV_GEN_ATTACK = 0;
static mrb_int cst_NRPN_SOURCE_ENV_GEN_DECAY = 0;
static mrb_int cst_NRPN_SOURCE_ENV_GEN_SUSTAIN = 0;
static mrb_int cst_NRPN_SOURCE_LFO_RATE = 0;
static mrb_int cst_NRPN_SOURCE_MIXER_1_LEVEL_1 = 0;
static mrb_int cst_NRPN_SOURCE_MIXER_1_INVERT_1 = 0;
static mrb_int cst_NRPN_SOURCE_MIXER_1_LEVEL_2 = 0;
static mrb_int cst_NRPN_SOURCE_MIXER_1_INVERT_2 = 0;
static mrb_int cst_NRPN_SOURCE_MIXER_2_LEVEL_1 = 0;
static mrb_int cst_NRPN_SOURCE_MIXER_2_INVERT_1 = 0;
static mrb_int cst_NRPN_SOURCE_MIXER_2_LEVEL_2 = 0;
static mrb_int cst_NRPN_SOURCE_MIXER_2_INVERT_2 = 0;
static mrb_int cst_NRPN_SOURCE_MIXER_3_LEVEL_1 = 0;
static mrb_int cst_NRPN_SOURCE_MIXER_3_INVERT_1 = 0;
static mrb_int cst_NRPN_SOURCE_MIXER_3_LEVEL_2 = 0;
static mrb_int cst_NRPN_SOURCE_MIXER_3_INVERT_2 = 0;
static mrb_int cst_NRPN_SOURCE_MIXER_4_LEVEL_1 = 0;
static mrb_int cst_NRPN_SOURCE_MIXER_4_INVERT_1 = 0;
static mrb_int cst_NRPN_SOURCE_MIXER_4_LEVEL_2 = 0;
static mrb_int cst_NRPN_SOURCE_MIXER_4_INVERT_2 = 0;
static mrb_int cst_NRPN_SOURCE_MIXER_5_LEVEL_1 = 0;
static mrb_int cst_NRPN_SOURCE_MIXER_5_INVERT_1 = 0;
static mrb_int cst_NRPN_SOURCE_MIXER_5_LEVEL_2 = 0;
static mrb_int cst_NRPN_SOURCE_MIXER_5_INVERT_2 = 0;
static mrb_int cst_NRPN_CC_OSC_WAVEFORM = 0;
static mrb_int cst_NRPN_CC_OSC_MOD_AMOUNT = 0;
static mrb_int cst_NRPN_CC_OSC_COARSE_TUNE = 0;
static mrb_int cst_NRPN_CC_OSC_FINE_TUNE = 0;
static mrb_int cst_NRPN_CC_FILTER_CUTOFF = 0;
static mrb_int cst_NRPN_CC_FILTER_RESONANCE = 0;
static mrb_int cst_NRPN_CC_FILTER_MOD_AMOUNT = 0;
static mrb_int cst_NRPN_CC_FILTER_GAIN = 0;
static mrb_int cst_NRPN_CC_AMP_GAIN = 0;
static mrb_int cst_NRPN_CC_ENV_GEN_ATTACK = 0;
static mrb_int cst_NRPN_CC_ENV_GEN_DECAY = 0;
static mrb_int cst_NRPN_CC_ENV_GEN_SUSTAIN = 0;
static mrb_int cst_NRPN_CC_LFO_RATE = 0;
static mrb_int cst_NRPN_CC_MIXER_1_LEVEL_1 = 0;
static mrb_int cst_NRPN_CC_MIXER_1_INVERT_1 = 0;
static mrb_int cst_NRPN_CC_MIXER_1_LEVEL_2 = 0;
static mrb_int cst_NRPN_CC_MIXER_1_INVERT_2 = 0;
static mrb_int cst_NRPN_CC_MIXER_2_LEVEL_1 = 0;
static mrb_int cst_NRPN_CC_MIXER_2_INVERT_1 = 0;
static mrb_int cst_NRPN_CC_MIXER_2_LEVEL_2 = 0;
static mrb_int cst_NRPN_CC_MIXER_2_INVERT_2 = 0;
static mrb_int cst_NRPN_CC_MIXER_3_LEVEL_1 = 0;
static mrb_int cst_NRPN_CC_MIXER_3_INVERT_1 = 0;
static mrb_int cst_NRPN_CC_MIXER_3_LEVEL_2 = 0;
static mrb_int cst_NRPN_CC_MIXER_3_INVERT_2 = 0;
static mrb_int cst_NRPN_CC_MIXER_4_LEVEL_1 = 0;
static mrb_int cst_NRPN_CC_MIXER_4_INVERT_1 = 0;
static mrb_int cst_NRPN_CC_MIXER_4_LEVEL_2 = 0;
static mrb_int cst_NRPN_CC_MIXER_4_INVERT_2 = 0;
static mrb_int cst_NRPN_CC_MIXER_5_LEVEL_1 = 0;
static mrb_int cst_NRPN_CC_MIXER_5_INVERT_1 = 0;
static mrb_int cst_NRPN_CC_MIXER_5_LEVEL_2 = 0;
static mrb_int cst_NRPN_CC_MIXER_5_INVERT_2 = 0;

static void sp_mark_user_globals(void) {
  sp_re_mark_globals();
  if (cst_Spms1__Osc__FREQ_TABLE) sp_gc_mark((void *)cst_Spms1__Osc__FREQ_TABLE);
  if (cst_Spms1__Filter__FREQ_TABLE) sp_gc_mark((void *)cst_Spms1__Filter__FREQ_TABLE);
  if (cst_Q_TABLE) sp_gc_mark((void *)cst_Q_TABLE);
  if (cst_EXP_TABLE) sp_gc_mark((void *)cst_EXP_TABLE);
  if (cst_Spms1__LFO__FREQ_TABLE) sp_gc_mark((void *)cst_Spms1__LFO__FREQ_TABLE);
}

static int sp_poly_is_a(sp_RbVal obj, sp_Class klass);
static void sp_re_init(void) {
  sp_sym_name_fn = sp_sym_to_s;
  sp_user_exc_parent_fn = sp_user_exc_parent;
  sp_poly_is_a_hook = sp_poly_is_a;
  sp_gc_mark_globals_hook = sp_mark_user_globals;
  sp_json_sym_intern_fn = sp_sym_intern;
  sp_obj_inspect_fn = sp_obj_inspect_sw;
  sp_obj_to_s_fn = sp_obj_to_s_sw;
}

SP_POOL_DEFINE(Spms1)
static sp_Spms1 *sp_Spms1_new(void) {
  sp_Spms1 *self = SP_POOL_NEW(Spms1, NULL);
  memset(self, 0, sizeof(*self));
  SP_GC_ROOT(self);
  self->cls_id = 0;
  return self;
}
SP_POOL_DEFINE(Osc)
static sp_Osc *sp_Osc_new(mrb_int lv_sample_rate) {
  sp_Osc *self = SP_POOL_NEW(Osc, NULL);
  memset(self, 0, sizeof(*self));
  SP_GC_ROOT(self);
  self->cls_id = 1;
  self->iv_sample_rate = SP_INT_NIL;
  self->iv_sample_counter = SP_INT_NIL;
  sp_Osc_initialize(self, lv_sample_rate);
  return self;
}
SP_POOL_DEFINE(Filter)
static sp_Filter *sp_Filter_new(mrb_int lv_sample_rate) {
  sp_Filter *self = SP_POOL_NEW(Filter, NULL);
  memset(self, 0, sizeof(*self));
  SP_GC_ROOT(self);
  self->cls_id = 2;
  self->iv_sample_rate = SP_INT_NIL;
  self->iv_sample_counter = SP_INT_NIL;
  sp_Filter_initialize(self, lv_sample_rate);
  return self;
}
SP_POOL_DEFINE(Amp)
static sp_Amp *sp_Amp_new(mrb_int lv_sample_rate) {
  sp_Amp *self = SP_POOL_NEW(Amp, NULL);
  memset(self, 0, sizeof(*self));
  SP_GC_ROOT(self);
  self->cls_id = 3;
  self->iv_sample_rate = SP_INT_NIL;
  self->iv_sample_counter = SP_INT_NIL;
  sp_Amp_initialize(self, lv_sample_rate);
  return self;
}
SP_POOL_DEFINE(EnvGen)
static sp_EnvGen *sp_EnvGen_new(mrb_int lv_sample_rate) {
  sp_EnvGen *self = SP_POOL_NEW(EnvGen, NULL);
  memset(self, 0, sizeof(*self));
  SP_GC_ROOT(self);
  self->cls_id = 4;
  self->iv_sample_rate = SP_INT_NIL;
  self->iv_state = SP_INT_NIL;
  self->iv_sample_counter = SP_INT_NIL;
  sp_EnvGen_initialize(self, lv_sample_rate);
  return self;
}
SP_POOL_DEFINE(LFO)
static sp_LFO *sp_LFO_new(mrb_int lv_sample_rate) {
  sp_LFO *self = SP_POOL_NEW(LFO, NULL);
  memset(self, 0, sizeof(*self));
  SP_GC_ROOT(self);
  self->cls_id = 5;
  self->iv_sample_rate = SP_INT_NIL;
  self->iv_sample_counter = SP_INT_NIL;
  sp_LFO_initialize(self, lv_sample_rate);
  return self;
}
SP_POOL_DEFINE(Mixer)
static sp_Mixer *sp_Mixer_new(mrb_int lv_sample_rate) {
  sp_Mixer *self = SP_POOL_NEW(Mixer, NULL);
  memset(self, 0, sizeof(*self));
  SP_GC_ROOT(self);
  self->cls_id = 6;
  self->iv_sample_rate = SP_INT_NIL;
  self->iv_sample_counter = SP_INT_NIL;
  sp_Mixer_initialize(self, lv_sample_rate);
  return self;
}
SP_POOL_DEFINE(C)
static sp_C *sp_C_new(void) {
  sp_C *self = SP_POOL_NEW(C, NULL);
  memset(self, 0, sizeof(*self));
  SP_GC_ROOT(self);
  self->cls_id = 7;
  return self;
}
static const char *sp_obj_to_s_sw(int cls_id, void *p) {
  switch (cls_id) {
    default: return NULL;
  }
}
static const char *sp_obj_inspect_sw(int cls_id, void *p) {
  switch (cls_id) {
    case 0: {
      sp_Spms1 *o = (sp_Spms1 *)p; (void)o;
      sp_String *_s = sp_String_new(sp_sprintf("#<Spms1:0x%016llx", (unsigned long long)(uintptr_t)p));
      sp_String_append(_s, ">");
      return _s->data;
    }
    case 1: {
      sp_Osc *o = (sp_Osc *)p; (void)o;
      sp_String *_s = sp_String_new(sp_sprintf("#<Spms1::Osc:0x%016llx", (unsigned long long)(uintptr_t)p));
      sp_String_append(_s, " @sample_rate="); sp_String_append(_s, sp_poly_inspect((o->iv_sample_rate == SP_INT_NIL ? sp_box_nil() : sp_box_int(o->iv_sample_rate))));
      sp_String_append(_s, ", @inv_sample_rate="); sp_String_append(_s, sp_poly_inspect(sp_box_float(o->iv_inv_sample_rate)));
      sp_String_append(_s, ", @smoothing_target_blend="); sp_String_append(_s, sp_poly_inspect(sp_box_float(o->iv_smoothing_target_blend)));
      sp_String_append(_s, ", @phase="); sp_String_append(_s, sp_poly_inspect(sp_box_float(o->iv_phase)));
      sp_String_append(_s, ", @waveform="); sp_String_append(_s, sp_poly_inspect(sp_box_float(o->iv_waveform)));
      sp_String_append(_s, ", @current_waveform="); sp_String_append(_s, sp_poly_inspect(sp_box_float(o->iv_current_waveform)));
      sp_String_append(_s, ", @modulation_amount="); sp_String_append(_s, sp_poly_inspect(sp_box_float(o->iv_modulation_amount)));
      sp_String_append(_s, ", @current_modulation_amount="); sp_String_append(_s, sp_poly_inspect(sp_box_float(o->iv_current_modulation_amount)));
      sp_String_append(_s, ", @coarse_tune="); sp_String_append(_s, sp_poly_inspect(sp_box_float(o->iv_coarse_tune)));
      sp_String_append(_s, ", @fine_tune="); sp_String_append(_s, sp_poly_inspect(sp_box_float(o->iv_fine_tune)));
      sp_String_append(_s, ", @tune="); sp_String_append(_s, sp_poly_inspect(sp_box_float(o->iv_tune)));
      sp_String_append(_s, ", @current_tune="); sp_String_append(_s, sp_poly_inspect(sp_box_float(o->iv_current_tune)));
      sp_String_append(_s, ", @sample_counter="); sp_String_append(_s, sp_poly_inspect((o->iv_sample_counter == SP_INT_NIL ? sp_box_nil() : sp_box_int(o->iv_sample_counter))));
      sp_String_append(_s, ">");
      return _s->data;
    }
    case 2: {
      sp_Filter *o = (sp_Filter *)p; (void)o;
      sp_String *_s = sp_String_new(sp_sprintf("#<Spms1::Filter:0x%016llx", (unsigned long long)(uintptr_t)p));
      sp_String_append(_s, " @sample_rate="); sp_String_append(_s, sp_poly_inspect((o->iv_sample_rate == SP_INT_NIL ? sp_box_nil() : sp_box_int(o->iv_sample_rate))));
      sp_String_append(_s, ", @inv_sample_rate="); sp_String_append(_s, sp_poly_inspect(sp_box_float(o->iv_inv_sample_rate)));
      sp_String_append(_s, ", @smoothing_target_blend="); sp_String_append(_s, sp_poly_inspect(sp_box_float(o->iv_smoothing_target_blend)));
      sp_String_append(_s, ", @cutoff="); sp_String_append(_s, sp_poly_inspect(sp_box_float(o->iv_cutoff)));
      sp_String_append(_s, ", @resonance="); sp_String_append(_s, sp_poly_inspect(sp_box_float(o->iv_resonance)));
      sp_String_append(_s, ", @modulation_amount="); sp_String_append(_s, sp_poly_inspect(sp_box_float(o->iv_modulation_amount)));
      sp_String_append(_s, ", @gain="); sp_String_append(_s, sp_poly_inspect(sp_box_float(o->iv_gain)));
      sp_String_append(_s, ", @current_cutoff="); sp_String_append(_s, sp_poly_inspect(sp_box_float(o->iv_current_cutoff)));
      sp_String_append(_s, ", @current_resonance="); sp_String_append(_s, sp_poly_inspect(sp_box_float(o->iv_current_resonance)));
      sp_String_append(_s, ", @current_modulation_amount="); sp_String_append(_s, sp_poly_inspect(sp_box_float(o->iv_current_modulation_amount)));
      sp_String_append(_s, ", @current_gain="); sp_String_append(_s, sp_poly_inspect(sp_box_float(o->iv_current_gain)));
      sp_String_append(_s, ", @b0="); sp_String_append(_s, sp_poly_inspect(sp_box_float(o->iv_b0)));
      sp_String_append(_s, ", @b1="); sp_String_append(_s, sp_poly_inspect(sp_box_float(o->iv_b1)));
      sp_String_append(_s, ", @b2="); sp_String_append(_s, sp_poly_inspect(sp_box_float(o->iv_b2)));
      sp_String_append(_s, ", @a1="); sp_String_append(_s, sp_poly_inspect(sp_box_float(o->iv_a1)));
      sp_String_append(_s, ", @a2="); sp_String_append(_s, sp_poly_inspect(sp_box_float(o->iv_a2)));
      sp_String_append(_s, ", @z1="); sp_String_append(_s, sp_poly_inspect(sp_box_float(o->iv_z1)));
      sp_String_append(_s, ", @z2="); sp_String_append(_s, sp_poly_inspect(sp_box_float(o->iv_z2)));
      sp_String_append(_s, ", @next_b0="); sp_String_append(_s, sp_poly_inspect(sp_box_float(o->iv_next_b0)));
      sp_String_append(_s, ", @next_b1="); sp_String_append(_s, sp_poly_inspect(sp_box_float(o->iv_next_b1)));
      sp_String_append(_s, ", @next_a1="); sp_String_append(_s, sp_poly_inspect(sp_box_float(o->iv_next_a1)));
      sp_String_append(_s, ", @next_a2="); sp_String_append(_s, sp_poly_inspect(sp_box_float(o->iv_next_a2)));
      sp_String_append(_s, ", @current_modulation_input="); sp_String_append(_s, sp_poly_inspect(sp_box_float(o->iv_current_modulation_input)));
      sp_String_append(_s, ", @sample_counter="); sp_String_append(_s, sp_poly_inspect((o->iv_sample_counter == SP_INT_NIL ? sp_box_nil() : sp_box_int(o->iv_sample_counter))));
      sp_String_append(_s, ", @step_omega="); sp_String_append(_s, sp_poly_inspect(sp_box_float(o->iv_step_omega)));
      sp_String_append(_s, ", @step_q="); sp_String_append(_s, sp_poly_inspect(sp_box_float(o->iv_step_q)));
      sp_String_append(_s, ", @step_sin_w="); sp_String_append(_s, sp_poly_inspect(sp_box_float(o->iv_step_sin_w)));
      sp_String_append(_s, ", @step_cos_w="); sp_String_append(_s, sp_poly_inspect(sp_box_float(o->iv_step_cos_w)));
      sp_String_append(_s, ", @step_two_q="); sp_String_append(_s, sp_poly_inspect(sp_box_float(o->iv_step_two_q)));
      sp_String_append(_s, ">");
      return _s->data;
    }
    case 3: {
      sp_Amp *o = (sp_Amp *)p; (void)o;
      sp_String *_s = sp_String_new(sp_sprintf("#<Spms1::Amp:0x%016llx", (unsigned long long)(uintptr_t)p));
      sp_String_append(_s, " @sample_rate="); sp_String_append(_s, sp_poly_inspect((o->iv_sample_rate == SP_INT_NIL ? sp_box_nil() : sp_box_int(o->iv_sample_rate))));
      sp_String_append(_s, ", @smoothing_target_blend="); sp_String_append(_s, sp_poly_inspect(sp_box_float(o->iv_smoothing_target_blend)));
      sp_String_append(_s, ", @gain="); sp_String_append(_s, sp_poly_inspect(sp_box_float(o->iv_gain)));
      sp_String_append(_s, ", @current_gain="); sp_String_append(_s, sp_poly_inspect(sp_box_float(o->iv_current_gain)));
      sp_String_append(_s, ", @sample_counter="); sp_String_append(_s, sp_poly_inspect((o->iv_sample_counter == SP_INT_NIL ? sp_box_nil() : sp_box_int(o->iv_sample_counter))));
      sp_String_append(_s, ">");
      return _s->data;
    }
    case 4: {
      sp_EnvGen *o = (sp_EnvGen *)p; (void)o;
      sp_String *_s = sp_String_new(sp_sprintf("#<Spms1::EnvGen:0x%016llx", (unsigned long long)(uintptr_t)p));
      sp_String_append(_s, " @sample_rate="); sp_String_append(_s, sp_poly_inspect((o->iv_sample_rate == SP_INT_NIL ? sp_box_nil() : sp_box_int(o->iv_sample_rate))));
      sp_String_append(_s, ", @effective_rate="); sp_String_append(_s, sp_poly_inspect(sp_box_float(o->iv_effective_rate)));
      sp_String_append(_s, ", @state="); sp_String_append(_s, sp_poly_inspect((o->iv_state == SP_INT_NIL ? sp_box_nil() : sp_box_int(o->iv_state))));
      sp_String_append(_s, ", @current_level="); sp_String_append(_s, sp_poly_inspect(sp_box_float(o->iv_current_level)));
      sp_String_append(_s, ", @attack="); sp_String_append(_s, sp_poly_inspect(sp_box_float(o->iv_attack)));
      sp_String_append(_s, ", @decay="); sp_String_append(_s, sp_poly_inspect(sp_box_float(o->iv_decay)));
      sp_String_append(_s, ", @sustain="); sp_String_append(_s, sp_poly_inspect(sp_box_float(o->iv_sustain)));
      sp_String_append(_s, ", @was_gate_on="); sp_String_append(_s, sp_poly_inspect(sp_box_bool(o->iv_was_gate_on)));
      sp_String_append(_s, ", @attack_coef="); sp_String_append(_s, sp_poly_inspect(sp_box_float(o->iv_attack_coef)));
      sp_String_append(_s, ", @decay_coef="); sp_String_append(_s, sp_poly_inspect(sp_box_float(o->iv_decay_coef)));
      sp_String_append(_s, ", @sample_counter="); sp_String_append(_s, sp_poly_inspect((o->iv_sample_counter == SP_INT_NIL ? sp_box_nil() : sp_box_int(o->iv_sample_counter))));
      sp_String_append(_s, ">");
      return _s->data;
    }
    case 5: {
      sp_LFO *o = (sp_LFO *)p; (void)o;
      sp_String *_s = sp_String_new(sp_sprintf("#<Spms1::LFO:0x%016llx", (unsigned long long)(uintptr_t)p));
      sp_String_append(_s, " @sample_rate="); sp_String_append(_s, sp_poly_inspect((o->iv_sample_rate == SP_INT_NIL ? sp_box_nil() : sp_box_int(o->iv_sample_rate))));
      sp_String_append(_s, ", @inv_sample_rate="); sp_String_append(_s, sp_poly_inspect(sp_box_float(o->iv_inv_sample_rate)));
      sp_String_append(_s, ", @smoothing_target_blend="); sp_String_append(_s, sp_poly_inspect(sp_box_float(o->iv_smoothing_target_blend)));
      sp_String_append(_s, ", @phase="); sp_String_append(_s, sp_poly_inspect(sp_box_float(o->iv_phase)));
      sp_String_append(_s, ", @rate="); sp_String_append(_s, sp_poly_inspect(sp_box_float(o->iv_rate)));
      sp_String_append(_s, ", @current_rate="); sp_String_append(_s, sp_poly_inspect(sp_box_float(o->iv_current_rate)));
      sp_String_append(_s, ", @dt="); sp_String_append(_s, sp_poly_inspect(sp_box_float(o->iv_dt)));
      sp_String_append(_s, ", @sample_counter="); sp_String_append(_s, sp_poly_inspect((o->iv_sample_counter == SP_INT_NIL ? sp_box_nil() : sp_box_int(o->iv_sample_counter))));
      sp_String_append(_s, ">");
      return _s->data;
    }
    case 6: {
      sp_Mixer *o = (sp_Mixer *)p; (void)o;
      sp_String *_s = sp_String_new(sp_sprintf("#<Spms1::Mixer:0x%016llx", (unsigned long long)(uintptr_t)p));
      sp_String_append(_s, " @sample_rate="); sp_String_append(_s, sp_poly_inspect((o->iv_sample_rate == SP_INT_NIL ? sp_box_nil() : sp_box_int(o->iv_sample_rate))));
      sp_String_append(_s, ", @smoothing_target_blend="); sp_String_append(_s, sp_poly_inspect(sp_box_float(o->iv_smoothing_target_blend)));
      sp_String_append(_s, ", @level_1="); sp_String_append(_s, sp_poly_inspect(sp_box_float(o->iv_level_1)));
      sp_String_append(_s, ", @level_2="); sp_String_append(_s, sp_poly_inspect(sp_box_float(o->iv_level_2)));
      sp_String_append(_s, ", @polarity_1="); sp_String_append(_s, sp_poly_inspect(sp_box_float(o->iv_polarity_1)));
      sp_String_append(_s, ", @polarity_2="); sp_String_append(_s, sp_poly_inspect(sp_box_float(o->iv_polarity_2)));
      sp_String_append(_s, ", @target_1="); sp_String_append(_s, sp_poly_inspect(sp_box_float(o->iv_target_1)));
      sp_String_append(_s, ", @target_2="); sp_String_append(_s, sp_poly_inspect(sp_box_float(o->iv_target_2)));
      sp_String_append(_s, ", @current_1="); sp_String_append(_s, sp_poly_inspect(sp_box_float(o->iv_current_1)));
      sp_String_append(_s, ", @current_2="); sp_String_append(_s, sp_poly_inspect(sp_box_float(o->iv_current_2)));
      sp_String_append(_s, ", @sample_counter="); sp_String_append(_s, sp_poly_inspect((o->iv_sample_counter == SP_INT_NIL ? sp_box_nil() : sp_box_int(o->iv_sample_counter))));
      sp_String_append(_s, ">");
      return _s->data;
    }
    case 7: {
      sp_C *o = (sp_C *)p; (void)o;
      sp_String *_s = sp_String_new(sp_sprintf("#<Spms1::C:0x%016llx", (unsigned long long)(uintptr_t)p));
      sp_String_append(_s, ">");
      return _s->data;
    }
    default: return "#<Object>";
  }
}
#line 25 "spms1_osc.rb"
static void sp_Osc_initialize(sp_Osc *self, mrb_int lv_sample_rate) {
    SP_GC_SAVE();
#line 26 "spms1_osc.rb"
  self->iv_sample_rate = lv_sample_rate;
#line 30 "spms1_osc.rb"
  self->iv_inv_sample_rate = (1.0 / lv_sample_rate);
#line 31 "spms1_osc.rb"
  self->iv_smoothing_target_blend = ((cst_Spms1__Osc__SMOOTHING_TARGET_BLEND_BASE * ((48000.0 / self->iv_sample_rate))) * ((cst_Spms1__Osc__CONTROL_RATE_DIVISOR / 4.0)));
#line 32 "spms1_osc.rb"
  self->iv_phase = 0.0;
#line 33 "spms1_osc.rb"
  self->iv_waveform = 0.0;
#line 34 "spms1_osc.rb"
  self->iv_current_waveform = 0.0;
#line 35 "spms1_osc.rb"
  self->iv_modulation_amount = 0.0;
#line 36 "spms1_osc.rb"
  self->iv_current_modulation_amount = 0.0;
#line 37 "spms1_osc.rb"
  self->iv_coarse_tune = 0.0;
#line 38 "spms1_osc.rb"
  self->iv_fine_tune = 0.0;
#line 41 "spms1_osc.rb"
  self->iv_tune = 0.0;
#line 42 "spms1_osc.rb"
  self->iv_current_tune = 0.0;
#line 43 "spms1_osc.rb"
  self->iv_sample_counter = 0LL;
}
#line 48 "spms1_osc.rb"
static mrb_float sp_Osc_set_waveform(sp_Osc *self, mrb_float lv_waveform) {
    SP_GC_SAVE();
#line 49 "spms1_osc.rb"
  self->iv_waveform = (((lv_waveform < 0.0)) ? 0.0 : ((((lv_waveform > 1.0)) ? 1.0 : lv_waveform)));
  return 0.0;
}
#line 54 "spms1_osc.rb"
static mrb_float sp_Osc_set_modulation_amount(sp_Osc *self, mrb_float lv_amount) {
    SP_GC_SAVE();
    mrb_float lv_clamped_amount = 0.0;
#line 55 "spms1_osc.rb"
  lv_clamped_amount = (((lv_amount < 0.0)) ? 0.0 : ((((lv_amount > 1.0)) ? 1.0 : lv_amount)));
#line 56 "spms1_osc.rb"
  self->iv_modulation_amount = (lv_clamped_amount * cst_MODULATION_RANGE);
  return 0.0;
}
#line 62 "spms1_osc.rb"
static mrb_float sp_Osc_set_coarse_tune(sp_Osc *self, mrb_float lv_coarse_tune) {
    SP_GC_SAVE();
    mrb_float lv_clamped = 0.0;
#line 63 "spms1_osc.rb"
  lv_clamped = (((lv_coarse_tune < 0.0)) ? 0.0 : ((((lv_coarse_tune > 1.0)) ? 1.0 : lv_coarse_tune)));
#line 64 "spms1_osc.rb"
  self->iv_coarse_tune = ((((lv_clamped + lv_clamped) - 1.0)) * cst_COARSE_TUNE_RANGE);
#line 65 "spms1_osc.rb"
  self->iv_tune = (self->iv_coarse_tune + self->iv_fine_tune);
  return 0.0;
}
#line 68 "spms1_osc.rb"
static mrb_float sp_Osc_set_fine_tune(sp_Osc *self, mrb_float lv_fine_tune) {
    SP_GC_SAVE();
    mrb_float lv_clamped = 0.0;
#line 69 "spms1_osc.rb"
  lv_clamped = (((lv_fine_tune < 0.0)) ? 0.0 : ((((lv_fine_tune > 1.0)) ? 1.0 : lv_fine_tune)));
#line 70 "spms1_osc.rb"
  self->iv_fine_tune = ((((lv_clamped + lv_clamped) - 1.0)) * cst_FINE_TUNE_RANGE);
#line 71 "spms1_osc.rb"
  self->iv_tune = (self->iv_coarse_tune + self->iv_fine_tune);
  return 0.0;
}
#line 78 "spms1_osc.rb"
static mrb_float sp_Osc_process(sp_Osc *self, mrb_float lv_pitch_input, mrb_float lv_modulation_input) {
    SP_GC_SAVE();
    mrb_float lv_total_pitch = 0.0;
    mrb_float lv_pitch = 0.0;
    mrb_float lv_freq = 0.0;
    mrb_float lv_current_dt = 0.0;
    mrb_float lv_current_dt_inv = 0.0;
    mrb_float lv_naive_saw1 = 0.0;
    mrb_float lv_blep1 = 0.0;
    mrb_float lv_saw1 = 0.0;
    mrb_float lv_phase2 = 0.0;
    mrb_float lv_naive_saw2 = 0.0;
    mrb_float lv_blep2 = 0.0;
    mrb_float lv_saw2 = 0.0;
    mrb_float lv_output = 0.0;
#line 79 "spms1_osc.rb"
  if ((self->iv_sample_counter == 0LL)) {
#line 81 "spms1_osc.rb"
    self->iv_current_waveform += (((self->iv_waveform - self->iv_current_waveform)) * self->iv_smoothing_target_blend);
#line 82 "spms1_osc.rb"
    self->iv_current_modulation_amount += (((self->iv_modulation_amount - self->iv_current_modulation_amount)) * self->iv_smoothing_target_blend);
#line 83 "spms1_osc.rb"
    self->iv_current_tune += (((self->iv_tune - self->iv_current_tune)) * self->iv_smoothing_target_blend);
  }
#line 86 "spms1_osc.rb"
  lv_total_pitch = ((lv_pitch_input + self->iv_current_tune) + ((lv_modulation_input * self->iv_current_modulation_amount)));
#line 87 "spms1_osc.rb"
  lv_pitch = (((lv_total_pitch < -0.5)) ? -0.5 : ((((lv_total_pitch > 0.5)) ? 0.5 : lv_total_pitch)));
#line 88 "spms1_osc.rb"
  mrb_float _t1 = lv_pitch;
  lv_freq = sp_Osc_pitch_to_freq_fast((sp_Osc *)self, _t1);
#line 89 "spms1_osc.rb"
  lv_current_dt = (lv_freq * self->iv_inv_sample_rate);
#line 92 "spms1_osc.rb"
  lv_current_dt_inv = (1.0 / lv_current_dt);
#line 94 "spms1_osc.rb"
  lv_naive_saw1 = ((-2.0 * self->iv_phase) + 1.0);
#line 95 "spms1_osc.rb"
  mrb_float _t2 = self->iv_phase;
  mrb_float _t3 = lv_current_dt;
  mrb_float _t4 = lv_current_dt_inv;
  lv_blep1 = sp_Osc_poly_blep((sp_Osc *)self, _t2, _t3, _t4);
#line 96 "spms1_osc.rb"
  lv_saw1 = (lv_naive_saw1 + lv_blep1);
#line 98 "spms1_osc.rb"
  lv_phase2 = (self->iv_phase + 0.5);
#line 99 "spms1_osc.rb"
  lv_phase2 -= (((lv_phase2 < 1.0)) ? 0.0 : 1.0);
#line 101 "spms1_osc.rb"
  lv_naive_saw2 = ((-2.0 * lv_phase2) + 1.0);
#line 102 "spms1_osc.rb"
  mrb_float _t5 = lv_phase2;
  mrb_float _t6 = lv_current_dt;
  mrb_float _t7 = lv_current_dt_inv;
  lv_blep2 = sp_Osc_poly_blep((sp_Osc *)self, _t5, _t6, _t7);
#line 103 "spms1_osc.rb"
  lv_saw2 = (lv_naive_saw2 + lv_blep2);
#line 105 "spms1_osc.rb"
  lv_output = (lv_saw1 - ((lv_saw2 * self->iv_current_waveform)));
#line 106 "spms1_osc.rb"
  self->iv_phase += lv_current_dt;
#line 107 "spms1_osc.rb"
  self->iv_phase -= (((self->iv_phase < 1.0)) ? 0.0 : 1.0);
#line 108 "spms1_osc.rb"
  self->iv_sample_counter = sp_imod((sp_int_add(self->iv_sample_counter, 1LL)), 4LL);
#line 113 "spms1_osc.rb"
  return (lv_output * 0.5);
  return 0.0;
}
#line 118 "spms1_osc.rb"
static mrb_float sp_Osc_pitch_to_freq_fast(sp_Osc *self, mrb_float lv_pitch) {
    SP_GC_SAVE();
    mrb_float lv_internal_pitch = 0.0;
    mrb_int lv_index = 0;
    mrb_float lv_fraction = 0.0;
    mrb_float lv_f0 = 0.0;
    mrb_float lv_f1 = 0.0;
#line 119 "spms1_osc.rb"
  lv_internal_pitch = (((lv_pitch + 0.5)) * 120.0);
#line 120 "spms1_osc.rb"
  lv_index = sp_float_to_i_checked(lv_internal_pitch);
#line 121 "spms1_osc.rb"
  lv_fraction = (lv_internal_pitch - ((mrb_float)(lv_index)));
#line 122 "spms1_osc.rb"
  lv_f0 = sp_FloatArray_get(cst_Spms1__Osc__FREQ_TABLE, lv_index);
#line 123 "spms1_osc.rb"
  lv_f1 = sp_FloatArray_get(cst_Spms1__Osc__FREQ_TABLE, sp_int_add(lv_index, 1LL));
#line 124 "spms1_osc.rb"
  return (lv_f0 + (lv_fraction * ((lv_f1 - lv_f0))));
  return 0.0;
}
#line 131 "spms1_osc.rb"
static mrb_float sp_Osc_poly_blep(sp_Osc *self, mrb_float lv_t, mrb_float lv_dt, mrb_float lv_dt_inv) {
    SP_GC_SAVE();
    mrb_float lv_num_start = 0.0;
    mrb_float lv_blep_start = 0.0;
    mrb_float lv_num_end = 0.0;
    mrb_float lv_blep_end = 0.0;
    mrb_float lv_val = 0.0;
#line 132 "spms1_osc.rb"
  lv_num_start = (lv_t * lv_dt_inv);
#line 133 "spms1_osc.rb"
  lv_blep_start = (((lv_num_start + lv_num_start) - (lv_num_start * lv_num_start)) - 1.0);
#line 134 "spms1_osc.rb"
  lv_num_end = (((lv_t - 1.0)) * lv_dt_inv);
#line 135 "spms1_osc.rb"
  lv_blep_end = ((((lv_num_end * lv_num_end) + lv_num_end) + lv_num_end) + 1.0);
#line 136 "spms1_osc.rb"
  lv_val = (((lv_t < lv_dt)) ? lv_blep_start : 0.0);
#line 137 "spms1_osc.rb"
  if (((lv_t > (1.0 - lv_dt)))) {
    return lv_blep_end;
  }
  else {
    return lv_val;
  }
  return 0.0;
}
#line 37 "spms1_filter.rb"
static void sp_Filter_initialize(sp_Filter *self, mrb_int lv_sample_rate) {
    SP_GC_SAVE();
#line 38 "spms1_filter.rb"
  self->iv_sample_rate = lv_sample_rate;
#line 41 "spms1_filter.rb"
  self->iv_inv_sample_rate = (1.0 / lv_sample_rate);
#line 42 "spms1_filter.rb"
  self->iv_smoothing_target_blend = ((cst_Spms1__Filter__SMOOTHING_TARGET_BLEND_BASE * ((48000.0 / self->iv_sample_rate))) * ((cst_Spms1__Filter__CONTROL_RATE_DIVISOR / 4.0)));
#line 43 "spms1_filter.rb"
  self->iv_cutoff = 1.0;
#line 44 "spms1_filter.rb"
  self->iv_resonance = 0.0;
#line 45 "spms1_filter.rb"
  self->iv_modulation_amount = 0.0;
#line 46 "spms1_filter.rb"
  self->iv_gain = 0.5;
#line 48 "spms1_filter.rb"
  self->iv_current_cutoff = 1.0;
#line 49 "spms1_filter.rb"
  self->iv_current_resonance = 0.0;
#line 50 "spms1_filter.rb"
  self->iv_current_modulation_amount = 0.0;
#line 51 "spms1_filter.rb"
  self->iv_current_gain = 0.5;
#line 53 "spms1_filter.rb"
  self->iv_b0 = 1.0;
  self->iv_b1 = 0.0;
  self->iv_b2 = 0.0;
#line 54 "spms1_filter.rb"
  self->iv_a1 = 0.0;
  self->iv_a2 = 0.0;
#line 55 "spms1_filter.rb"
  self->iv_z1 = 0.0;
  self->iv_z2 = 0.0;
#line 57 "spms1_filter.rb"
  self->iv_next_b0 = 1.0;
#line 58 "spms1_filter.rb"
  self->iv_next_b1 = 0.0;
#line 59 "spms1_filter.rb"
  self->iv_next_a1 = 0.0;
#line 60 "spms1_filter.rb"
  self->iv_next_a2 = 0.0;
#line 62 "spms1_filter.rb"
  self->iv_current_modulation_input = 0.0;
#line 63 "spms1_filter.rb"
  self->iv_sample_counter = 0LL;
#line 65 "spms1_filter.rb"
  sp_Filter_update_coefficients((sp_Filter *)self);
}
#line 70 "spms1_filter.rb"
static mrb_float sp_Filter_set_cutoff(sp_Filter *self, mrb_float lv_cutoff) {
    SP_GC_SAVE();
#line 71 "spms1_filter.rb"
  self->iv_cutoff = (((lv_cutoff < 0.0)) ? 0.0 : ((((lv_cutoff > 1.0)) ? 1.0 : lv_cutoff)));
  return 0.0;
}
#line 75 "spms1_filter.rb"
static mrb_float sp_Filter_set_modulation_amount(sp_Filter *self, mrb_float lv_amount) {
    SP_GC_SAVE();
#line 76 "spms1_filter.rb"
  self->iv_modulation_amount = (((lv_amount < 0.0)) ? 0.0 : ((((lv_amount > 1.0)) ? 1.0 : lv_amount)));
  return 0.0;
}
#line 82 "spms1_filter.rb"
static mrb_float sp_Filter_set_gain(sp_Filter *self, mrb_float lv_gain) {
    SP_GC_SAVE();
#line 83 "spms1_filter.rb"
  self->iv_gain = (((lv_gain < 0.0)) ? 0.0 : ((((lv_gain > 1.0)) ? 1.0 : lv_gain)));
  return 0.0;
}
#line 87 "spms1_filter.rb"
static mrb_float sp_Filter_set_resonance(sp_Filter *self, mrb_float lv_resonance) {
    SP_GC_SAVE();
#line 88 "spms1_filter.rb"
  self->iv_resonance = (((lv_resonance < 0.0)) ? 0.0 : ((((lv_resonance > 1.0)) ? 1.0 : lv_resonance)));
  return 0.0;
}
#line 91 "spms1_filter.rb"
static mrb_float sp_Filter_process(sp_Filter *self, mrb_float lv_audio_input, mrb_float lv_modulation_input) {
    SP_GC_SAVE();
    mrb_float lv_driven_input = 0.0;
    mrb_float lv_audio_output = 0.0;
#line 92 "spms1_filter.rb"
  self->iv_current_modulation_input = lv_modulation_input;
#line 94 "spms1_filter.rb"
  if ((self->iv_sample_counter == 0LL)) {
#line 95 "spms1_filter.rb"
    sp_Filter_update_coefficients((sp_Filter *)self);
  }
#line 98 "spms1_filter.rb"
  lv_driven_input = (lv_audio_input * self->iv_current_gain);
#line 101 "spms1_filter.rb"
  lv_audio_output = (self->iv_z1 + (self->iv_b0 * lv_driven_input));
#line 102 "spms1_filter.rb"
  mrb_float _t8 = ((self->iv_z2 + (self->iv_b1 * lv_driven_input)) - (self->iv_a1 * lv_audio_output));
  self->iv_z1 = sp_Filter_soft_clip((sp_Filter *)self, _t8);
#line 103 "spms1_filter.rb"
  mrb_float _t9 = ((self->iv_b2 * lv_driven_input) - (self->iv_a2 * lv_audio_output));
  self->iv_z2 = sp_Filter_soft_clip((sp_Filter *)self, _t9);
#line 105 "spms1_filter.rb"
  self->iv_sample_counter = sp_imod((sp_int_add(self->iv_sample_counter, 1LL)), 4LL);
#line 107 "spms1_filter.rb"
  return lv_audio_output;
  return 0.0;
}
#line 112 "spms1_filter.rb"
static mrb_float sp_Filter_cutoff_to_freq_fast(sp_Filter *self, mrb_float lv_clamped_cutoff) {
    SP_GC_SAVE();
    mrb_float lv_internal_cutoff = 0.0;
    mrb_int lv_index = 0;
    mrb_float lv_fraction = 0.0;
    mrb_float lv_f0 = 0.0;
    mrb_float lv_f1 = 0.0;
#line 113 "spms1_filter.rb"
  lv_internal_cutoff = ((lv_clamped_cutoff * 120.0) + 15.0);
#line 114 "spms1_filter.rb"
  lv_index = sp_float_to_i_checked(lv_internal_cutoff);
#line 115 "spms1_filter.rb"
  lv_fraction = (lv_internal_cutoff - ((mrb_float)(lv_index)));
#line 117 "spms1_filter.rb"
  lv_f0 = sp_FloatArray_get(cst_Spms1__Filter__FREQ_TABLE, lv_index);
#line 118 "spms1_filter.rb"
  lv_f1 = sp_FloatArray_get(cst_Spms1__Filter__FREQ_TABLE, sp_int_add(lv_index, 1LL));
#line 120 "spms1_filter.rb"
  return (lv_f0 + (lv_fraction * ((lv_f1 - lv_f0))));
  return 0.0;
}
#line 125 "spms1_filter.rb"
static mrb_float sp_Filter_update_coefficients(sp_Filter *self) {
    SP_GC_SAVE();
    mrb_float lv_total_cutoff = 0.0;
    mrb_float lv_clamped_cutoff = 0.0;
    mrb_float lv_cutoff_freq = 0.0;
    mrb_float lv_internal_resonance = 0.0;
    mrb_int lv_index = 0;
    mrb_float lv_fraction = 0.0;
    mrb_float lv_q0 = 0.0;
    mrb_float lv_q1 = 0.0;
    mrb_float lv_step_inv_denom = 0.0;
    mrb_float lv_raw_b0 = 0.0;
#line 126 "spms1_filter.rb"
  self->iv_current_cutoff += (((self->iv_cutoff - self->iv_current_cutoff)) * self->iv_smoothing_target_blend);
#line 127 "spms1_filter.rb"
  self->iv_current_resonance += (((self->iv_resonance - self->iv_current_resonance)) * self->iv_smoothing_target_blend);
#line 128 "spms1_filter.rb"
  self->iv_current_modulation_amount += (((self->iv_modulation_amount - self->iv_current_modulation_amount)) * self->iv_smoothing_target_blend);
#line 129 "spms1_filter.rb"
  self->iv_current_gain += (((self->iv_gain - self->iv_current_gain)) * self->iv_smoothing_target_blend);
#line 133 "spms1_filter.rb"
  lv_total_cutoff = (self->iv_current_cutoff + ((self->iv_current_modulation_input * self->iv_current_modulation_amount)));
#line 134 "spms1_filter.rb"
  lv_clamped_cutoff = (((lv_total_cutoff < 0.0)) ? 0.0 : ((((lv_total_cutoff > 1.0)) ? 1.0 : lv_total_cutoff)));
#line 136 "spms1_filter.rb"
  mrb_float _t10 = lv_clamped_cutoff;
  lv_cutoff_freq = sp_Filter_cutoff_to_freq_fast((sp_Filter *)self, _t10);
#line 137 "spms1_filter.rb"
  self->iv_step_omega = (((2.0 * M_PI) * lv_cutoff_freq) * self->iv_inv_sample_rate);
#line 139 "spms1_filter.rb"
  lv_internal_resonance = (self->iv_current_resonance * 120.0);
#line 141 "spms1_filter.rb"
  lv_index = sp_float_to_i_checked(lv_internal_resonance);
#line 142 "spms1_filter.rb"
  lv_fraction = (lv_internal_resonance - ((mrb_float)(lv_index)));
#line 144 "spms1_filter.rb"
  lv_q0 = sp_FloatArray_get(cst_Q_TABLE, lv_index);
#line 145 "spms1_filter.rb"
  lv_q1 = sp_FloatArray_get(cst_Q_TABLE, sp_int_add(lv_index, 1LL));
#line 147 "spms1_filter.rb"
  self->iv_step_q = (lv_q0 + (lv_fraction * ((lv_q1 - lv_q0))));
#line 148 "spms1_filter.rb"
  self->iv_step_sin_w = sin((mrb_float)(self->iv_step_omega));
#line 149 "spms1_filter.rb"
  self->iv_step_cos_w = cos((mrb_float)(self->iv_step_omega));
#line 151 "spms1_filter.rb"
  lv_step_inv_denom = (1.0 / ((((2.0 * self->iv_step_q)) + self->iv_step_sin_w)));
#line 153 "spms1_filter.rb"
  self->iv_step_two_q = (2.0 * self->iv_step_q);
#line 154 "spms1_filter.rb"
  lv_raw_b0 = ((((1.0 - self->iv_step_cos_w)) * 0.5) * self->iv_step_two_q);
#line 155 "spms1_filter.rb"
  self->iv_next_b0 = (lv_raw_b0 * lv_step_inv_denom);
#line 156 "spms1_filter.rb"
  self->iv_next_b1 = ((((1.0 - self->iv_step_cos_w)) * self->iv_step_two_q) * lv_step_inv_denom);
#line 157 "spms1_filter.rb"
  self->iv_next_a1 = (((-4.0 * self->iv_step_cos_w) * self->iv_step_q) * lv_step_inv_denom);
#line 158 "spms1_filter.rb"
  self->iv_next_a2 = (((self->iv_step_two_q - self->iv_step_sin_w)) * lv_step_inv_denom);
#line 160 "spms1_filter.rb"
  self->iv_b0 = self->iv_next_b0;
#line 161 "spms1_filter.rb"
  self->iv_b1 = self->iv_next_b1;
#line 162 "spms1_filter.rb"
  self->iv_b2 = self->iv_next_b0;
#line 163 "spms1_filter.rb"
  self->iv_a1 = self->iv_next_a1;
#line 164 "spms1_filter.rb"
  self->iv_a2 = self->iv_next_a2;
  return 0.0;
}
#line 169 "spms1_filter.rb"
static mrb_float sp_Filter_soft_clip(sp_Filter *self, mrb_float lv_sample) {
    SP_GC_SAVE();
    mrb_float lv_scaled = 0.0;
#line 170 "spms1_filter.rb"
  if ((lv_sample > cst_SOFT_CLIP_CEILING)) {
#line 171 "spms1_filter.rb"
    return cst_SOFT_CLIP_LIMIT;
  }
  else {
    if ((lv_sample < (-cst_SOFT_CLIP_CEILING))) {
#line 173 "spms1_filter.rb"
      return (-cst_SOFT_CLIP_LIMIT);
    }
    else {
#line 175 "spms1_filter.rb"
      lv_scaled = (lv_sample * cst_SOFT_CLIP_INV_CEILING);
#line 176 "spms1_filter.rb"
      return (lv_sample - ((((lv_scaled * lv_scaled) * lv_scaled)) * cst_SOFT_CLIP_CUBIC_SCALE));
    }
  }
  return 0.0;
}
#line 11 "spms1_amp.rb"
static void sp_Amp_initialize(sp_Amp *self, mrb_int lv_sample_rate) {
    SP_GC_SAVE();
#line 12 "spms1_amp.rb"
  self->iv_sample_rate = lv_sample_rate;
#line 13 "spms1_amp.rb"
  self->iv_smoothing_target_blend = ((cst_Spms1__Amp__SMOOTHING_TARGET_BLEND_BASE * ((48000.0 / self->iv_sample_rate))) * ((cst_Spms1__Amp__CONTROL_RATE_DIVISOR / 4.0)));
#line 14 "spms1_amp.rb"
  self->iv_gain = 1.0;
#line 15 "spms1_amp.rb"
  self->iv_current_gain = 1.0;
#line 16 "spms1_amp.rb"
  self->iv_sample_counter = 0LL;
}
#line 23 "spms1_amp.rb"
static mrb_float sp_Amp_set_gain(sp_Amp *self, mrb_float lv_gain) {
    SP_GC_SAVE();
#line 24 "spms1_amp.rb"
  self->iv_gain = (((lv_gain < 0.0)) ? 0.0 : ((((lv_gain > 1.0)) ? 1.0 : lv_gain)));
  return 0.0;
}
#line 27 "spms1_amp.rb"
static mrb_float sp_Amp_process(sp_Amp *self, mrb_float lv_audio_input, mrb_float lv_modulation_input) {
    SP_GC_SAVE();
    mrb_float lv_mod = 0.0;
    mrb_float lv_total_gain = 0.0;
#line 29 "spms1_amp.rb"
  if ((self->iv_sample_counter == 0LL)) {
#line 30 "spms1_amp.rb"
    self->iv_current_gain += (((self->iv_gain - self->iv_current_gain)) * self->iv_smoothing_target_blend);
  }
#line 33 "spms1_amp.rb"
  self->iv_sample_counter = sp_imod((sp_int_add(self->iv_sample_counter, 1LL)), 4LL);
#line 39 "spms1_amp.rb"
  lv_mod = (((lv_modulation_input < -1.0)) ? -1.0 : ((((lv_modulation_input > 1.0)) ? 1.0 : lv_modulation_input)));
#line 40 "spms1_amp.rb"
  lv_total_gain = (self->iv_current_gain * lv_mod);
#line 42 "spms1_amp.rb"
  return (lv_audio_input * lv_total_gain);
  return 0.0;
}
#line 28 "spms1_env_gen.rb"
static void sp_EnvGen_initialize(sp_EnvGen *self, mrb_int lv_sample_rate) {
    SP_GC_SAVE();
#line 29 "spms1_env_gen.rb"
  self->iv_sample_rate = lv_sample_rate;
#line 32 "spms1_env_gen.rb"
  self->iv_effective_rate = (lv_sample_rate * ((1.0 / cst_Spms1__EnvGen__CONTROL_RATE_DIVISOR)));
#line 33 "spms1_env_gen.rb"
  self->iv_state = cst_STATE_IDLE;
#line 34 "spms1_env_gen.rb"
  self->iv_current_level = 0.0;
#line 36 "spms1_env_gen.rb"
  self->iv_attack = 0.0;
#line 37 "spms1_env_gen.rb"
  self->iv_decay = 0.0;
#line 38 "spms1_env_gen.rb"
  self->iv_sustain = 1.0;
#line 40 "spms1_env_gen.rb"
  self->iv_was_gate_on = 0;
#line 41 "spms1_env_gen.rb"
  self->iv_attack_coef = 1.0;
#line 42 "spms1_env_gen.rb"
  self->iv_decay_coef = 1.0;
#line 43 "spms1_env_gen.rb"
  self->iv_sample_counter = 0LL;
#line 45 "spms1_env_gen.rb"
  sp_EnvGen_update_coefficients_full((sp_EnvGen *)self);
}
#line 49 "spms1_env_gen.rb"
static mrb_float sp_EnvGen_set_attack(sp_EnvGen *self, mrb_float lv_attack) {
    SP_GC_SAVE();
#line 50 "spms1_env_gen.rb"
  self->iv_attack = (((lv_attack < 0.0)) ? 0.0 : ((((lv_attack > 1.0)) ? 1.0 : lv_attack)));
  return 0.0;
}
#line 54 "spms1_env_gen.rb"
static mrb_float sp_EnvGen_set_decay(sp_EnvGen *self, mrb_float lv_decay) {
    SP_GC_SAVE();
#line 55 "spms1_env_gen.rb"
  self->iv_decay = (((lv_decay < 0.0)) ? 0.0 : ((((lv_decay > 1.0)) ? 1.0 : lv_decay)));
  return 0.0;
}
#line 59 "spms1_env_gen.rb"
static mrb_float sp_EnvGen_set_sustain(sp_EnvGen *self, mrb_float lv_sustain) {
    SP_GC_SAVE();
#line 60 "spms1_env_gen.rb"
  self->iv_sustain = (((lv_sustain < 0.0)) ? 0.0 : ((((lv_sustain > 1.0)) ? 1.0 : lv_sustain)));
  return 0.0;
}
#line 63 "spms1_env_gen.rb"
static mrb_float sp_EnvGen_process(sp_EnvGen *self, mrb_float lv_gate_input) {
    SP_GC_SAVE();
    mrb_bool lv_is_gate_on = 0;
    mrb_bool lv_gate_rose = 0;
    mrb_bool lv_gate_fell = 0;
    mrb_float lv_target = 0.0;
    mrb_float lv_coef = 0.0;
    mrb_bool lv_apply_step = 0;
    mrb_float lv_coef_masked = 0.0;
    mrb_bool lv_is_attack_done = 0;
    mrb_bool lv_is_idle_reached = 0;
    mrb_bool lv_is_forced_attack = 0;
#line 65 "spms1_env_gen.rb"
  if ((self->iv_sample_counter == 0LL)) {
#line 66 "spms1_env_gen.rb"
    lv_is_gate_on = (lv_gate_input >= 0.5);
#line 67 "spms1_env_gen.rb"
    lv_gate_rose = (lv_is_gate_on && (!self->iv_was_gate_on));
#line 68 "spms1_env_gen.rb"
    lv_gate_fell = ((!lv_is_gate_on) && self->iv_was_gate_on);
#line 70 "spms1_env_gen.rb"
    self->iv_state = (lv_gate_rose ? cst_STATE_ATTACK : ((lv_gate_fell ? cst_STATE_SUSTAIN : self->iv_state)));
#line 71 "spms1_env_gen.rb"
    self->iv_was_gate_on = lv_is_gate_on;
#line 73 "spms1_env_gen.rb"
    sp_EnvGen_update_coefficients_full((sp_EnvGen *)self);
#line 75 "spms1_env_gen.rb"
    lv_target = (((self->iv_state == cst_STATE_ATTACK)) ? cst_ATTACK_TARGET : ((((((self->iv_state == cst_STATE_SUSTAIN)) && lv_is_gate_on)) ? self->iv_sustain : 0.0)));
#line 76 "spms1_env_gen.rb"
    lv_coef = (((self->iv_state == cst_STATE_ATTACK)) ? self->iv_attack_coef : ((((self->iv_state == cst_STATE_SUSTAIN)) ? self->iv_decay_coef : 0.0)));
#line 78 "spms1_env_gen.rb"
    lv_apply_step = ((((self->iv_state != cst_STATE_SUSTAIN)) || (!lv_is_gate_on)) || ((self->iv_sustain < self->iv_current_level)));
#line 79 "spms1_env_gen.rb"
    lv_coef_masked = (lv_apply_step ? lv_coef : 0.0);
#line 81 "spms1_env_gen.rb"
    self->iv_current_level += (((lv_target - self->iv_current_level)) * lv_coef_masked);
#line 83 "spms1_env_gen.rb"
    lv_is_attack_done = (((self->iv_state == cst_STATE_ATTACK)) && (((self->iv_current_level >= 1.0) || (!self->iv_was_gate_on))));
#line 84 "spms1_env_gen.rb"
    lv_is_idle_reached = ((((self->iv_state == cst_STATE_SUSTAIN)) && (!self->iv_was_gate_on)) && ((self->iv_current_level < 1.0000000000000001e-05)));
#line 85 "spms1_env_gen.rb"
    lv_is_forced_attack = (((self->iv_state == cst_STATE_IDLE)) && self->iv_was_gate_on);
#line 87 "spms1_env_gen.rb"
    self->iv_state = (lv_is_attack_done ? cst_STATE_SUSTAIN : ((lv_is_idle_reached ? cst_STATE_IDLE : ((lv_is_forced_attack ? cst_STATE_ATTACK : self->iv_state)))));
#line 89 "spms1_env_gen.rb"
    if (lv_is_attack_done) {
      self->iv_current_level = 1.0;
    }
#line 90 "spms1_env_gen.rb"
    if ((lv_is_idle_reached || (((self->iv_state == cst_STATE_IDLE) && (!self->iv_was_gate_on))))) {
      self->iv_current_level = 0.0;
    }
  }
#line 93 "spms1_env_gen.rb"
  self->iv_sample_counter = sp_imod((sp_int_add(self->iv_sample_counter, 1LL)), 4LL);
#line 94 "spms1_env_gen.rb"
  return self->iv_current_level;
  return 0.0;
}
#line 99 "spms1_env_gen.rb"
static mrb_float sp_EnvGen_update_coefficients_full(sp_EnvGen *self) {
    SP_GC_SAVE();
#line 100 "spms1_env_gen.rb"
  mrb_float _t13 = self->iv_attack;
  self->iv_attack_coef = (1.0 / (((cst_ATTACK_BASE * sp_EnvGen_calculate_exp_fast((sp_EnvGen *)self, _t13)) * self->iv_effective_rate)));
#line 101 "spms1_env_gen.rb"
  mrb_float _t14 = self->iv_decay;
  self->iv_decay_coef = (1.0 / (((cst_DECAY_BASE * sp_EnvGen_calculate_exp_fast((sp_EnvGen *)self, _t14)) * self->iv_effective_rate)));
  return 0.0;
}
#line 104 "spms1_env_gen.rb"
static mrb_float sp_EnvGen_calculate_exp_fast(sp_EnvGen *self, mrb_float lv_value) {
    SP_GC_SAVE();
    mrb_float lv_v_scale = 0.0;
    mrb_int lv_index = 0;
    mrb_float lv_fraction = 0.0;
    mrb_float lv_e0 = 0.0;
    mrb_float lv_e1 = 0.0;
#line 105 "spms1_env_gen.rb"
  lv_v_scale = (lv_value * 120.0);
#line 106 "spms1_env_gen.rb"
  lv_index = sp_float_to_i_checked(lv_v_scale);
#line 107 "spms1_env_gen.rb"
  lv_fraction = (lv_v_scale - ((mrb_float)(lv_index)));
#line 109 "spms1_env_gen.rb"
  lv_e0 = sp_FloatArray_get(cst_EXP_TABLE, lv_index);
#line 110 "spms1_env_gen.rb"
  lv_e1 = sp_FloatArray_get(cst_EXP_TABLE, sp_int_add(lv_index, 1LL));
#line 112 "spms1_env_gen.rb"
  return (lv_e0 + (lv_fraction * ((lv_e1 - lv_e0))));
  return 0.0;
}
#line 19 "spms1_lfo.rb"
static void sp_LFO_initialize(sp_LFO *self, mrb_int lv_sample_rate) {
    SP_GC_SAVE();
#line 20 "spms1_lfo.rb"
  self->iv_sample_rate = lv_sample_rate;
#line 24 "spms1_lfo.rb"
  self->iv_inv_sample_rate = (1.0 / lv_sample_rate);
#line 25 "spms1_lfo.rb"
  self->iv_smoothing_target_blend = ((cst_Spms1__LFO__SMOOTHING_TARGET_BLEND_BASE * ((48000.0 / self->iv_sample_rate))) * ((cst_Spms1__LFO__CONTROL_RATE_DIVISOR / 4.0)));
#line 26 "spms1_lfo.rb"
  self->iv_phase = 0.0;
#line 28 "spms1_lfo.rb"
  self->iv_rate = 0.5;
#line 29 "spms1_lfo.rb"
  self->iv_current_rate = 0.5;
#line 31 "spms1_lfo.rb"
  self->iv_dt = 0.0;
#line 32 "spms1_lfo.rb"
  self->iv_sample_counter = 0LL;
}
#line 37 "spms1_lfo.rb"
static mrb_float sp_LFO_set_rate(sp_LFO *self, mrb_float lv_rate) {
    SP_GC_SAVE();
#line 38 "spms1_lfo.rb"
  self->iv_rate = (((lv_rate < 0.0)) ? 0.0 : ((((lv_rate > 1.0)) ? 1.0 : lv_rate)));
  return 0.0;
}
#line 44 "spms1_lfo.rb"
static mrb_float sp_LFO_process(sp_LFO *self) {
    SP_GC_SAVE();
    mrb_float lv_shifted = 0.0;
    mrb_float lv_distance = 0.0;
    mrb_float lv_folded = 0.0;
    mrb_float lv_output = 0.0;
#line 45 "spms1_lfo.rb"
  if ((self->iv_sample_counter == 0LL)) {
#line 49 "spms1_lfo.rb"
    self->iv_current_rate += (((self->iv_rate - self->iv_current_rate)) * self->iv_smoothing_target_blend);
#line 50 "spms1_lfo.rb"
    mrb_float _t15 = self->iv_current_rate;
    self->iv_dt = (sp_LFO_rate_to_freq_fast((sp_LFO *)self, _t15) * self->iv_inv_sample_rate);
  }
#line 53 "spms1_lfo.rb"
  self->iv_sample_counter = sp_imod((sp_int_add(self->iv_sample_counter, 1LL)), 4LL);
#line 57 "spms1_lfo.rb"
  lv_shifted = (self->iv_phase + 0.25);
#line 58 "spms1_lfo.rb"
  lv_shifted -= (((lv_shifted < 1.0)) ? 0.0 : 1.0);
#line 59 "spms1_lfo.rb"
  lv_distance = (lv_shifted - 0.5);
#line 60 "spms1_lfo.rb"
  lv_folded = (((lv_distance < 0.0)) ? (-lv_distance) : lv_distance);
#line 61 "spms1_lfo.rb"
  lv_output = (0.5 - ((2.0 * lv_folded)));
#line 63 "spms1_lfo.rb"
  self->iv_phase += self->iv_dt;
#line 64 "spms1_lfo.rb"
  self->iv_phase -= (((self->iv_phase < 1.0)) ? 0.0 : 1.0);
#line 66 "spms1_lfo.rb"
  return lv_output;
  return 0.0;
}
#line 71 "spms1_lfo.rb"
static mrb_float sp_LFO_rate_to_freq_fast(sp_LFO *self, mrb_float lv_rate) {
    SP_GC_SAVE();
    mrb_float lv_internal_rate = 0.0;
    mrb_int lv_index = 0;
    mrb_float lv_fraction = 0.0;
    mrb_float lv_f0 = 0.0;
    mrb_float lv_f1 = 0.0;
#line 72 "spms1_lfo.rb"
  lv_internal_rate = (lv_rate * 120.0);
#line 73 "spms1_lfo.rb"
  lv_index = sp_float_to_i_checked(lv_internal_rate);
#line 74 "spms1_lfo.rb"
  lv_fraction = (lv_internal_rate - ((mrb_float)(lv_index)));
#line 75 "spms1_lfo.rb"
  lv_f0 = sp_FloatArray_get(cst_Spms1__LFO__FREQ_TABLE, lv_index);
#line 76 "spms1_lfo.rb"
  lv_f1 = sp_FloatArray_get(cst_Spms1__LFO__FREQ_TABLE, sp_int_add(lv_index, 1LL));
#line 77 "spms1_lfo.rb"
  return (lv_f0 + (lv_fraction * ((lv_f1 - lv_f0))));
  return 0.0;
}
#line 13 "spms1_mixer.rb"
static void sp_Mixer_initialize(sp_Mixer *self, mrb_int lv_sample_rate) {
    SP_GC_SAVE();
#line 14 "spms1_mixer.rb"
  self->iv_sample_rate = lv_sample_rate;
#line 15 "spms1_mixer.rb"
  self->iv_smoothing_target_blend = ((cst_Spms1__Mixer__SMOOTHING_TARGET_BLEND_BASE * ((48000.0 / self->iv_sample_rate))) * ((cst_Spms1__Mixer__CONTROL_RATE_DIVISOR / 4.0)));
#line 16 "spms1_mixer.rb"
  self->iv_level_1 = 1.0;
#line 17 "spms1_mixer.rb"
  self->iv_level_2 = 1.0;
#line 18 "spms1_mixer.rb"
  self->iv_polarity_1 = 1.0;
#line 19 "spms1_mixer.rb"
  self->iv_polarity_2 = 1.0;
#line 22 "spms1_mixer.rb"
  self->iv_target_1 = 1.0;
#line 23 "spms1_mixer.rb"
  self->iv_target_2 = 1.0;
#line 24 "spms1_mixer.rb"
  self->iv_current_1 = 1.0;
#line 25 "spms1_mixer.rb"
  self->iv_current_2 = 1.0;
#line 26 "spms1_mixer.rb"
  self->iv_sample_counter = 0LL;
}
#line 30 "spms1_mixer.rb"
static mrb_float sp_Mixer_set_level_1(sp_Mixer *self, mrb_float lv_level) {
    SP_GC_SAVE();
#line 31 "spms1_mixer.rb"
  self->iv_level_1 = (((lv_level < 0.0)) ? 0.0 : ((((lv_level > 1.0)) ? 1.0 : lv_level)));
#line 32 "spms1_mixer.rb"
  self->iv_target_1 = (self->iv_level_1 * self->iv_polarity_1);
  return 0.0;
}
#line 35 "spms1_mixer.rb"
static mrb_float sp_Mixer_set_level_2(sp_Mixer *self, mrb_float lv_level) {
    SP_GC_SAVE();
#line 36 "spms1_mixer.rb"
  self->iv_level_2 = (((lv_level < 0.0)) ? 0.0 : ((((lv_level > 1.0)) ? 1.0 : lv_level)));
#line 37 "spms1_mixer.rb"
  self->iv_target_2 = (self->iv_level_2 * self->iv_polarity_2);
  return 0.0;
}
#line 44 "spms1_mixer.rb"
static mrb_float sp_Mixer_set_invert_1(sp_Mixer *self, mrb_float lv_invert) {
    SP_GC_SAVE();
    mrb_float lv_clamped_invert = 0.0;
#line 45 "spms1_mixer.rb"
  lv_clamped_invert = (((lv_invert < 0.0)) ? 0.0 : ((((lv_invert > 1.0)) ? 1.0 : lv_invert)));
#line 46 "spms1_mixer.rb"
  self->iv_polarity_1 = (1.0 - ((lv_clamped_invert + lv_clamped_invert)));
#line 47 "spms1_mixer.rb"
  self->iv_target_1 = (self->iv_level_1 * self->iv_polarity_1);
  return 0.0;
}
#line 50 "spms1_mixer.rb"
static mrb_float sp_Mixer_set_invert_2(sp_Mixer *self, mrb_float lv_invert) {
    SP_GC_SAVE();
    mrb_float lv_clamped_invert = 0.0;
#line 51 "spms1_mixer.rb"
  lv_clamped_invert = (((lv_invert < 0.0)) ? 0.0 : ((((lv_invert > 1.0)) ? 1.0 : lv_invert)));
#line 52 "spms1_mixer.rb"
  self->iv_polarity_2 = (1.0 - ((lv_clamped_invert + lv_clamped_invert)));
#line 53 "spms1_mixer.rb"
  self->iv_target_2 = (self->iv_level_2 * self->iv_polarity_2);
  return 0.0;
}
#line 58 "spms1_mixer.rb"
static mrb_float sp_Mixer_process(sp_Mixer *self, mrb_float lv_input_1, mrb_float lv_input_2) {
    SP_GC_SAVE();
#line 59 "spms1_mixer.rb"
  if ((self->iv_sample_counter == 0LL)) {
#line 60 "spms1_mixer.rb"
    self->iv_current_1 += (((self->iv_target_1 - self->iv_current_1)) * self->iv_smoothing_target_blend);
#line 61 "spms1_mixer.rb"
    self->iv_current_2 += (((self->iv_target_2 - self->iv_current_2)) * self->iv_smoothing_target_blend);
  }
#line 64 "spms1_mixer.rb"
  self->iv_sample_counter = sp_imod((sp_int_add(self->iv_sample_counter, 1LL)), 4LL);
#line 66 "spms1_mixer.rb"
  return ((lv_input_1 * self->iv_current_1) + (lv_input_2 * self->iv_current_2));
  return 0.0;
}
#line 255 "spms1_main.rb"
static mrb_float sp_cc_to_ratio(mrb_int lv_value) {
    SP_GC_SAVE();
    mrb_float lv_scaled = 0.0;
#line 256 "spms1_main.rb"
  lv_scaled = (((((mrb_float)(lv_value)) - 4.0)) * ((1.0 / 120.0)));
#line 257 "spms1_main.rb"
  if (((lv_scaled < 0.0))) {
    return 0.0;
  }
  else {
    return ((((lv_scaled > 1.0)) ? 1.0 : lv_scaled));
  }
  return 0.0;
}
#line 263 "spms1_main.rb"
static mrb_int sp_cc_slot(mrb_int lv_cc_number, mrb_int lv_slot) {
    SP_GC_SAVE();
#line 264 "spms1_main.rb"
  if (((lv_cc_number == 0LL))) {
    return cst_SIGNAL_SINK;
  }
  else {
    return lv_slot;
  }
  return 0;
}
int main(int argc,char**argv){
    SP_GC_SAVE();
    sp_re_init();
    volatile mrb_int lv_i = 0;
    sp_LFO * lv_lfo = NULL;
    SP_GC_ROOT(lv_lfo);
    sp_EnvGen * lv_env_gen = NULL;
    SP_GC_ROOT(lv_env_gen);
    sp_Osc * lv_osc = NULL;
    SP_GC_ROOT(lv_osc);
    sp_Filter * lv_filter = NULL;
    SP_GC_ROOT(lv_filter);
    sp_Amp * lv_amp = NULL;
    SP_GC_ROOT(lv_amp);
    sp_Mixer * lv_mixer_1 = NULL;
    SP_GC_ROOT(lv_mixer_1);
    sp_Mixer * lv_mixer_2 = NULL;
    SP_GC_ROOT(lv_mixer_2);
    sp_Mixer * lv_mixer_3 = NULL;
    SP_GC_ROOT(lv_mixer_3);
    sp_Mixer * lv_mixer_4 = NULL;
    SP_GC_ROOT(lv_mixer_4);
    sp_Mixer * lv_mixer_5 = NULL;
    SP_GC_ROOT(lv_mixer_5);
    sp_IntArray * lv_active_modules = NULL;
    SP_GC_ROOT(lv_active_modules);
    sp_FloatArray * lv_audio_buffer = NULL;
    SP_GC_ROOT(lv_audio_buffer);
    sp_FloatArray * lv_signals = NULL;
    SP_GC_ROOT(lv_signals);
    volatile mrb_int lv_slot = 0;
    volatile mrb_int lv_source_env_gen_gate = 0;
    volatile mrb_int lv_source_osc_pitch = 0;
    volatile mrb_int lv_source_osc_mod = 0;
    volatile mrb_int lv_source_filter_audio = 0;
    volatile mrb_int lv_source_filter_mod = 0;
    volatile mrb_int lv_source_amp_audio = 0;
    volatile mrb_int lv_source_amp_mod = 0;
    volatile mrb_int lv_source_mixer_1_in_1 = 0;
    volatile mrb_int lv_source_mixer_1_in_2 = 0;
    volatile mrb_int lv_source_mixer_2_in_1 = 0;
    volatile mrb_int lv_source_mixer_2_in_2 = 0;
    volatile mrb_int lv_source_mixer_3_in_1 = 0;
    volatile mrb_int lv_source_mixer_3_in_2 = 0;
    volatile mrb_int lv_source_mixer_4_in_1 = 0;
    volatile mrb_int lv_source_mixer_4_in_2 = 0;
    volatile mrb_int lv_source_mixer_5_in_1 = 0;
    volatile mrb_int lv_source_mixer_5_in_2 = 0;
    volatile mrb_int lv_source_output = 0;
    volatile mrb_int lv_source_osc_waveform = 0;
    volatile mrb_int lv_source_osc_mod_amount = 0;
    volatile mrb_int lv_source_osc_coarse_tune = 0;
    volatile mrb_int lv_source_osc_fine_tune = 0;
    volatile mrb_int lv_source_filter_cutoff = 0;
    volatile mrb_int lv_source_filter_resonance = 0;
    volatile mrb_int lv_source_filter_mod_amount = 0;
    volatile mrb_int lv_source_filter_gain = 0;
    volatile mrb_int lv_source_amp_gain = 0;
    volatile mrb_int lv_source_env_gen_attack = 0;
    volatile mrb_int lv_source_env_gen_decay = 0;
    volatile mrb_int lv_source_env_gen_sustain = 0;
    volatile mrb_int lv_source_lfo_rate = 0;
    volatile mrb_int lv_source_mixer_1_level_1 = 0;
    volatile mrb_int lv_source_mixer_1_invert_1 = 0;
    volatile mrb_int lv_source_mixer_1_level_2 = 0;
    volatile mrb_int lv_source_mixer_1_invert_2 = 0;
    volatile mrb_int lv_source_mixer_2_level_1 = 0;
    volatile mrb_int lv_source_mixer_2_invert_1 = 0;
    volatile mrb_int lv_source_mixer_2_level_2 = 0;
    volatile mrb_int lv_source_mixer_2_invert_2 = 0;
    volatile mrb_int lv_source_mixer_3_level_1 = 0;
    volatile mrb_int lv_source_mixer_3_invert_1 = 0;
    volatile mrb_int lv_source_mixer_3_level_2 = 0;
    volatile mrb_int lv_source_mixer_3_invert_2 = 0;
    volatile mrb_int lv_source_mixer_4_level_1 = 0;
    volatile mrb_int lv_source_mixer_4_invert_1 = 0;
    volatile mrb_int lv_source_mixer_4_level_2 = 0;
    volatile mrb_int lv_source_mixer_4_invert_2 = 0;
    volatile mrb_int lv_source_mixer_5_level_1 = 0;
    volatile mrb_int lv_source_mixer_5_invert_1 = 0;
    volatile mrb_int lv_source_mixer_5_level_2 = 0;
    volatile mrb_int lv_source_mixer_5_invert_2 = 0;
    volatile mrb_int lv_cc_osc_waveform = 0;
    volatile mrb_int lv_cc_osc_mod_amount = 0;
    volatile mrb_int lv_cc_osc_coarse_tune = 0;
    volatile mrb_int lv_cc_osc_fine_tune = 0;
    volatile mrb_int lv_cc_filter_cutoff = 0;
    volatile mrb_int lv_cc_filter_resonance = 0;
    volatile mrb_int lv_cc_filter_mod_amount = 0;
    volatile mrb_int lv_cc_filter_gain = 0;
    volatile mrb_int lv_cc_amp_gain = 0;
    volatile mrb_int lv_cc_env_gen_attack = 0;
    volatile mrb_int lv_cc_env_gen_decay = 0;
    volatile mrb_int lv_cc_env_gen_sustain = 0;
    volatile mrb_int lv_cc_lfo_rate = 0;
    volatile mrb_int lv_cc_mixer_1_level_1 = 0;
    volatile mrb_int lv_cc_mixer_1_invert_1 = 0;
    volatile mrb_int lv_cc_mixer_1_level_2 = 0;
    volatile mrb_int lv_cc_mixer_1_invert_2 = 0;
    volatile mrb_int lv_cc_mixer_2_level_1 = 0;
    volatile mrb_int lv_cc_mixer_2_invert_1 = 0;
    volatile mrb_int lv_cc_mixer_2_level_2 = 0;
    volatile mrb_int lv_cc_mixer_2_invert_2 = 0;
    volatile mrb_int lv_cc_mixer_3_level_1 = 0;
    volatile mrb_int lv_cc_mixer_3_invert_1 = 0;
    volatile mrb_int lv_cc_mixer_3_level_2 = 0;
    volatile mrb_int lv_cc_mixer_3_invert_2 = 0;
    volatile mrb_int lv_cc_mixer_4_level_1 = 0;
    volatile mrb_int lv_cc_mixer_4_invert_1 = 0;
    volatile mrb_int lv_cc_mixer_4_level_2 = 0;
    volatile mrb_int lv_cc_mixer_4_invert_2 = 0;
    volatile mrb_int lv_cc_mixer_5_level_1 = 0;
    volatile mrb_int lv_cc_mixer_5_invert_1 = 0;
    volatile mrb_int lv_cc_mixer_5_level_2 = 0;
    volatile mrb_int lv_cc_mixer_5_invert_2 = 0;
    volatile mrb_int lv_module_id = 0;
    mrb_int lv_i__bp5236 = 0;

#line 1 "spms1_osc.rb"
#line 3 "spms1_osc.rb"
#line 6 "spms1_osc.rb"
  cst_Spms1__Osc__SMOOTHING_TARGET_BLEND_BASE = 0.03125;
#line 8 "spms1_osc.rb"
  cst_Spms1__Osc__CONTROL_RATE_DIVISOR = 4LL;
#line 13 "spms1_osc.rb"
  cst_MODULATION_RANGE = (120.0 / 120.0);
#line 16 "spms1_osc.rb"
  cst_COARSE_TUNE_RANGE = (60.0 / 120.0);
#line 17 "spms1_osc.rb"
  cst_FINE_TUNE_RANGE = (0.59999999999999998 / 120.0);
#line 20 "spms1_osc.rb"
  mrb_int _t17 = 129LL;
  if (_t17 < 0) sp_raise_cls("ArgumentError", "negative array size");
  mrb_float _t18 = 0.0;
  sp_FloatArray *_t19 = sp_FloatArray_new();
  SP_GC_ROOT(_t19);
  for (mrb_int _t20 = 0; _t20 < _t17; _t20++) sp_FloatArray_push(_t19, _t18);
  cst_Spms1__Osc__FREQ_TABLE = _t19;
#line 21 "spms1_osc.rb"
  { mrb_int _t21 = 129LL;
    for (lv_i = 0LL; lv_i < _t21; lv_i++) {
#line 22 "spms1_osc.rb"
      sp_FloatArray_set(cst_Spms1__Osc__FREQ_TABLE, lv_i, (440.0 * (sp_float_pow(2.0, ((((((mrb_float)(lv_i)) - 69.0)) * ((1.0 / 12.0))))))));
    }
  }
#line 1 "spms1_filter.rb"
#line 7 "spms1_filter.rb"
#line 8 "spms1_filter.rb"
  cst_SOFT_CLIP_CEILING = 4.0;
#line 13 "spms1_filter.rb"
  cst_SOFT_CLIP_INV_CEILING = (1.0 / cst_SOFT_CLIP_CEILING);
#line 14 "spms1_filter.rb"
  cst_SOFT_CLIP_LIMIT = (((2.0 / 3.0)) * cst_SOFT_CLIP_CEILING);
#line 15 "spms1_filter.rb"
  cst_SOFT_CLIP_CUBIC_SCALE = (((1.0 / 3.0)) * cst_SOFT_CLIP_CEILING);
#line 18 "spms1_filter.rb"
  cst_Spms1__Filter__SMOOTHING_TARGET_BLEND_BASE = 0.03125;
#line 20 "spms1_filter.rb"
  cst_Spms1__Filter__CONTROL_RATE_DIVISOR = 4LL;
#line 23 "spms1_filter.rb"
  mrb_int _t23 = 137LL;
  if (_t23 < 0) sp_raise_cls("ArgumentError", "negative array size");
  mrb_float _t24 = 0.0;
  sp_FloatArray *_t25 = sp_FloatArray_new();
  SP_GC_ROOT(_t25);
  for (mrb_int _t26 = 0; _t26 < _t23; _t26++) sp_FloatArray_push(_t25, _t24);
  cst_Spms1__Filter__FREQ_TABLE = _t25;
#line 24 "spms1_filter.rb"
  { mrb_int _t27 = 136LL;
    for (lv_i = 0LL; lv_i < _t27; lv_i++) {
#line 25 "spms1_filter.rb"
      sp_FloatArray_set(cst_Spms1__Filter__FREQ_TABLE, lv_i, (440.0 * (sp_float_pow(2.0, ((((((mrb_float)(lv_i)) - 69.0)) * ((1.0 / 12.0))))))));
    }
  }
#line 27 "spms1_filter.rb"
  sp_FloatArray_set(cst_Spms1__Filter__FREQ_TABLE, 136LL, sp_FloatArray_get(cst_Spms1__Filter__FREQ_TABLE, 135LL));
#line 30 "spms1_filter.rb"
  mrb_int _t29 = 122LL;
  if (_t29 < 0) sp_raise_cls("ArgumentError", "negative array size");
  mrb_float _t30 = 0.0;
  sp_FloatArray *_t31 = sp_FloatArray_new();
  SP_GC_ROOT(_t31);
  for (mrb_int _t32 = 0; _t32 < _t29; _t32++) sp_FloatArray_push(_t31, _t30);
  cst_Q_TABLE = _t31;
#line 31 "spms1_filter.rb"
  cst_BASE_Q = 0.70710678118654757;
#line 32 "spms1_filter.rb"
  { mrb_int _t33 = 121LL;
    for (lv_i = 0LL; lv_i < _t33; lv_i++) {
#line 33 "spms1_filter.rb"
      sp_FloatArray_set(cst_Q_TABLE, lv_i, (cst_BASE_Q * (sp_float_pow(2.0, ((((mrb_float)(lv_i)) * ((1.0 / 30.0))))))));
    }
  }
#line 35 "spms1_filter.rb"
  sp_FloatArray_set(cst_Q_TABLE, 121LL, sp_FloatArray_get(cst_Q_TABLE, 120LL));
#line 1 "spms1_amp.rb"
#line 4 "spms1_amp.rb"
#line 7 "spms1_amp.rb"
  cst_Spms1__Amp__SMOOTHING_TARGET_BLEND_BASE = 0.03125;
#line 9 "spms1_amp.rb"
  cst_Spms1__Amp__CONTROL_RATE_DIVISOR = 4LL;
#line 1 "spms1_env_gen.rb"
#line 3 "spms1_env_gen.rb"
#line 4 "spms1_env_gen.rb"
  cst_STATE_ATTACK = 0LL;
#line 5 "spms1_env_gen.rb"
  cst_STATE_SUSTAIN = 1LL;
#line 6 "spms1_env_gen.rb"
  cst_STATE_IDLE = 2LL;
#line 8 "spms1_env_gen.rb"
  cst_Spms1__EnvGen__CONTROL_RATE_DIVISOR = 4LL;
#line 11 "spms1_env_gen.rb"
  mrb_int _t35 = 122LL;
  if (_t35 < 0) sp_raise_cls("ArgumentError", "negative array size");
  mrb_float _t36 = 0.0;
  sp_FloatArray *_t37 = sp_FloatArray_new();
  SP_GC_ROOT(_t37);
  for (mrb_int _t38 = 0; _t38 < _t35; _t38++) sp_FloatArray_push(_t37, _t36);
  cst_EXP_TABLE = _t37;
#line 12 "spms1_env_gen.rb"
  { mrb_int _t39 = 121LL;
    for (lv_i = 0LL; lv_i < _t39; lv_i++) {
#line 13 "spms1_env_gen.rb"
      sp_FloatArray_set(cst_EXP_TABLE, lv_i, sp_float_pow(10.0, ((((((mrb_float)(lv_i)) - 60.0)) * ((1.0 / 30.0))))));
    }
  }
#line 15 "spms1_env_gen.rb"
  sp_FloatArray_set(cst_EXP_TABLE, 121LL, sp_FloatArray_get(cst_EXP_TABLE, 120LL));
#line 19 "spms1_env_gen.rb"
  cst_ATTACK_BASE = (0.001 / ((0.01 * sp_math_log((mrb_float)(2LL)))));
#line 23 "spms1_env_gen.rb"
  cst_DECAY_BASE = (0.0030000000000000001 / (((0.01 * 10LL) * sp_math_log((mrb_float)(2LL)))));
#line 26 "spms1_env_gen.rb"
  cst_ATTACK_TARGET = 2.0;
#line 1 "spms1_lfo.rb"
#line 4 "spms1_lfo.rb"
#line 7 "spms1_lfo.rb"
  cst_Spms1__LFO__SMOOTHING_TARGET_BLEND_BASE = 0.03125;
#line 9 "spms1_lfo.rb"
  cst_Spms1__LFO__CONTROL_RATE_DIVISOR = 4LL;
#line 14 "spms1_lfo.rb"
  mrb_int _t43 = 122LL;
  if (_t43 < 0) sp_raise_cls("ArgumentError", "negative array size");
  mrb_float _t44 = 0.0;
  sp_FloatArray *_t45 = sp_FloatArray_new();
  SP_GC_ROOT(_t45);
  for (mrb_int _t46 = 0; _t46 < _t43; _t46++) sp_FloatArray_push(_t45, _t44);
  cst_Spms1__LFO__FREQ_TABLE = _t45;
#line 15 "spms1_lfo.rb"
  { mrb_int _t47 = 122LL;
    for (lv_i = 0LL; lv_i < _t47; lv_i++) {
#line 16 "spms1_lfo.rb"
      sp_FloatArray_set(cst_Spms1__LFO__FREQ_TABLE, lv_i, (440.0 * (sp_float_pow(2.0, ((((((mrb_float)(lv_i)) - 132.0)) * ((1.0 / 12.0))))))));
    }
  }
#line 1 "spms1_mixer.rb"
#line 6 "spms1_mixer.rb"
#line 9 "spms1_mixer.rb"
  cst_Spms1__Mixer__SMOOTHING_TARGET_BLEND_BASE = 0.03125;
#line 11 "spms1_mixer.rb"
  cst_Spms1__Mixer__CONTROL_RATE_DIVISOR = 4LL;
#line 23 "spms1_main.rb"
#line 24 "spms1_main.rb"
#line 49 "spms1_main.rb"
#line 51 "spms1_main.rb"
  cst_MIDI_CH = 0LL;
#line 52 "spms1_main.rb"
  cst_SAMPLE_RATE = 48000LL;
#line 53 "spms1_main.rb"
  cst_AUDIO_BUFFERS = 2LL;
#line 54 "spms1_main.rb"
  cst_AUDIO_BUFFER_WORDS = 64LL;
#line 60 "spms1_main.rb"
  cst_MODULES_SIZE = 32LL;
#line 66 "spms1_main.rb"
  cst_MODULE_NONE = 0LL;
#line 67 "spms1_main.rb"
  cst_MODULE_LFO = 1LL;
#line 68 "spms1_main.rb"
  cst_MODULE_ENV_GEN = 2LL;
#line 69 "spms1_main.rb"
  cst_MODULE_OSC = 3LL;
#line 70 "spms1_main.rb"
  cst_MODULE_FILTER = 4LL;
#line 71 "spms1_main.rb"
  cst_MODULE_AMP = 5LL;
#line 72 "spms1_main.rb"
  cst_MODULE_MIXER_1 = 6LL;
#line 73 "spms1_main.rb"
  cst_MODULE_MIXER_2 = 7LL;
#line 74 "spms1_main.rb"
  cst_MODULE_MIXER_3 = 8LL;
#line 75 "spms1_main.rb"
  cst_MODULE_MIXER_4 = 9LL;
#line 76 "spms1_main.rb"
  cst_MODULE_MIXER_5 = 10LL;
#line 89 "spms1_main.rb"
  cst_SIGNAL_NONE = 0LL;
#line 90 "spms1_main.rb"
  cst_SIGNAL_ONE = 1LL;
#line 91 "spms1_main.rb"
  cst_SIGNAL_HALF = 2LL;
#line 92 "spms1_main.rb"
  cst_SIGNAL_MINUS_HALF = 3LL;
#line 93 "spms1_main.rb"
  cst_SIGNAL_MINUS_ONE = 4LL;
#line 95 "spms1_main.rb"
  cst_SIGNAL_LFO_OUTPUT = 5LL;
#line 96 "spms1_main.rb"
  cst_SIGNAL_ENV_GEN_OUTPUT = 6LL;
#line 97 "spms1_main.rb"
  cst_SIGNAL_OSC_OUTPUT = 7LL;
#line 98 "spms1_main.rb"
  cst_SIGNAL_FILTER_OUTPUT = 8LL;
#line 99 "spms1_main.rb"
  cst_SIGNAL_AMP_OUTPUT = 9LL;
#line 100 "spms1_main.rb"
  cst_SIGNAL_MIXER_1_OUTPUT = 10LL;
#line 101 "spms1_main.rb"
  cst_SIGNAL_MIXER_2_OUTPUT = 11LL;
#line 102 "spms1_main.rb"
  cst_SIGNAL_MIXER_3_OUTPUT = 12LL;
#line 103 "spms1_main.rb"
  cst_SIGNAL_MIXER_4_OUTPUT = 13LL;
#line 104 "spms1_main.rb"
  cst_SIGNAL_MIXER_5_OUTPUT = 14LL;
#line 106 "spms1_main.rb"
  cst_SIGNAL_OSC_WAVEFORM = 15LL;
#line 107 "spms1_main.rb"
  cst_SIGNAL_OSC_MOD_AMOUNT = 16LL;
#line 108 "spms1_main.rb"
  cst_SIGNAL_OSC_COARSE_TUNE = 17LL;
#line 109 "spms1_main.rb"
  cst_SIGNAL_OSC_FINE_TUNE = 18LL;
#line 110 "spms1_main.rb"
  cst_SIGNAL_FILTER_CUTOFF = 19LL;
#line 111 "spms1_main.rb"
  cst_SIGNAL_FILTER_RESONANCE = 20LL;
#line 112 "spms1_main.rb"
  cst_SIGNAL_FILTER_MOD_AMOUNT = 21LL;
#line 113 "spms1_main.rb"
  cst_SIGNAL_FILTER_GAIN = 22LL;
#line 114 "spms1_main.rb"
  cst_SIGNAL_AMP_GAIN = 23LL;
#line 115 "spms1_main.rb"
  cst_SIGNAL_ENV_GEN_ATTACK = 24LL;
#line 116 "spms1_main.rb"
  cst_SIGNAL_ENV_GEN_DECAY = 25LL;
#line 117 "spms1_main.rb"
  cst_SIGNAL_ENV_GEN_SUSTAIN = 26LL;
#line 118 "spms1_main.rb"
  cst_SIGNAL_LFO_RATE = 27LL;
#line 119 "spms1_main.rb"
  cst_SIGNAL_MIXER_1_LEVEL_1 = 28LL;
#line 120 "spms1_main.rb"
  cst_SIGNAL_MIXER_1_INVERT_1 = 29LL;
#line 121 "spms1_main.rb"
  cst_SIGNAL_MIXER_1_LEVEL_2 = 30LL;
#line 122 "spms1_main.rb"
  cst_SIGNAL_MIXER_1_INVERT_2 = 31LL;
#line 123 "spms1_main.rb"
  cst_SIGNAL_MIXER_2_LEVEL_1 = 32LL;
#line 124 "spms1_main.rb"
  cst_SIGNAL_MIXER_2_INVERT_1 = 33LL;
#line 125 "spms1_main.rb"
  cst_SIGNAL_MIXER_2_LEVEL_2 = 34LL;
#line 126 "spms1_main.rb"
  cst_SIGNAL_MIXER_2_INVERT_2 = 35LL;
#line 127 "spms1_main.rb"
  cst_SIGNAL_MIXER_3_LEVEL_1 = 36LL;
#line 128 "spms1_main.rb"
  cst_SIGNAL_MIXER_3_INVERT_1 = 37LL;
#line 129 "spms1_main.rb"
  cst_SIGNAL_MIXER_3_LEVEL_2 = 38LL;
#line 130 "spms1_main.rb"
  cst_SIGNAL_MIXER_3_INVERT_2 = 39LL;
#line 131 "spms1_main.rb"
  cst_SIGNAL_MIXER_4_LEVEL_1 = 40LL;
#line 132 "spms1_main.rb"
  cst_SIGNAL_MIXER_4_INVERT_1 = 41LL;
#line 133 "spms1_main.rb"
  cst_SIGNAL_MIXER_4_LEVEL_2 = 42LL;
#line 134 "spms1_main.rb"
  cst_SIGNAL_MIXER_4_INVERT_2 = 43LL;
#line 135 "spms1_main.rb"
  cst_SIGNAL_MIXER_5_LEVEL_1 = 44LL;
#line 136 "spms1_main.rb"
  cst_SIGNAL_MIXER_5_INVERT_1 = 45LL;
#line 137 "spms1_main.rb"
  cst_SIGNAL_MIXER_5_LEVEL_2 = 46LL;
#line 138 "spms1_main.rb"
  cst_SIGNAL_MIXER_5_INVERT_2 = 47LL;
#line 140 "spms1_main.rb"
  cst_SIGNAL_PITCH = 48LL;
#line 141 "spms1_main.rb"
  cst_SIGNAL_GATE = 49LL;
#line 142 "spms1_main.rb"
  cst_SIGNAL_BEND = 50LL;
#line 144 "spms1_main.rb"
  cst_SIGNALS_SIZE = 128LL;
#line 148 "spms1_main.rb"
  cst_SIGNAL_SINK = sp_int_sub(cst_SIGNALS_SIZE, 1LL);
#line 155 "spms1_main.rb"
  cst_NRPN_ACTIVE_MODULE_BASE = 0LL;
#line 157 "spms1_main.rb"
  cst_NRPN_SOURCE_ENV_GEN_GATE = 128LL;
#line 158 "spms1_main.rb"
  cst_NRPN_SOURCE_OSC_PITCH = 129LL;
#line 159 "spms1_main.rb"
  cst_NRPN_SOURCE_OSC_MOD = 130LL;
#line 160 "spms1_main.rb"
  cst_NRPN_SOURCE_FILTER_AUDIO = 131LL;
#line 161 "spms1_main.rb"
  cst_NRPN_SOURCE_FILTER_MOD = 132LL;
#line 162 "spms1_main.rb"
  cst_NRPN_SOURCE_AMP_AUDIO = 133LL;
#line 163 "spms1_main.rb"
  cst_NRPN_SOURCE_AMP_MOD = 134LL;
#line 164 "spms1_main.rb"
  cst_NRPN_SOURCE_MIXER_1_IN_1 = 135LL;
#line 165 "spms1_main.rb"
  cst_NRPN_SOURCE_MIXER_1_IN_2 = 136LL;
#line 166 "spms1_main.rb"
  cst_NRPN_SOURCE_MIXER_2_IN_1 = 137LL;
#line 167 "spms1_main.rb"
  cst_NRPN_SOURCE_MIXER_2_IN_2 = 138LL;
#line 168 "spms1_main.rb"
  cst_NRPN_SOURCE_MIXER_3_IN_1 = 139LL;
#line 169 "spms1_main.rb"
  cst_NRPN_SOURCE_MIXER_3_IN_2 = 140LL;
#line 170 "spms1_main.rb"
  cst_NRPN_SOURCE_MIXER_4_IN_1 = 141LL;
#line 171 "spms1_main.rb"
  cst_NRPN_SOURCE_MIXER_4_IN_2 = 142LL;
#line 172 "spms1_main.rb"
  cst_NRPN_SOURCE_MIXER_5_IN_1 = 143LL;
#line 173 "spms1_main.rb"
  cst_NRPN_SOURCE_MIXER_5_IN_2 = 144LL;
#line 174 "spms1_main.rb"
  cst_NRPN_SOURCE_OUTPUT = 145LL;
#line 176 "spms1_main.rb"
  cst_NRPN_SOURCE_OSC_WAVEFORM = 256LL;
#line 177 "spms1_main.rb"
  cst_NRPN_SOURCE_OSC_MOD_AMOUNT = 257LL;
#line 178 "spms1_main.rb"
  cst_NRPN_SOURCE_OSC_COARSE_TUNE = 258LL;
#line 179 "spms1_main.rb"
  cst_NRPN_SOURCE_OSC_FINE_TUNE = 259LL;
#line 180 "spms1_main.rb"
  cst_NRPN_SOURCE_FILTER_CUTOFF = 260LL;
#line 181 "spms1_main.rb"
  cst_NRPN_SOURCE_FILTER_RESONANCE = 261LL;
#line 182 "spms1_main.rb"
  cst_NRPN_SOURCE_FILTER_MOD_AMOUNT = 262LL;
#line 183 "spms1_main.rb"
  cst_NRPN_SOURCE_FILTER_GAIN = 263LL;
#line 184 "spms1_main.rb"
  cst_NRPN_SOURCE_AMP_GAIN = 264LL;
#line 185 "spms1_main.rb"
  cst_NRPN_SOURCE_ENV_GEN_ATTACK = 265LL;
#line 186 "spms1_main.rb"
  cst_NRPN_SOURCE_ENV_GEN_DECAY = 266LL;
#line 187 "spms1_main.rb"
  cst_NRPN_SOURCE_ENV_GEN_SUSTAIN = 267LL;
#line 188 "spms1_main.rb"
  cst_NRPN_SOURCE_LFO_RATE = 268LL;
#line 189 "spms1_main.rb"
  cst_NRPN_SOURCE_MIXER_1_LEVEL_1 = 269LL;
#line 190 "spms1_main.rb"
  cst_NRPN_SOURCE_MIXER_1_INVERT_1 = 270LL;
#line 191 "spms1_main.rb"
  cst_NRPN_SOURCE_MIXER_1_LEVEL_2 = 271LL;
#line 192 "spms1_main.rb"
  cst_NRPN_SOURCE_MIXER_1_INVERT_2 = 272LL;
#line 193 "spms1_main.rb"
  cst_NRPN_SOURCE_MIXER_2_LEVEL_1 = 273LL;
#line 194 "spms1_main.rb"
  cst_NRPN_SOURCE_MIXER_2_INVERT_1 = 274LL;
#line 195 "spms1_main.rb"
  cst_NRPN_SOURCE_MIXER_2_LEVEL_2 = 275LL;
#line 196 "spms1_main.rb"
  cst_NRPN_SOURCE_MIXER_2_INVERT_2 = 276LL;
#line 197 "spms1_main.rb"
  cst_NRPN_SOURCE_MIXER_3_LEVEL_1 = 277LL;
#line 198 "spms1_main.rb"
  cst_NRPN_SOURCE_MIXER_3_INVERT_1 = 278LL;
#line 199 "spms1_main.rb"
  cst_NRPN_SOURCE_MIXER_3_LEVEL_2 = 279LL;
#line 200 "spms1_main.rb"
  cst_NRPN_SOURCE_MIXER_3_INVERT_2 = 280LL;
#line 201 "spms1_main.rb"
  cst_NRPN_SOURCE_MIXER_4_LEVEL_1 = 281LL;
#line 202 "spms1_main.rb"
  cst_NRPN_SOURCE_MIXER_4_INVERT_1 = 282LL;
#line 203 "spms1_main.rb"
  cst_NRPN_SOURCE_MIXER_4_LEVEL_2 = 283LL;
#line 204 "spms1_main.rb"
  cst_NRPN_SOURCE_MIXER_4_INVERT_2 = 284LL;
#line 205 "spms1_main.rb"
  cst_NRPN_SOURCE_MIXER_5_LEVEL_1 = 285LL;
#line 206 "spms1_main.rb"
  cst_NRPN_SOURCE_MIXER_5_INVERT_1 = 286LL;
#line 207 "spms1_main.rb"
  cst_NRPN_SOURCE_MIXER_5_LEVEL_2 = 287LL;
#line 208 "spms1_main.rb"
  cst_NRPN_SOURCE_MIXER_5_INVERT_2 = 288LL;
#line 213 "spms1_main.rb"
  cst_NRPN_CC_OSC_WAVEFORM = 384LL;
#line 214 "spms1_main.rb"
  cst_NRPN_CC_OSC_MOD_AMOUNT = 385LL;
#line 215 "spms1_main.rb"
  cst_NRPN_CC_OSC_COARSE_TUNE = 386LL;
#line 216 "spms1_main.rb"
  cst_NRPN_CC_OSC_FINE_TUNE = 387LL;
#line 217 "spms1_main.rb"
  cst_NRPN_CC_FILTER_CUTOFF = 388LL;
#line 218 "spms1_main.rb"
  cst_NRPN_CC_FILTER_RESONANCE = 389LL;
#line 219 "spms1_main.rb"
  cst_NRPN_CC_FILTER_MOD_AMOUNT = 390LL;
#line 220 "spms1_main.rb"
  cst_NRPN_CC_FILTER_GAIN = 391LL;
#line 221 "spms1_main.rb"
  cst_NRPN_CC_AMP_GAIN = 392LL;
#line 222 "spms1_main.rb"
  cst_NRPN_CC_ENV_GEN_ATTACK = 393LL;
#line 223 "spms1_main.rb"
  cst_NRPN_CC_ENV_GEN_DECAY = 394LL;
#line 224 "spms1_main.rb"
  cst_NRPN_CC_ENV_GEN_SUSTAIN = 395LL;
#line 225 "spms1_main.rb"
  cst_NRPN_CC_LFO_RATE = 396LL;
#line 226 "spms1_main.rb"
  cst_NRPN_CC_MIXER_1_LEVEL_1 = 397LL;
#line 227 "spms1_main.rb"
  cst_NRPN_CC_MIXER_1_INVERT_1 = 398LL;
#line 228 "spms1_main.rb"
  cst_NRPN_CC_MIXER_1_LEVEL_2 = 399LL;
#line 229 "spms1_main.rb"
  cst_NRPN_CC_MIXER_1_INVERT_2 = 400LL;
#line 230 "spms1_main.rb"
  cst_NRPN_CC_MIXER_2_LEVEL_1 = 401LL;
#line 231 "spms1_main.rb"
  cst_NRPN_CC_MIXER_2_INVERT_1 = 402LL;
#line 232 "spms1_main.rb"
  cst_NRPN_CC_MIXER_2_LEVEL_2 = 403LL;
#line 233 "spms1_main.rb"
  cst_NRPN_CC_MIXER_2_INVERT_2 = 404LL;
#line 234 "spms1_main.rb"
  cst_NRPN_CC_MIXER_3_LEVEL_1 = 405LL;
#line 235 "spms1_main.rb"
  cst_NRPN_CC_MIXER_3_INVERT_1 = 406LL;
#line 236 "spms1_main.rb"
  cst_NRPN_CC_MIXER_3_LEVEL_2 = 407LL;
#line 237 "spms1_main.rb"
  cst_NRPN_CC_MIXER_3_INVERT_2 = 408LL;
#line 238 "spms1_main.rb"
  cst_NRPN_CC_MIXER_4_LEVEL_1 = 409LL;
#line 239 "spms1_main.rb"
  cst_NRPN_CC_MIXER_4_INVERT_1 = 410LL;
#line 240 "spms1_main.rb"
  cst_NRPN_CC_MIXER_4_LEVEL_2 = 411LL;
#line 241 "spms1_main.rb"
  cst_NRPN_CC_MIXER_4_INVERT_2 = 412LL;
#line 242 "spms1_main.rb"
  cst_NRPN_CC_MIXER_5_LEVEL_1 = 413LL;
#line 243 "spms1_main.rb"
  cst_NRPN_CC_MIXER_5_INVERT_1 = 414LL;
#line 244 "spms1_main.rb"
  cst_NRPN_CC_MIXER_5_LEVEL_2 = 415LL;
#line 245 "spms1_main.rb"
  cst_NRPN_CC_MIXER_5_INVERT_2 = 416LL;
#line 255 "spms1_main.rb"
#line 263 "spms1_main.rb"
#line 267 "spms1_main.rb"
  lv_lfo = sp_LFO_new(cst_SAMPLE_RATE);
#line 268 "spms1_main.rb"
  lv_env_gen = sp_EnvGen_new(cst_SAMPLE_RATE);
#line 269 "spms1_main.rb"
  lv_osc = sp_Osc_new(cst_SAMPLE_RATE);
#line 270 "spms1_main.rb"
  lv_filter = sp_Filter_new(cst_SAMPLE_RATE);
#line 271 "spms1_main.rb"
  lv_amp = sp_Amp_new(cst_SAMPLE_RATE);
#line 272 "spms1_main.rb"
  lv_mixer_1 = sp_Mixer_new(cst_SAMPLE_RATE);
#line 273 "spms1_main.rb"
  lv_mixer_2 = sp_Mixer_new(cst_SAMPLE_RATE);
#line 274 "spms1_main.rb"
  lv_mixer_3 = sp_Mixer_new(cst_SAMPLE_RATE);
#line 275 "spms1_main.rb"
  lv_mixer_4 = sp_Mixer_new(cst_SAMPLE_RATE);
#line 276 "spms1_main.rb"
  lv_mixer_5 = sp_Mixer_new(cst_SAMPLE_RATE);
#line 279 "spms1_main.rb"
  mrb_int _t59 = cst_MODULES_SIZE;
  if (_t59 < 0) sp_raise_cls("ArgumentError", "negative array size");
  mrb_int _t60 = cst_MODULE_NONE;
  sp_IntArray *_t61 = sp_IntArray_new();
  SP_GC_ROOT(_t61);
  for (mrb_int _t62 = 0; _t62 < _t59; _t62++) sp_IntArray_push(_t61, _t60);
  lv_active_modules = _t61;
#line 281 "spms1_main.rb"
  mrb_int _t64 = cst_AUDIO_BUFFER_WORDS;
  if (_t64 < 0) sp_raise_cls("ArgumentError", "negative array size");
  mrb_float _t65 = 0.0;
  sp_FloatArray *_t66 = sp_FloatArray_new();
  SP_GC_ROOT(_t66);
  for (mrb_int _t67 = 0; _t67 < _t64; _t67++) sp_FloatArray_push(_t66, _t65);
  lv_audio_buffer = _t66;
#line 286 "spms1_main.rb"
  mrb_int _t69 = cst_SIGNALS_SIZE;
  if (_t69 < 0) sp_raise_cls("ArgumentError", "negative array size");
  mrb_float _t70 = 0.0;
  sp_FloatArray *_t71 = sp_FloatArray_new();
  SP_GC_ROOT(_t71);
  for (mrb_int _t72 = 0; _t72 < _t69; _t72++) sp_FloatArray_push(_t71, _t70);
  lv_signals = _t71;
#line 287 "spms1_main.rb"
  sp_FloatArray_set(lv_signals, cst_SIGNAL_ONE, 1.0);
#line 288 "spms1_main.rb"
  sp_FloatArray_set(lv_signals, cst_SIGNAL_HALF, 0.5);
#line 289 "spms1_main.rb"
  sp_FloatArray_set(lv_signals, cst_SIGNAL_MINUS_HALF, -0.5);
#line 290 "spms1_main.rb"
  sp_FloatArray_set(lv_signals, cst_SIGNAL_MINUS_ONE, -1.0);
#line 298 "spms1_main.rb"
  sp_FloatArray_set(lv_signals, cst_SIGNAL_MIXER_1_LEVEL_1, sp_cc_to_ratio(28LL));
#line 299 "spms1_main.rb"
  sp_FloatArray_set(lv_signals, cst_SIGNAL_MIXER_1_INVERT_1, sp_cc_to_ratio(4LL));
#line 300 "spms1_main.rb"
  sp_FloatArray_set(lv_signals, cst_SIGNAL_MIXER_1_LEVEL_2, sp_cc_to_ratio(28LL));
#line 301 "spms1_main.rb"
  sp_FloatArray_set(lv_signals, cst_SIGNAL_MIXER_1_INVERT_2, sp_cc_to_ratio(4LL));
#line 302 "spms1_main.rb"
  sp_FloatArray_set(lv_signals, cst_SIGNAL_MIXER_2_LEVEL_1, sp_cc_to_ratio(124LL));
#line 303 "spms1_main.rb"
  sp_FloatArray_set(lv_signals, cst_SIGNAL_MIXER_2_INVERT_1, sp_cc_to_ratio(4LL));
#line 304 "spms1_main.rb"
  sp_FloatArray_set(lv_signals, cst_SIGNAL_MIXER_2_LEVEL_2, sp_cc_to_ratio(124LL));
#line 305 "spms1_main.rb"
  sp_FloatArray_set(lv_signals, cst_SIGNAL_MIXER_2_INVERT_2, sp_cc_to_ratio(4LL));
#line 306 "spms1_main.rb"
  sp_FloatArray_set(lv_signals, cst_SIGNAL_MIXER_3_LEVEL_1, sp_cc_to_ratio(124LL));
#line 307 "spms1_main.rb"
  sp_FloatArray_set(lv_signals, cst_SIGNAL_MIXER_3_INVERT_1, sp_cc_to_ratio(4LL));
#line 308 "spms1_main.rb"
  sp_FloatArray_set(lv_signals, cst_SIGNAL_MIXER_3_LEVEL_2, sp_cc_to_ratio(124LL));
#line 309 "spms1_main.rb"
  sp_FloatArray_set(lv_signals, cst_SIGNAL_MIXER_3_INVERT_2, sp_cc_to_ratio(4LL));
#line 310 "spms1_main.rb"
  sp_FloatArray_set(lv_signals, cst_SIGNAL_MIXER_4_LEVEL_1, sp_cc_to_ratio(124LL));
#line 311 "spms1_main.rb"
  sp_FloatArray_set(lv_signals, cst_SIGNAL_MIXER_4_INVERT_1, sp_cc_to_ratio(4LL));
#line 312 "spms1_main.rb"
  sp_FloatArray_set(lv_signals, cst_SIGNAL_MIXER_4_LEVEL_2, sp_cc_to_ratio(124LL));
#line 313 "spms1_main.rb"
  sp_FloatArray_set(lv_signals, cst_SIGNAL_MIXER_4_INVERT_2, sp_cc_to_ratio(4LL));
#line 314 "spms1_main.rb"
  sp_FloatArray_set(lv_signals, cst_SIGNAL_MIXER_5_LEVEL_1, sp_cc_to_ratio(124LL));
#line 315 "spms1_main.rb"
  sp_FloatArray_set(lv_signals, cst_SIGNAL_MIXER_5_INVERT_1, sp_cc_to_ratio(4LL));
#line 316 "spms1_main.rb"
  sp_FloatArray_set(lv_signals, cst_SIGNAL_MIXER_5_LEVEL_2, sp_cc_to_ratio(124LL));
#line 317 "spms1_main.rb"
  sp_FloatArray_set(lv_signals, cst_SIGNAL_MIXER_5_INVERT_2, sp_cc_to_ratio(4LL));
#line 325 "spms1_main.rb"
  (set_midi_nrpn_value(((uint8_t)(cst_MIDI_CH)), ((int32_t)(sp_int_add(cst_NRPN_ACTIVE_MODULE_BASE, 0LL))), ((uint8_t)(cst_MODULE_LFO))), (mrb_int)0);
#line 326 "spms1_main.rb"
  (set_midi_nrpn_value(((uint8_t)(cst_MIDI_CH)), ((int32_t)(sp_int_add(cst_NRPN_ACTIVE_MODULE_BASE, 1LL))), ((uint8_t)(cst_MODULE_MIXER_1))), (mrb_int)0);
#line 327 "spms1_main.rb"
  (set_midi_nrpn_value(((uint8_t)(cst_MIDI_CH)), ((int32_t)(sp_int_add(cst_NRPN_ACTIVE_MODULE_BASE, 2LL))), ((uint8_t)(cst_MODULE_ENV_GEN))), (mrb_int)0);
#line 328 "spms1_main.rb"
  (set_midi_nrpn_value(((uint8_t)(cst_MIDI_CH)), ((int32_t)(sp_int_add(cst_NRPN_ACTIVE_MODULE_BASE, 3LL))), ((uint8_t)(cst_MODULE_MIXER_2))), (mrb_int)0);
#line 329 "spms1_main.rb"
  (set_midi_nrpn_value(((uint8_t)(cst_MIDI_CH)), ((int32_t)(sp_int_add(cst_NRPN_ACTIVE_MODULE_BASE, 4LL))), ((uint8_t)(cst_MODULE_OSC))), (mrb_int)0);
#line 330 "spms1_main.rb"
  (set_midi_nrpn_value(((uint8_t)(cst_MIDI_CH)), ((int32_t)(sp_int_add(cst_NRPN_ACTIVE_MODULE_BASE, 5LL))), ((uint8_t)(cst_MODULE_MIXER_3))), (mrb_int)0);
#line 331 "spms1_main.rb"
  (set_midi_nrpn_value(((uint8_t)(cst_MIDI_CH)), ((int32_t)(sp_int_add(cst_NRPN_ACTIVE_MODULE_BASE, 6LL))), ((uint8_t)(cst_MODULE_FILTER))), (mrb_int)0);
#line 332 "spms1_main.rb"
  (set_midi_nrpn_value(((uint8_t)(cst_MIDI_CH)), ((int32_t)(sp_int_add(cst_NRPN_ACTIVE_MODULE_BASE, 7LL))), ((uint8_t)(cst_MODULE_MIXER_4))), (mrb_int)0);
#line 333 "spms1_main.rb"
  (set_midi_nrpn_value(((uint8_t)(cst_MIDI_CH)), ((int32_t)(sp_int_add(cst_NRPN_ACTIVE_MODULE_BASE, 8LL))), ((uint8_t)(cst_MODULE_AMP))), (mrb_int)0);
#line 334 "spms1_main.rb"
  (set_midi_nrpn_value(((uint8_t)(cst_MIDI_CH)), ((int32_t)(sp_int_add(cst_NRPN_ACTIVE_MODULE_BASE, 9LL))), ((uint8_t)(cst_MODULE_MIXER_5))), (mrb_int)0);
#line 336 "spms1_main.rb"
  (set_midi_nrpn_value(((uint8_t)(cst_MIDI_CH)), ((int32_t)(cst_NRPN_SOURCE_ENV_GEN_GATE)), ((uint8_t)(cst_SIGNAL_GATE))), (mrb_int)0);
#line 337 "spms1_main.rb"
  (set_midi_nrpn_value(((uint8_t)(cst_MIDI_CH)), ((int32_t)(cst_NRPN_SOURCE_OSC_PITCH)), ((uint8_t)(cst_SIGNAL_PITCH))), (mrb_int)0);
#line 338 "spms1_main.rb"
  (set_midi_nrpn_value(((uint8_t)(cst_MIDI_CH)), ((int32_t)(cst_NRPN_SOURCE_OSC_MOD)), ((uint8_t)(cst_SIGNAL_MIXER_1_OUTPUT))), (mrb_int)0);
#line 339 "spms1_main.rb"
  (set_midi_nrpn_value(((uint8_t)(cst_MIDI_CH)), ((int32_t)(cst_NRPN_SOURCE_FILTER_AUDIO)), ((uint8_t)(cst_SIGNAL_OSC_OUTPUT))), (mrb_int)0);
#line 340 "spms1_main.rb"
  (set_midi_nrpn_value(((uint8_t)(cst_MIDI_CH)), ((int32_t)(cst_NRPN_SOURCE_FILTER_MOD)), ((uint8_t)(cst_SIGNAL_ENV_GEN_OUTPUT))), (mrb_int)0);
#line 341 "spms1_main.rb"
  (set_midi_nrpn_value(((uint8_t)(cst_MIDI_CH)), ((int32_t)(cst_NRPN_SOURCE_AMP_AUDIO)), ((uint8_t)(cst_SIGNAL_FILTER_OUTPUT))), (mrb_int)0);
#line 342 "spms1_main.rb"
  (set_midi_nrpn_value(((uint8_t)(cst_MIDI_CH)), ((int32_t)(cst_NRPN_SOURCE_AMP_MOD)), ((uint8_t)(cst_SIGNAL_ENV_GEN_OUTPUT))), (mrb_int)0);
#line 343 "spms1_main.rb"
  (set_midi_nrpn_value(((uint8_t)(cst_MIDI_CH)), ((int32_t)(cst_NRPN_SOURCE_MIXER_1_IN_1)), ((uint8_t)(cst_SIGNAL_LFO_OUTPUT))), (mrb_int)0);
#line 344 "spms1_main.rb"
  (set_midi_nrpn_value(((uint8_t)(cst_MIDI_CH)), ((int32_t)(cst_NRPN_SOURCE_OUTPUT)), ((uint8_t)(cst_SIGNAL_AMP_OUTPUT))), (mrb_int)0);
#line 346 "spms1_main.rb"
  (set_midi_nrpn_value(((uint8_t)(cst_MIDI_CH)), ((int32_t)(cst_NRPN_SOURCE_OSC_WAVEFORM)), ((uint8_t)(cst_SIGNAL_OSC_WAVEFORM))), (mrb_int)0);
#line 347 "spms1_main.rb"
  (set_midi_nrpn_value(((uint8_t)(cst_MIDI_CH)), ((int32_t)(cst_NRPN_SOURCE_OSC_MOD_AMOUNT)), ((uint8_t)(cst_SIGNAL_OSC_MOD_AMOUNT))), (mrb_int)0);
#line 348 "spms1_main.rb"
  (set_midi_nrpn_value(((uint8_t)(cst_MIDI_CH)), ((int32_t)(cst_NRPN_SOURCE_OSC_COARSE_TUNE)), ((uint8_t)(cst_SIGNAL_OSC_COARSE_TUNE))), (mrb_int)0);
#line 349 "spms1_main.rb"
  (set_midi_nrpn_value(((uint8_t)(cst_MIDI_CH)), ((int32_t)(cst_NRPN_SOURCE_OSC_FINE_TUNE)), ((uint8_t)(cst_SIGNAL_OSC_FINE_TUNE))), (mrb_int)0);
#line 350 "spms1_main.rb"
  (set_midi_nrpn_value(((uint8_t)(cst_MIDI_CH)), ((int32_t)(cst_NRPN_SOURCE_FILTER_CUTOFF)), ((uint8_t)(cst_SIGNAL_FILTER_CUTOFF))), (mrb_int)0);
#line 351 "spms1_main.rb"
  (set_midi_nrpn_value(((uint8_t)(cst_MIDI_CH)), ((int32_t)(cst_NRPN_SOURCE_FILTER_RESONANCE)), ((uint8_t)(cst_SIGNAL_FILTER_RESONANCE))), (mrb_int)0);
#line 352 "spms1_main.rb"
  (set_midi_nrpn_value(((uint8_t)(cst_MIDI_CH)), ((int32_t)(cst_NRPN_SOURCE_FILTER_MOD_AMOUNT)), ((uint8_t)(cst_SIGNAL_FILTER_MOD_AMOUNT))), (mrb_int)0);
#line 353 "spms1_main.rb"
  (set_midi_nrpn_value(((uint8_t)(cst_MIDI_CH)), ((int32_t)(cst_NRPN_SOURCE_FILTER_GAIN)), ((uint8_t)(cst_SIGNAL_FILTER_GAIN))), (mrb_int)0);
#line 354 "spms1_main.rb"
  (set_midi_nrpn_value(((uint8_t)(cst_MIDI_CH)), ((int32_t)(cst_NRPN_SOURCE_AMP_GAIN)), ((uint8_t)(cst_SIGNAL_AMP_GAIN))), (mrb_int)0);
#line 355 "spms1_main.rb"
  (set_midi_nrpn_value(((uint8_t)(cst_MIDI_CH)), ((int32_t)(cst_NRPN_SOURCE_ENV_GEN_ATTACK)), ((uint8_t)(cst_SIGNAL_ENV_GEN_ATTACK))), (mrb_int)0);
#line 356 "spms1_main.rb"
  (set_midi_nrpn_value(((uint8_t)(cst_MIDI_CH)), ((int32_t)(cst_NRPN_SOURCE_ENV_GEN_DECAY)), ((uint8_t)(cst_SIGNAL_ENV_GEN_DECAY))), (mrb_int)0);
#line 357 "spms1_main.rb"
  (set_midi_nrpn_value(((uint8_t)(cst_MIDI_CH)), ((int32_t)(cst_NRPN_SOURCE_ENV_GEN_SUSTAIN)), ((uint8_t)(cst_SIGNAL_ENV_GEN_SUSTAIN))), (mrb_int)0);
#line 358 "spms1_main.rb"
  (set_midi_nrpn_value(((uint8_t)(cst_MIDI_CH)), ((int32_t)(cst_NRPN_SOURCE_LFO_RATE)), ((uint8_t)(cst_SIGNAL_LFO_RATE))), (mrb_int)0);
#line 359 "spms1_main.rb"
  (set_midi_nrpn_value(((uint8_t)(cst_MIDI_CH)), ((int32_t)(cst_NRPN_SOURCE_MIXER_1_LEVEL_1)), ((uint8_t)(cst_SIGNAL_MIXER_1_LEVEL_1))), (mrb_int)0);
#line 360 "spms1_main.rb"
  (set_midi_nrpn_value(((uint8_t)(cst_MIDI_CH)), ((int32_t)(cst_NRPN_SOURCE_MIXER_1_INVERT_1)), ((uint8_t)(cst_SIGNAL_MIXER_1_INVERT_1))), (mrb_int)0);
#line 361 "spms1_main.rb"
  (set_midi_nrpn_value(((uint8_t)(cst_MIDI_CH)), ((int32_t)(cst_NRPN_SOURCE_MIXER_1_LEVEL_2)), ((uint8_t)(cst_SIGNAL_MIXER_1_LEVEL_2))), (mrb_int)0);
#line 362 "spms1_main.rb"
  (set_midi_nrpn_value(((uint8_t)(cst_MIDI_CH)), ((int32_t)(cst_NRPN_SOURCE_MIXER_1_INVERT_2)), ((uint8_t)(cst_SIGNAL_MIXER_1_INVERT_2))), (mrb_int)0);
#line 363 "spms1_main.rb"
  (set_midi_nrpn_value(((uint8_t)(cst_MIDI_CH)), ((int32_t)(cst_NRPN_SOURCE_MIXER_2_LEVEL_1)), ((uint8_t)(cst_SIGNAL_MIXER_2_LEVEL_1))), (mrb_int)0);
#line 364 "spms1_main.rb"
  (set_midi_nrpn_value(((uint8_t)(cst_MIDI_CH)), ((int32_t)(cst_NRPN_SOURCE_MIXER_2_INVERT_1)), ((uint8_t)(cst_SIGNAL_MIXER_2_INVERT_1))), (mrb_int)0);
#line 365 "spms1_main.rb"
  (set_midi_nrpn_value(((uint8_t)(cst_MIDI_CH)), ((int32_t)(cst_NRPN_SOURCE_MIXER_2_LEVEL_2)), ((uint8_t)(cst_SIGNAL_MIXER_2_LEVEL_2))), (mrb_int)0);
#line 366 "spms1_main.rb"
  (set_midi_nrpn_value(((uint8_t)(cst_MIDI_CH)), ((int32_t)(cst_NRPN_SOURCE_MIXER_2_INVERT_2)), ((uint8_t)(cst_SIGNAL_MIXER_2_INVERT_2))), (mrb_int)0);
#line 367 "spms1_main.rb"
  (set_midi_nrpn_value(((uint8_t)(cst_MIDI_CH)), ((int32_t)(cst_NRPN_SOURCE_MIXER_3_LEVEL_1)), ((uint8_t)(cst_SIGNAL_MIXER_3_LEVEL_1))), (mrb_int)0);
#line 368 "spms1_main.rb"
  (set_midi_nrpn_value(((uint8_t)(cst_MIDI_CH)), ((int32_t)(cst_NRPN_SOURCE_MIXER_3_INVERT_1)), ((uint8_t)(cst_SIGNAL_MIXER_3_INVERT_1))), (mrb_int)0);
#line 369 "spms1_main.rb"
  (set_midi_nrpn_value(((uint8_t)(cst_MIDI_CH)), ((int32_t)(cst_NRPN_SOURCE_MIXER_3_LEVEL_2)), ((uint8_t)(cst_SIGNAL_MIXER_3_LEVEL_2))), (mrb_int)0);
#line 370 "spms1_main.rb"
  (set_midi_nrpn_value(((uint8_t)(cst_MIDI_CH)), ((int32_t)(cst_NRPN_SOURCE_MIXER_3_INVERT_2)), ((uint8_t)(cst_SIGNAL_MIXER_3_INVERT_2))), (mrb_int)0);
#line 371 "spms1_main.rb"
  (set_midi_nrpn_value(((uint8_t)(cst_MIDI_CH)), ((int32_t)(cst_NRPN_SOURCE_MIXER_4_LEVEL_1)), ((uint8_t)(cst_SIGNAL_MIXER_4_LEVEL_1))), (mrb_int)0);
#line 372 "spms1_main.rb"
  (set_midi_nrpn_value(((uint8_t)(cst_MIDI_CH)), ((int32_t)(cst_NRPN_SOURCE_MIXER_4_INVERT_1)), ((uint8_t)(cst_SIGNAL_MIXER_4_INVERT_1))), (mrb_int)0);
#line 373 "spms1_main.rb"
  (set_midi_nrpn_value(((uint8_t)(cst_MIDI_CH)), ((int32_t)(cst_NRPN_SOURCE_MIXER_4_LEVEL_2)), ((uint8_t)(cst_SIGNAL_MIXER_4_LEVEL_2))), (mrb_int)0);
#line 374 "spms1_main.rb"
  (set_midi_nrpn_value(((uint8_t)(cst_MIDI_CH)), ((int32_t)(cst_NRPN_SOURCE_MIXER_4_INVERT_2)), ((uint8_t)(cst_SIGNAL_MIXER_4_INVERT_2))), (mrb_int)0);
#line 375 "spms1_main.rb"
  (set_midi_nrpn_value(((uint8_t)(cst_MIDI_CH)), ((int32_t)(cst_NRPN_SOURCE_MIXER_5_LEVEL_1)), ((uint8_t)(cst_SIGNAL_MIXER_5_LEVEL_1))), (mrb_int)0);
#line 376 "spms1_main.rb"
  (set_midi_nrpn_value(((uint8_t)(cst_MIDI_CH)), ((int32_t)(cst_NRPN_SOURCE_MIXER_5_INVERT_1)), ((uint8_t)(cst_SIGNAL_MIXER_5_INVERT_1))), (mrb_int)0);
#line 377 "spms1_main.rb"
  (set_midi_nrpn_value(((uint8_t)(cst_MIDI_CH)), ((int32_t)(cst_NRPN_SOURCE_MIXER_5_LEVEL_2)), ((uint8_t)(cst_SIGNAL_MIXER_5_LEVEL_2))), (mrb_int)0);
#line 378 "spms1_main.rb"
  (set_midi_nrpn_value(((uint8_t)(cst_MIDI_CH)), ((int32_t)(cst_NRPN_SOURCE_MIXER_5_INVERT_2)), ((uint8_t)(cst_SIGNAL_MIXER_5_INVERT_2))), (mrb_int)0);
#line 380 "spms1_main.rb"
  (set_midi_nrpn_value(((uint8_t)(cst_MIDI_CH)), ((int32_t)(cst_NRPN_CC_OSC_WAVEFORM)), ((uint8_t)(20LL))), (mrb_int)0);
#line 381 "spms1_main.rb"
  (set_midi_nrpn_value(((uint8_t)(cst_MIDI_CH)), ((int32_t)(cst_NRPN_CC_OSC_MOD_AMOUNT)), ((uint8_t)(13LL))), (mrb_int)0);
#line 382 "spms1_main.rb"
  (set_midi_nrpn_value(((uint8_t)(cst_MIDI_CH)), ((int32_t)(cst_NRPN_CC_OSC_COARSE_TUNE)), ((uint8_t)(86LL))), (mrb_int)0);
#line 383 "spms1_main.rb"
  (set_midi_nrpn_value(((uint8_t)(cst_MIDI_CH)), ((int32_t)(cst_NRPN_CC_OSC_FINE_TUNE)), ((uint8_t)(70LL))), (mrb_int)0);
#line 384 "spms1_main.rb"
  (set_midi_nrpn_value(((uint8_t)(cst_MIDI_CH)), ((int32_t)(cst_NRPN_CC_FILTER_CUTOFF)), ((uint8_t)(74LL))), (mrb_int)0);
#line 385 "spms1_main.rb"
  (set_midi_nrpn_value(((uint8_t)(cst_MIDI_CH)), ((int32_t)(cst_NRPN_CC_FILTER_RESONANCE)), ((uint8_t)(71LL))), (mrb_int)0);
#line 386 "spms1_main.rb"
  (set_midi_nrpn_value(((uint8_t)(cst_MIDI_CH)), ((int32_t)(cst_NRPN_CC_FILTER_MOD_AMOUNT)), ((uint8_t)(24LL))), (mrb_int)0);
#line 387 "spms1_main.rb"
  (set_midi_nrpn_value(((uint8_t)(cst_MIDI_CH)), ((int32_t)(cst_NRPN_CC_FILTER_GAIN)), ((uint8_t)(112LL))), (mrb_int)0);
#line 388 "spms1_main.rb"
  (set_midi_nrpn_value(((uint8_t)(cst_MIDI_CH)), ((int32_t)(cst_NRPN_CC_AMP_GAIN)), ((uint8_t)(15LL))), (mrb_int)0);
#line 389 "spms1_main.rb"
  (set_midi_nrpn_value(((uint8_t)(cst_MIDI_CH)), ((int32_t)(cst_NRPN_CC_ENV_GEN_ATTACK)), ((uint8_t)(73LL))), (mrb_int)0);
#line 390 "spms1_main.rb"
  (set_midi_nrpn_value(((uint8_t)(cst_MIDI_CH)), ((int32_t)(cst_NRPN_CC_ENV_GEN_DECAY)), ((uint8_t)(75LL))), (mrb_int)0);
#line 391 "spms1_main.rb"
  (set_midi_nrpn_value(((uint8_t)(cst_MIDI_CH)), ((int32_t)(cst_NRPN_CC_ENV_GEN_SUSTAIN)), ((uint8_t)(30LL))), (mrb_int)0);
#line 392 "spms1_main.rb"
  (set_midi_nrpn_value(((uint8_t)(cst_MIDI_CH)), ((int32_t)(cst_NRPN_CC_LFO_RATE)), ((uint8_t)(3LL))), (mrb_int)0);
#line 394 "spms1_main.rb"
  (set_midi_cc_value(((uint8_t)(cst_MIDI_CH)), ((uint8_t)(20LL)), ((uint8_t)(4LL))), (mrb_int)0);
#line 395 "spms1_main.rb"
  (set_midi_cc_value(((uint8_t)(cst_MIDI_CH)), ((uint8_t)(13LL)), ((uint8_t)(4LL))), (mrb_int)0);
#line 396 "spms1_main.rb"
  (set_midi_cc_value(((uint8_t)(cst_MIDI_CH)), ((uint8_t)(86LL)), ((uint8_t)(64LL))), (mrb_int)0);
#line 397 "spms1_main.rb"
  (set_midi_cc_value(((uint8_t)(cst_MIDI_CH)), ((uint8_t)(70LL)), ((uint8_t)(64LL))), (mrb_int)0);
#line 398 "spms1_main.rb"
  (set_midi_cc_value(((uint8_t)(cst_MIDI_CH)), ((uint8_t)(74LL)), ((uint8_t)(124LL))), (mrb_int)0);
#line 399 "spms1_main.rb"
  (set_midi_cc_value(((uint8_t)(cst_MIDI_CH)), ((uint8_t)(71LL)), ((uint8_t)(64LL))), (mrb_int)0);
#line 400 "spms1_main.rb"
  (set_midi_cc_value(((uint8_t)(cst_MIDI_CH)), ((uint8_t)(24LL)), ((uint8_t)(64LL))), (mrb_int)0);
#line 401 "spms1_main.rb"
  (set_midi_cc_value(((uint8_t)(cst_MIDI_CH)), ((uint8_t)(112LL)), ((uint8_t)(64LL))), (mrb_int)0);
#line 402 "spms1_main.rb"
  (set_midi_cc_value(((uint8_t)(cst_MIDI_CH)), ((uint8_t)(15LL)), ((uint8_t)(64LL))), (mrb_int)0);
#line 403 "spms1_main.rb"
  (set_midi_cc_value(((uint8_t)(cst_MIDI_CH)), ((uint8_t)(73LL)), ((uint8_t)(4LL))), (mrb_int)0);
#line 404 "spms1_main.rb"
  (set_midi_cc_value(((uint8_t)(cst_MIDI_CH)), ((uint8_t)(75LL)), ((uint8_t)(94LL))), (mrb_int)0);
#line 405 "spms1_main.rb"
  (set_midi_cc_value(((uint8_t)(cst_MIDI_CH)), ((uint8_t)(30LL)), ((uint8_t)(4LL))), (mrb_int)0);
#line 406 "spms1_main.rb"
  (set_midi_cc_value(((uint8_t)(cst_MIDI_CH)), ((uint8_t)(3LL)), ((uint8_t)(64LL))), (mrb_int)0);
#line 408 "spms1_main.rb"
  (set_sample_rate(((int32_t)(cst_SAMPLE_RATE))), (mrb_int)0);
#line 409 "spms1_main.rb"
  (set_audio_buffers(((int32_t)(cst_AUDIO_BUFFERS))), (mrb_int)0);
#line 410 "spms1_main.rb"
  (set_audio_buffer_words(((int32_t)(cst_AUDIO_BUFFER_WORDS))), (mrb_int)0);
#line 411 "spms1_main.rb"
  (start_audio(), (mrb_int)0);
#line 413 "spms1_main.rb"
  int _gcb155 = sp_gc_nroots; (void)_gcb155;
  sp_exc_msg[sp_exc_top] = 0; sp_exc_obj[sp_exc_top] = 0; sp_exc_top++;
  if (setjmp(sp_exc_stack[sp_exc_top-1]) == 0) {
    for (;;) {
      lv_slot = SP_INT_NIL;
      lv_source_env_gen_gate = SP_INT_NIL;
      lv_source_osc_pitch = SP_INT_NIL;
      lv_source_osc_mod = SP_INT_NIL;
      lv_source_filter_audio = SP_INT_NIL;
      lv_source_filter_mod = SP_INT_NIL;
      lv_source_amp_audio = SP_INT_NIL;
      lv_source_amp_mod = SP_INT_NIL;
      lv_source_mixer_1_in_1 = SP_INT_NIL;
      lv_source_mixer_1_in_2 = SP_INT_NIL;
      lv_source_mixer_2_in_1 = SP_INT_NIL;
      lv_source_mixer_2_in_2 = SP_INT_NIL;
      lv_source_mixer_3_in_1 = SP_INT_NIL;
      lv_source_mixer_3_in_2 = SP_INT_NIL;
      lv_source_mixer_4_in_1 = SP_INT_NIL;
      lv_source_mixer_4_in_2 = SP_INT_NIL;
      lv_source_mixer_5_in_1 = SP_INT_NIL;
      lv_source_mixer_5_in_2 = SP_INT_NIL;
      lv_source_output = SP_INT_NIL;
      lv_source_osc_waveform = SP_INT_NIL;
      lv_source_osc_mod_amount = SP_INT_NIL;
      lv_source_osc_coarse_tune = SP_INT_NIL;
      lv_source_osc_fine_tune = SP_INT_NIL;
      lv_source_filter_cutoff = SP_INT_NIL;
      lv_source_filter_resonance = SP_INT_NIL;
      lv_source_filter_mod_amount = SP_INT_NIL;
      lv_source_filter_gain = SP_INT_NIL;
      lv_source_amp_gain = SP_INT_NIL;
      lv_source_env_gen_attack = SP_INT_NIL;
      lv_source_env_gen_decay = SP_INT_NIL;
      lv_source_env_gen_sustain = SP_INT_NIL;
      lv_source_lfo_rate = SP_INT_NIL;
      lv_source_mixer_1_level_1 = SP_INT_NIL;
      lv_source_mixer_1_invert_1 = SP_INT_NIL;
      lv_source_mixer_1_level_2 = SP_INT_NIL;
      lv_source_mixer_1_invert_2 = SP_INT_NIL;
      lv_source_mixer_2_level_1 = SP_INT_NIL;
      lv_source_mixer_2_invert_1 = SP_INT_NIL;
      lv_source_mixer_2_level_2 = SP_INT_NIL;
      lv_source_mixer_2_invert_2 = SP_INT_NIL;
      lv_source_mixer_3_level_1 = SP_INT_NIL;
      lv_source_mixer_3_invert_1 = SP_INT_NIL;
      lv_source_mixer_3_level_2 = SP_INT_NIL;
      lv_source_mixer_3_invert_2 = SP_INT_NIL;
      lv_source_mixer_4_level_1 = SP_INT_NIL;
      lv_source_mixer_4_invert_1 = SP_INT_NIL;
      lv_source_mixer_4_level_2 = SP_INT_NIL;
      lv_source_mixer_4_invert_2 = SP_INT_NIL;
      lv_source_mixer_5_level_1 = SP_INT_NIL;
      lv_source_mixer_5_invert_1 = SP_INT_NIL;
      lv_source_mixer_5_level_2 = SP_INT_NIL;
      lv_source_mixer_5_invert_2 = SP_INT_NIL;
      lv_cc_osc_waveform = SP_INT_NIL;
      lv_cc_osc_mod_amount = SP_INT_NIL;
      lv_cc_osc_coarse_tune = SP_INT_NIL;
      lv_cc_osc_fine_tune = SP_INT_NIL;
      lv_cc_filter_cutoff = SP_INT_NIL;
      lv_cc_filter_resonance = SP_INT_NIL;
      lv_cc_filter_mod_amount = SP_INT_NIL;
      lv_cc_filter_gain = SP_INT_NIL;
      lv_cc_amp_gain = SP_INT_NIL;
      lv_cc_env_gen_attack = SP_INT_NIL;
      lv_cc_env_gen_decay = SP_INT_NIL;
      lv_cc_env_gen_sustain = SP_INT_NIL;
      lv_cc_lfo_rate = SP_INT_NIL;
      lv_cc_mixer_1_level_1 = SP_INT_NIL;
      lv_cc_mixer_1_invert_1 = SP_INT_NIL;
      lv_cc_mixer_1_level_2 = SP_INT_NIL;
      lv_cc_mixer_1_invert_2 = SP_INT_NIL;
      lv_cc_mixer_2_level_1 = SP_INT_NIL;
      lv_cc_mixer_2_invert_1 = SP_INT_NIL;
      lv_cc_mixer_2_level_2 = SP_INT_NIL;
      lv_cc_mixer_2_invert_2 = SP_INT_NIL;
      lv_cc_mixer_3_level_1 = SP_INT_NIL;
      lv_cc_mixer_3_invert_1 = SP_INT_NIL;
      lv_cc_mixer_3_level_2 = SP_INT_NIL;
      lv_cc_mixer_3_invert_2 = SP_INT_NIL;
      lv_cc_mixer_4_level_1 = SP_INT_NIL;
      lv_cc_mixer_4_invert_1 = SP_INT_NIL;
      lv_cc_mixer_4_level_2 = SP_INT_NIL;
      lv_cc_mixer_4_invert_2 = SP_INT_NIL;
      lv_cc_mixer_5_level_1 = SP_INT_NIL;
      lv_cc_mixer_5_invert_1 = SP_INT_NIL;
      lv_cc_mixer_5_level_2 = SP_INT_NIL;
      lv_cc_mixer_5_invert_2 = SP_INT_NIL;
      lv_i = SP_INT_NIL;
      lv_module_id = SP_INT_NIL;
#line 414 "spms1_main.rb"
      (start_debug_measure(), (mrb_int)0);
#line 416 "spms1_main.rb"
      sp_FloatArray_set(lv_signals, cst_SIGNAL_PITCH, ((((mrb_float)(((mrb_int)(get_midi_note_on_pitch(((uint8_t)(cst_MIDI_CH))))))) * ((1.0 / 120.0))) - 0.5));
#line 417 "spms1_main.rb"
      sp_FloatArray_set(lv_signals, cst_SIGNAL_GATE, ((mrb_float)(((mrb_int)(get_midi_note_on_state(((uint8_t)(cst_MIDI_CH))))))));
#line 425 "spms1_main.rb"
      sp_FloatArray_set(lv_signals, cst_SIGNAL_BEND, (((mrb_float)((sp_idiv((sp_int_add(((mrb_int)(get_midi_pitch_bend(((uint8_t)(cst_MIDI_CH))))), 1LL)), 2LL)))) * ((1.0 / 8192.0))));
#line 429 "spms1_main.rb"
      lv_slot = 0LL;
#line 430 "spms1_main.rb"
      while ((lv_slot < cst_MODULES_SIZE)) {
#line 431 "spms1_main.rb"
        sp_IntArray_set(lv_active_modules, lv_slot, ((mrb_int)(get_midi_nrpn_value(((uint8_t)(cst_MIDI_CH)), ((int32_t)(sp_int_add(cst_NRPN_ACTIVE_MODULE_BASE, lv_slot)))))));
#line 432 "spms1_main.rb"
        lv_slot = sp_int_add(lv_slot, 1LL);
      }
#line 435 "spms1_main.rb"
      lv_source_env_gen_gate = ((mrb_int)(get_midi_nrpn_value(((uint8_t)(cst_MIDI_CH)), ((int32_t)(cst_NRPN_SOURCE_ENV_GEN_GATE)))));
#line 436 "spms1_main.rb"
      lv_source_osc_pitch = ((mrb_int)(get_midi_nrpn_value(((uint8_t)(cst_MIDI_CH)), ((int32_t)(cst_NRPN_SOURCE_OSC_PITCH)))));
#line 437 "spms1_main.rb"
      lv_source_osc_mod = ((mrb_int)(get_midi_nrpn_value(((uint8_t)(cst_MIDI_CH)), ((int32_t)(cst_NRPN_SOURCE_OSC_MOD)))));
#line 438 "spms1_main.rb"
      lv_source_filter_audio = ((mrb_int)(get_midi_nrpn_value(((uint8_t)(cst_MIDI_CH)), ((int32_t)(cst_NRPN_SOURCE_FILTER_AUDIO)))));
#line 439 "spms1_main.rb"
      lv_source_filter_mod = ((mrb_int)(get_midi_nrpn_value(((uint8_t)(cst_MIDI_CH)), ((int32_t)(cst_NRPN_SOURCE_FILTER_MOD)))));
#line 440 "spms1_main.rb"
      lv_source_amp_audio = ((mrb_int)(get_midi_nrpn_value(((uint8_t)(cst_MIDI_CH)), ((int32_t)(cst_NRPN_SOURCE_AMP_AUDIO)))));
#line 441 "spms1_main.rb"
      lv_source_amp_mod = ((mrb_int)(get_midi_nrpn_value(((uint8_t)(cst_MIDI_CH)), ((int32_t)(cst_NRPN_SOURCE_AMP_MOD)))));
#line 442 "spms1_main.rb"
      lv_source_mixer_1_in_1 = ((mrb_int)(get_midi_nrpn_value(((uint8_t)(cst_MIDI_CH)), ((int32_t)(cst_NRPN_SOURCE_MIXER_1_IN_1)))));
#line 443 "spms1_main.rb"
      lv_source_mixer_1_in_2 = ((mrb_int)(get_midi_nrpn_value(((uint8_t)(cst_MIDI_CH)), ((int32_t)(cst_NRPN_SOURCE_MIXER_1_IN_2)))));
#line 444 "spms1_main.rb"
      lv_source_mixer_2_in_1 = ((mrb_int)(get_midi_nrpn_value(((uint8_t)(cst_MIDI_CH)), ((int32_t)(cst_NRPN_SOURCE_MIXER_2_IN_1)))));
#line 445 "spms1_main.rb"
      lv_source_mixer_2_in_2 = ((mrb_int)(get_midi_nrpn_value(((uint8_t)(cst_MIDI_CH)), ((int32_t)(cst_NRPN_SOURCE_MIXER_2_IN_2)))));
#line 446 "spms1_main.rb"
      lv_source_mixer_3_in_1 = ((mrb_int)(get_midi_nrpn_value(((uint8_t)(cst_MIDI_CH)), ((int32_t)(cst_NRPN_SOURCE_MIXER_3_IN_1)))));
#line 447 "spms1_main.rb"
      lv_source_mixer_3_in_2 = ((mrb_int)(get_midi_nrpn_value(((uint8_t)(cst_MIDI_CH)), ((int32_t)(cst_NRPN_SOURCE_MIXER_3_IN_2)))));
#line 448 "spms1_main.rb"
      lv_source_mixer_4_in_1 = ((mrb_int)(get_midi_nrpn_value(((uint8_t)(cst_MIDI_CH)), ((int32_t)(cst_NRPN_SOURCE_MIXER_4_IN_1)))));
#line 449 "spms1_main.rb"
      lv_source_mixer_4_in_2 = ((mrb_int)(get_midi_nrpn_value(((uint8_t)(cst_MIDI_CH)), ((int32_t)(cst_NRPN_SOURCE_MIXER_4_IN_2)))));
#line 450 "spms1_main.rb"
      lv_source_mixer_5_in_1 = ((mrb_int)(get_midi_nrpn_value(((uint8_t)(cst_MIDI_CH)), ((int32_t)(cst_NRPN_SOURCE_MIXER_5_IN_1)))));
#line 451 "spms1_main.rb"
      lv_source_mixer_5_in_2 = ((mrb_int)(get_midi_nrpn_value(((uint8_t)(cst_MIDI_CH)), ((int32_t)(cst_NRPN_SOURCE_MIXER_5_IN_2)))));
#line 452 "spms1_main.rb"
      lv_source_output = ((mrb_int)(get_midi_nrpn_value(((uint8_t)(cst_MIDI_CH)), ((int32_t)(cst_NRPN_SOURCE_OUTPUT)))));
#line 458 "spms1_main.rb"
      lv_source_osc_waveform = ((mrb_int)(get_midi_nrpn_value(((uint8_t)(cst_MIDI_CH)), ((int32_t)(cst_NRPN_SOURCE_OSC_WAVEFORM)))));
#line 459 "spms1_main.rb"
      lv_source_osc_mod_amount = ((mrb_int)(get_midi_nrpn_value(((uint8_t)(cst_MIDI_CH)), ((int32_t)(cst_NRPN_SOURCE_OSC_MOD_AMOUNT)))));
#line 460 "spms1_main.rb"
      lv_source_osc_coarse_tune = ((mrb_int)(get_midi_nrpn_value(((uint8_t)(cst_MIDI_CH)), ((int32_t)(cst_NRPN_SOURCE_OSC_COARSE_TUNE)))));
#line 461 "spms1_main.rb"
      lv_source_osc_fine_tune = ((mrb_int)(get_midi_nrpn_value(((uint8_t)(cst_MIDI_CH)), ((int32_t)(cst_NRPN_SOURCE_OSC_FINE_TUNE)))));
#line 462 "spms1_main.rb"
      lv_source_filter_cutoff = ((mrb_int)(get_midi_nrpn_value(((uint8_t)(cst_MIDI_CH)), ((int32_t)(cst_NRPN_SOURCE_FILTER_CUTOFF)))));
#line 463 "spms1_main.rb"
      lv_source_filter_resonance = ((mrb_int)(get_midi_nrpn_value(((uint8_t)(cst_MIDI_CH)), ((int32_t)(cst_NRPN_SOURCE_FILTER_RESONANCE)))));
#line 464 "spms1_main.rb"
      lv_source_filter_mod_amount = ((mrb_int)(get_midi_nrpn_value(((uint8_t)(cst_MIDI_CH)), ((int32_t)(cst_NRPN_SOURCE_FILTER_MOD_AMOUNT)))));
#line 465 "spms1_main.rb"
      lv_source_filter_gain = ((mrb_int)(get_midi_nrpn_value(((uint8_t)(cst_MIDI_CH)), ((int32_t)(cst_NRPN_SOURCE_FILTER_GAIN)))));
#line 466 "spms1_main.rb"
      lv_source_amp_gain = ((mrb_int)(get_midi_nrpn_value(((uint8_t)(cst_MIDI_CH)), ((int32_t)(cst_NRPN_SOURCE_AMP_GAIN)))));
#line 467 "spms1_main.rb"
      lv_source_env_gen_attack = ((mrb_int)(get_midi_nrpn_value(((uint8_t)(cst_MIDI_CH)), ((int32_t)(cst_NRPN_SOURCE_ENV_GEN_ATTACK)))));
#line 468 "spms1_main.rb"
      lv_source_env_gen_decay = ((mrb_int)(get_midi_nrpn_value(((uint8_t)(cst_MIDI_CH)), ((int32_t)(cst_NRPN_SOURCE_ENV_GEN_DECAY)))));
#line 469 "spms1_main.rb"
      lv_source_env_gen_sustain = ((mrb_int)(get_midi_nrpn_value(((uint8_t)(cst_MIDI_CH)), ((int32_t)(cst_NRPN_SOURCE_ENV_GEN_SUSTAIN)))));
#line 470 "spms1_main.rb"
      lv_source_lfo_rate = ((mrb_int)(get_midi_nrpn_value(((uint8_t)(cst_MIDI_CH)), ((int32_t)(cst_NRPN_SOURCE_LFO_RATE)))));
#line 471 "spms1_main.rb"
      lv_source_mixer_1_level_1 = ((mrb_int)(get_midi_nrpn_value(((uint8_t)(cst_MIDI_CH)), ((int32_t)(cst_NRPN_SOURCE_MIXER_1_LEVEL_1)))));
#line 472 "spms1_main.rb"
      lv_source_mixer_1_invert_1 = ((mrb_int)(get_midi_nrpn_value(((uint8_t)(cst_MIDI_CH)), ((int32_t)(cst_NRPN_SOURCE_MIXER_1_INVERT_1)))));
#line 473 "spms1_main.rb"
      lv_source_mixer_1_level_2 = ((mrb_int)(get_midi_nrpn_value(((uint8_t)(cst_MIDI_CH)), ((int32_t)(cst_NRPN_SOURCE_MIXER_1_LEVEL_2)))));
#line 474 "spms1_main.rb"
      lv_source_mixer_1_invert_2 = ((mrb_int)(get_midi_nrpn_value(((uint8_t)(cst_MIDI_CH)), ((int32_t)(cst_NRPN_SOURCE_MIXER_1_INVERT_2)))));
#line 475 "spms1_main.rb"
      lv_source_mixer_2_level_1 = ((mrb_int)(get_midi_nrpn_value(((uint8_t)(cst_MIDI_CH)), ((int32_t)(cst_NRPN_SOURCE_MIXER_2_LEVEL_1)))));
#line 476 "spms1_main.rb"
      lv_source_mixer_2_invert_1 = ((mrb_int)(get_midi_nrpn_value(((uint8_t)(cst_MIDI_CH)), ((int32_t)(cst_NRPN_SOURCE_MIXER_2_INVERT_1)))));
#line 477 "spms1_main.rb"
      lv_source_mixer_2_level_2 = ((mrb_int)(get_midi_nrpn_value(((uint8_t)(cst_MIDI_CH)), ((int32_t)(cst_NRPN_SOURCE_MIXER_2_LEVEL_2)))));
#line 478 "spms1_main.rb"
      lv_source_mixer_2_invert_2 = ((mrb_int)(get_midi_nrpn_value(((uint8_t)(cst_MIDI_CH)), ((int32_t)(cst_NRPN_SOURCE_MIXER_2_INVERT_2)))));
#line 479 "spms1_main.rb"
      lv_source_mixer_3_level_1 = ((mrb_int)(get_midi_nrpn_value(((uint8_t)(cst_MIDI_CH)), ((int32_t)(cst_NRPN_SOURCE_MIXER_3_LEVEL_1)))));
#line 480 "spms1_main.rb"
      lv_source_mixer_3_invert_1 = ((mrb_int)(get_midi_nrpn_value(((uint8_t)(cst_MIDI_CH)), ((int32_t)(cst_NRPN_SOURCE_MIXER_3_INVERT_1)))));
#line 481 "spms1_main.rb"
      lv_source_mixer_3_level_2 = ((mrb_int)(get_midi_nrpn_value(((uint8_t)(cst_MIDI_CH)), ((int32_t)(cst_NRPN_SOURCE_MIXER_3_LEVEL_2)))));
#line 482 "spms1_main.rb"
      lv_source_mixer_3_invert_2 = ((mrb_int)(get_midi_nrpn_value(((uint8_t)(cst_MIDI_CH)), ((int32_t)(cst_NRPN_SOURCE_MIXER_3_INVERT_2)))));
#line 483 "spms1_main.rb"
      lv_source_mixer_4_level_1 = ((mrb_int)(get_midi_nrpn_value(((uint8_t)(cst_MIDI_CH)), ((int32_t)(cst_NRPN_SOURCE_MIXER_4_LEVEL_1)))));
#line 484 "spms1_main.rb"
      lv_source_mixer_4_invert_1 = ((mrb_int)(get_midi_nrpn_value(((uint8_t)(cst_MIDI_CH)), ((int32_t)(cst_NRPN_SOURCE_MIXER_4_INVERT_1)))));
#line 485 "spms1_main.rb"
      lv_source_mixer_4_level_2 = ((mrb_int)(get_midi_nrpn_value(((uint8_t)(cst_MIDI_CH)), ((int32_t)(cst_NRPN_SOURCE_MIXER_4_LEVEL_2)))));
#line 486 "spms1_main.rb"
      lv_source_mixer_4_invert_2 = ((mrb_int)(get_midi_nrpn_value(((uint8_t)(cst_MIDI_CH)), ((int32_t)(cst_NRPN_SOURCE_MIXER_4_INVERT_2)))));
#line 487 "spms1_main.rb"
      lv_source_mixer_5_level_1 = ((mrb_int)(get_midi_nrpn_value(((uint8_t)(cst_MIDI_CH)), ((int32_t)(cst_NRPN_SOURCE_MIXER_5_LEVEL_1)))));
#line 488 "spms1_main.rb"
      lv_source_mixer_5_invert_1 = ((mrb_int)(get_midi_nrpn_value(((uint8_t)(cst_MIDI_CH)), ((int32_t)(cst_NRPN_SOURCE_MIXER_5_INVERT_1)))));
#line 489 "spms1_main.rb"
      lv_source_mixer_5_level_2 = ((mrb_int)(get_midi_nrpn_value(((uint8_t)(cst_MIDI_CH)), ((int32_t)(cst_NRPN_SOURCE_MIXER_5_LEVEL_2)))));
#line 490 "spms1_main.rb"
      lv_source_mixer_5_invert_2 = ((mrb_int)(get_midi_nrpn_value(((uint8_t)(cst_MIDI_CH)), ((int32_t)(cst_NRPN_SOURCE_MIXER_5_INVERT_2)))));
#line 494 "spms1_main.rb"
      lv_cc_osc_waveform = ((mrb_int)(get_midi_nrpn_value(((uint8_t)(cst_MIDI_CH)), ((int32_t)(cst_NRPN_CC_OSC_WAVEFORM)))));
#line 495 "spms1_main.rb"
      lv_cc_osc_mod_amount = ((mrb_int)(get_midi_nrpn_value(((uint8_t)(cst_MIDI_CH)), ((int32_t)(cst_NRPN_CC_OSC_MOD_AMOUNT)))));
#line 496 "spms1_main.rb"
      lv_cc_osc_coarse_tune = ((mrb_int)(get_midi_nrpn_value(((uint8_t)(cst_MIDI_CH)), ((int32_t)(cst_NRPN_CC_OSC_COARSE_TUNE)))));
#line 497 "spms1_main.rb"
      lv_cc_osc_fine_tune = ((mrb_int)(get_midi_nrpn_value(((uint8_t)(cst_MIDI_CH)), ((int32_t)(cst_NRPN_CC_OSC_FINE_TUNE)))));
#line 498 "spms1_main.rb"
      lv_cc_filter_cutoff = ((mrb_int)(get_midi_nrpn_value(((uint8_t)(cst_MIDI_CH)), ((int32_t)(cst_NRPN_CC_FILTER_CUTOFF)))));
#line 499 "spms1_main.rb"
      lv_cc_filter_resonance = ((mrb_int)(get_midi_nrpn_value(((uint8_t)(cst_MIDI_CH)), ((int32_t)(cst_NRPN_CC_FILTER_RESONANCE)))));
#line 500 "spms1_main.rb"
      lv_cc_filter_mod_amount = ((mrb_int)(get_midi_nrpn_value(((uint8_t)(cst_MIDI_CH)), ((int32_t)(cst_NRPN_CC_FILTER_MOD_AMOUNT)))));
#line 501 "spms1_main.rb"
      lv_cc_filter_gain = ((mrb_int)(get_midi_nrpn_value(((uint8_t)(cst_MIDI_CH)), ((int32_t)(cst_NRPN_CC_FILTER_GAIN)))));
#line 502 "spms1_main.rb"
      lv_cc_amp_gain = ((mrb_int)(get_midi_nrpn_value(((uint8_t)(cst_MIDI_CH)), ((int32_t)(cst_NRPN_CC_AMP_GAIN)))));
#line 503 "spms1_main.rb"
      lv_cc_env_gen_attack = ((mrb_int)(get_midi_nrpn_value(((uint8_t)(cst_MIDI_CH)), ((int32_t)(cst_NRPN_CC_ENV_GEN_ATTACK)))));
#line 504 "spms1_main.rb"
      lv_cc_env_gen_decay = ((mrb_int)(get_midi_nrpn_value(((uint8_t)(cst_MIDI_CH)), ((int32_t)(cst_NRPN_CC_ENV_GEN_DECAY)))));
#line 505 "spms1_main.rb"
      lv_cc_env_gen_sustain = ((mrb_int)(get_midi_nrpn_value(((uint8_t)(cst_MIDI_CH)), ((int32_t)(cst_NRPN_CC_ENV_GEN_SUSTAIN)))));
#line 506 "spms1_main.rb"
      lv_cc_lfo_rate = ((mrb_int)(get_midi_nrpn_value(((uint8_t)(cst_MIDI_CH)), ((int32_t)(cst_NRPN_CC_LFO_RATE)))));
#line 507 "spms1_main.rb"
      lv_cc_mixer_1_level_1 = ((mrb_int)(get_midi_nrpn_value(((uint8_t)(cst_MIDI_CH)), ((int32_t)(cst_NRPN_CC_MIXER_1_LEVEL_1)))));
#line 508 "spms1_main.rb"
      lv_cc_mixer_1_invert_1 = ((mrb_int)(get_midi_nrpn_value(((uint8_t)(cst_MIDI_CH)), ((int32_t)(cst_NRPN_CC_MIXER_1_INVERT_1)))));
#line 509 "spms1_main.rb"
      lv_cc_mixer_1_level_2 = ((mrb_int)(get_midi_nrpn_value(((uint8_t)(cst_MIDI_CH)), ((int32_t)(cst_NRPN_CC_MIXER_1_LEVEL_2)))));
#line 510 "spms1_main.rb"
      lv_cc_mixer_1_invert_2 = ((mrb_int)(get_midi_nrpn_value(((uint8_t)(cst_MIDI_CH)), ((int32_t)(cst_NRPN_CC_MIXER_1_INVERT_2)))));
#line 511 "spms1_main.rb"
      lv_cc_mixer_2_level_1 = ((mrb_int)(get_midi_nrpn_value(((uint8_t)(cst_MIDI_CH)), ((int32_t)(cst_NRPN_CC_MIXER_2_LEVEL_1)))));
#line 512 "spms1_main.rb"
      lv_cc_mixer_2_invert_1 = ((mrb_int)(get_midi_nrpn_value(((uint8_t)(cst_MIDI_CH)), ((int32_t)(cst_NRPN_CC_MIXER_2_INVERT_1)))));
#line 513 "spms1_main.rb"
      lv_cc_mixer_2_level_2 = ((mrb_int)(get_midi_nrpn_value(((uint8_t)(cst_MIDI_CH)), ((int32_t)(cst_NRPN_CC_MIXER_2_LEVEL_2)))));
#line 514 "spms1_main.rb"
      lv_cc_mixer_2_invert_2 = ((mrb_int)(get_midi_nrpn_value(((uint8_t)(cst_MIDI_CH)), ((int32_t)(cst_NRPN_CC_MIXER_2_INVERT_2)))));
#line 515 "spms1_main.rb"
      lv_cc_mixer_3_level_1 = ((mrb_int)(get_midi_nrpn_value(((uint8_t)(cst_MIDI_CH)), ((int32_t)(cst_NRPN_CC_MIXER_3_LEVEL_1)))));
#line 516 "spms1_main.rb"
      lv_cc_mixer_3_invert_1 = ((mrb_int)(get_midi_nrpn_value(((uint8_t)(cst_MIDI_CH)), ((int32_t)(cst_NRPN_CC_MIXER_3_INVERT_1)))));
#line 517 "spms1_main.rb"
      lv_cc_mixer_3_level_2 = ((mrb_int)(get_midi_nrpn_value(((uint8_t)(cst_MIDI_CH)), ((int32_t)(cst_NRPN_CC_MIXER_3_LEVEL_2)))));
#line 518 "spms1_main.rb"
      lv_cc_mixer_3_invert_2 = ((mrb_int)(get_midi_nrpn_value(((uint8_t)(cst_MIDI_CH)), ((int32_t)(cst_NRPN_CC_MIXER_3_INVERT_2)))));
#line 519 "spms1_main.rb"
      lv_cc_mixer_4_level_1 = ((mrb_int)(get_midi_nrpn_value(((uint8_t)(cst_MIDI_CH)), ((int32_t)(cst_NRPN_CC_MIXER_4_LEVEL_1)))));
#line 520 "spms1_main.rb"
      lv_cc_mixer_4_invert_1 = ((mrb_int)(get_midi_nrpn_value(((uint8_t)(cst_MIDI_CH)), ((int32_t)(cst_NRPN_CC_MIXER_4_INVERT_1)))));
#line 521 "spms1_main.rb"
      lv_cc_mixer_4_level_2 = ((mrb_int)(get_midi_nrpn_value(((uint8_t)(cst_MIDI_CH)), ((int32_t)(cst_NRPN_CC_MIXER_4_LEVEL_2)))));
#line 522 "spms1_main.rb"
      lv_cc_mixer_4_invert_2 = ((mrb_int)(get_midi_nrpn_value(((uint8_t)(cst_MIDI_CH)), ((int32_t)(cst_NRPN_CC_MIXER_4_INVERT_2)))));
#line 523 "spms1_main.rb"
      lv_cc_mixer_5_level_1 = ((mrb_int)(get_midi_nrpn_value(((uint8_t)(cst_MIDI_CH)), ((int32_t)(cst_NRPN_CC_MIXER_5_LEVEL_1)))));
#line 524 "spms1_main.rb"
      lv_cc_mixer_5_invert_1 = ((mrb_int)(get_midi_nrpn_value(((uint8_t)(cst_MIDI_CH)), ((int32_t)(cst_NRPN_CC_MIXER_5_INVERT_1)))));
#line 525 "spms1_main.rb"
      lv_cc_mixer_5_level_2 = ((mrb_int)(get_midi_nrpn_value(((uint8_t)(cst_MIDI_CH)), ((int32_t)(cst_NRPN_CC_MIXER_5_LEVEL_2)))));
#line 526 "spms1_main.rb"
      lv_cc_mixer_5_invert_2 = ((mrb_int)(get_midi_nrpn_value(((uint8_t)(cst_MIDI_CH)), ((int32_t)(cst_NRPN_CC_MIXER_5_INVERT_2)))));
#line 528 "spms1_main.rb"
      sp_FloatArray_set(lv_signals, sp_cc_slot(lv_cc_osc_waveform, cst_SIGNAL_OSC_WAVEFORM), sp_cc_to_ratio(((mrb_int)(get_midi_cc_value(((uint8_t)(cst_MIDI_CH)), ((uint8_t)(lv_cc_osc_waveform)))))));
#line 529 "spms1_main.rb"
      sp_FloatArray_set(lv_signals, sp_cc_slot(lv_cc_osc_mod_amount, cst_SIGNAL_OSC_MOD_AMOUNT), sp_cc_to_ratio(((mrb_int)(get_midi_cc_value(((uint8_t)(cst_MIDI_CH)), ((uint8_t)(lv_cc_osc_mod_amount)))))));
#line 530 "spms1_main.rb"
      sp_FloatArray_set(lv_signals, sp_cc_slot(lv_cc_osc_coarse_tune, cst_SIGNAL_OSC_COARSE_TUNE), sp_cc_to_ratio(((mrb_int)(get_midi_cc_value(((uint8_t)(cst_MIDI_CH)), ((uint8_t)(lv_cc_osc_coarse_tune)))))));
#line 531 "spms1_main.rb"
      sp_FloatArray_set(lv_signals, sp_cc_slot(lv_cc_osc_fine_tune, cst_SIGNAL_OSC_FINE_TUNE), sp_cc_to_ratio(((mrb_int)(get_midi_cc_value(((uint8_t)(cst_MIDI_CH)), ((uint8_t)(lv_cc_osc_fine_tune)))))));
#line 532 "spms1_main.rb"
      sp_FloatArray_set(lv_signals, sp_cc_slot(lv_cc_filter_cutoff, cst_SIGNAL_FILTER_CUTOFF), sp_cc_to_ratio(((mrb_int)(get_midi_cc_value(((uint8_t)(cst_MIDI_CH)), ((uint8_t)(lv_cc_filter_cutoff)))))));
#line 533 "spms1_main.rb"
      sp_FloatArray_set(lv_signals, sp_cc_slot(lv_cc_filter_resonance, cst_SIGNAL_FILTER_RESONANCE), sp_cc_to_ratio(((mrb_int)(get_midi_cc_value(((uint8_t)(cst_MIDI_CH)), ((uint8_t)(lv_cc_filter_resonance)))))));
#line 534 "spms1_main.rb"
      sp_FloatArray_set(lv_signals, sp_cc_slot(lv_cc_filter_mod_amount, cst_SIGNAL_FILTER_MOD_AMOUNT), sp_cc_to_ratio(((mrb_int)(get_midi_cc_value(((uint8_t)(cst_MIDI_CH)), ((uint8_t)(lv_cc_filter_mod_amount)))))));
#line 535 "spms1_main.rb"
      sp_FloatArray_set(lv_signals, sp_cc_slot(lv_cc_filter_gain, cst_SIGNAL_FILTER_GAIN), sp_cc_to_ratio(((mrb_int)(get_midi_cc_value(((uint8_t)(cst_MIDI_CH)), ((uint8_t)(lv_cc_filter_gain)))))));
#line 536 "spms1_main.rb"
      sp_FloatArray_set(lv_signals, sp_cc_slot(lv_cc_amp_gain, cst_SIGNAL_AMP_GAIN), sp_cc_to_ratio(((mrb_int)(get_midi_cc_value(((uint8_t)(cst_MIDI_CH)), ((uint8_t)(lv_cc_amp_gain)))))));
#line 537 "spms1_main.rb"
      sp_FloatArray_set(lv_signals, sp_cc_slot(lv_cc_env_gen_attack, cst_SIGNAL_ENV_GEN_ATTACK), sp_cc_to_ratio(((mrb_int)(get_midi_cc_value(((uint8_t)(cst_MIDI_CH)), ((uint8_t)(lv_cc_env_gen_attack)))))));
#line 538 "spms1_main.rb"
      sp_FloatArray_set(lv_signals, sp_cc_slot(lv_cc_env_gen_decay, cst_SIGNAL_ENV_GEN_DECAY), sp_cc_to_ratio(((mrb_int)(get_midi_cc_value(((uint8_t)(cst_MIDI_CH)), ((uint8_t)(lv_cc_env_gen_decay)))))));
#line 539 "spms1_main.rb"
      sp_FloatArray_set(lv_signals, sp_cc_slot(lv_cc_env_gen_sustain, cst_SIGNAL_ENV_GEN_SUSTAIN), sp_cc_to_ratio(((mrb_int)(get_midi_cc_value(((uint8_t)(cst_MIDI_CH)), ((uint8_t)(lv_cc_env_gen_sustain)))))));
#line 540 "spms1_main.rb"
      sp_FloatArray_set(lv_signals, sp_cc_slot(lv_cc_lfo_rate, cst_SIGNAL_LFO_RATE), sp_cc_to_ratio(((mrb_int)(get_midi_cc_value(((uint8_t)(cst_MIDI_CH)), ((uint8_t)(lv_cc_lfo_rate)))))));
#line 541 "spms1_main.rb"
      sp_FloatArray_set(lv_signals, sp_cc_slot(lv_cc_mixer_1_level_1, cst_SIGNAL_MIXER_1_LEVEL_1), sp_cc_to_ratio(((mrb_int)(get_midi_cc_value(((uint8_t)(cst_MIDI_CH)), ((uint8_t)(lv_cc_mixer_1_level_1)))))));
#line 542 "spms1_main.rb"
      sp_FloatArray_set(lv_signals, sp_cc_slot(lv_cc_mixer_1_invert_1, cst_SIGNAL_MIXER_1_INVERT_1), sp_cc_to_ratio(((mrb_int)(get_midi_cc_value(((uint8_t)(cst_MIDI_CH)), ((uint8_t)(lv_cc_mixer_1_invert_1)))))));
#line 543 "spms1_main.rb"
      sp_FloatArray_set(lv_signals, sp_cc_slot(lv_cc_mixer_1_level_2, cst_SIGNAL_MIXER_1_LEVEL_2), sp_cc_to_ratio(((mrb_int)(get_midi_cc_value(((uint8_t)(cst_MIDI_CH)), ((uint8_t)(lv_cc_mixer_1_level_2)))))));
#line 544 "spms1_main.rb"
      sp_FloatArray_set(lv_signals, sp_cc_slot(lv_cc_mixer_1_invert_2, cst_SIGNAL_MIXER_1_INVERT_2), sp_cc_to_ratio(((mrb_int)(get_midi_cc_value(((uint8_t)(cst_MIDI_CH)), ((uint8_t)(lv_cc_mixer_1_invert_2)))))));
#line 545 "spms1_main.rb"
      sp_FloatArray_set(lv_signals, sp_cc_slot(lv_cc_mixer_2_level_1, cst_SIGNAL_MIXER_2_LEVEL_1), sp_cc_to_ratio(((mrb_int)(get_midi_cc_value(((uint8_t)(cst_MIDI_CH)), ((uint8_t)(lv_cc_mixer_2_level_1)))))));
#line 546 "spms1_main.rb"
      sp_FloatArray_set(lv_signals, sp_cc_slot(lv_cc_mixer_2_invert_1, cst_SIGNAL_MIXER_2_INVERT_1), sp_cc_to_ratio(((mrb_int)(get_midi_cc_value(((uint8_t)(cst_MIDI_CH)), ((uint8_t)(lv_cc_mixer_2_invert_1)))))));
#line 547 "spms1_main.rb"
      sp_FloatArray_set(lv_signals, sp_cc_slot(lv_cc_mixer_2_level_2, cst_SIGNAL_MIXER_2_LEVEL_2), sp_cc_to_ratio(((mrb_int)(get_midi_cc_value(((uint8_t)(cst_MIDI_CH)), ((uint8_t)(lv_cc_mixer_2_level_2)))))));
#line 548 "spms1_main.rb"
      sp_FloatArray_set(lv_signals, sp_cc_slot(lv_cc_mixer_2_invert_2, cst_SIGNAL_MIXER_2_INVERT_2), sp_cc_to_ratio(((mrb_int)(get_midi_cc_value(((uint8_t)(cst_MIDI_CH)), ((uint8_t)(lv_cc_mixer_2_invert_2)))))));
#line 549 "spms1_main.rb"
      sp_FloatArray_set(lv_signals, sp_cc_slot(lv_cc_mixer_3_level_1, cst_SIGNAL_MIXER_3_LEVEL_1), sp_cc_to_ratio(((mrb_int)(get_midi_cc_value(((uint8_t)(cst_MIDI_CH)), ((uint8_t)(lv_cc_mixer_3_level_1)))))));
#line 550 "spms1_main.rb"
      sp_FloatArray_set(lv_signals, sp_cc_slot(lv_cc_mixer_3_invert_1, cst_SIGNAL_MIXER_3_INVERT_1), sp_cc_to_ratio(((mrb_int)(get_midi_cc_value(((uint8_t)(cst_MIDI_CH)), ((uint8_t)(lv_cc_mixer_3_invert_1)))))));
#line 551 "spms1_main.rb"
      sp_FloatArray_set(lv_signals, sp_cc_slot(lv_cc_mixer_3_level_2, cst_SIGNAL_MIXER_3_LEVEL_2), sp_cc_to_ratio(((mrb_int)(get_midi_cc_value(((uint8_t)(cst_MIDI_CH)), ((uint8_t)(lv_cc_mixer_3_level_2)))))));
#line 552 "spms1_main.rb"
      sp_FloatArray_set(lv_signals, sp_cc_slot(lv_cc_mixer_3_invert_2, cst_SIGNAL_MIXER_3_INVERT_2), sp_cc_to_ratio(((mrb_int)(get_midi_cc_value(((uint8_t)(cst_MIDI_CH)), ((uint8_t)(lv_cc_mixer_3_invert_2)))))));
#line 553 "spms1_main.rb"
      sp_FloatArray_set(lv_signals, sp_cc_slot(lv_cc_mixer_4_level_1, cst_SIGNAL_MIXER_4_LEVEL_1), sp_cc_to_ratio(((mrb_int)(get_midi_cc_value(((uint8_t)(cst_MIDI_CH)), ((uint8_t)(lv_cc_mixer_4_level_1)))))));
#line 554 "spms1_main.rb"
      sp_FloatArray_set(lv_signals, sp_cc_slot(lv_cc_mixer_4_invert_1, cst_SIGNAL_MIXER_4_INVERT_1), sp_cc_to_ratio(((mrb_int)(get_midi_cc_value(((uint8_t)(cst_MIDI_CH)), ((uint8_t)(lv_cc_mixer_4_invert_1)))))));
#line 555 "spms1_main.rb"
      sp_FloatArray_set(lv_signals, sp_cc_slot(lv_cc_mixer_4_level_2, cst_SIGNAL_MIXER_4_LEVEL_2), sp_cc_to_ratio(((mrb_int)(get_midi_cc_value(((uint8_t)(cst_MIDI_CH)), ((uint8_t)(lv_cc_mixer_4_level_2)))))));
#line 556 "spms1_main.rb"
      sp_FloatArray_set(lv_signals, sp_cc_slot(lv_cc_mixer_4_invert_2, cst_SIGNAL_MIXER_4_INVERT_2), sp_cc_to_ratio(((mrb_int)(get_midi_cc_value(((uint8_t)(cst_MIDI_CH)), ((uint8_t)(lv_cc_mixer_4_invert_2)))))));
#line 557 "spms1_main.rb"
      sp_FloatArray_set(lv_signals, sp_cc_slot(lv_cc_mixer_5_level_1, cst_SIGNAL_MIXER_5_LEVEL_1), sp_cc_to_ratio(((mrb_int)(get_midi_cc_value(((uint8_t)(cst_MIDI_CH)), ((uint8_t)(lv_cc_mixer_5_level_1)))))));
#line 558 "spms1_main.rb"
      sp_FloatArray_set(lv_signals, sp_cc_slot(lv_cc_mixer_5_invert_1, cst_SIGNAL_MIXER_5_INVERT_1), sp_cc_to_ratio(((mrb_int)(get_midi_cc_value(((uint8_t)(cst_MIDI_CH)), ((uint8_t)(lv_cc_mixer_5_invert_1)))))));
#line 559 "spms1_main.rb"
      sp_FloatArray_set(lv_signals, sp_cc_slot(lv_cc_mixer_5_level_2, cst_SIGNAL_MIXER_5_LEVEL_2), sp_cc_to_ratio(((mrb_int)(get_midi_cc_value(((uint8_t)(cst_MIDI_CH)), ((uint8_t)(lv_cc_mixer_5_level_2)))))));
#line 560 "spms1_main.rb"
      sp_FloatArray_set(lv_signals, sp_cc_slot(lv_cc_mixer_5_invert_2, cst_SIGNAL_MIXER_5_INVERT_2), sp_cc_to_ratio(((mrb_int)(get_midi_cc_value(((uint8_t)(cst_MIDI_CH)), ((uint8_t)(lv_cc_mixer_5_invert_2)))))));
#line 562 "spms1_main.rb"
      mrb_float _t278 = sp_FloatArray_get(lv_signals, lv_source_osc_waveform);
      sp_Osc_set_waveform((sp_Osc *)lv_osc, _t278);
#line 563 "spms1_main.rb"
      mrb_float _t279 = sp_FloatArray_get(lv_signals, lv_source_osc_mod_amount);
      sp_Osc_set_modulation_amount((sp_Osc *)lv_osc, _t279);
#line 564 "spms1_main.rb"
      mrb_float _t280 = sp_FloatArray_get(lv_signals, lv_source_osc_coarse_tune);
      sp_Osc_set_coarse_tune((sp_Osc *)lv_osc, _t280);
#line 565 "spms1_main.rb"
      mrb_float _t281 = sp_FloatArray_get(lv_signals, lv_source_osc_fine_tune);
      sp_Osc_set_fine_tune((sp_Osc *)lv_osc, _t281);
#line 566 "spms1_main.rb"
      mrb_float _t282 = sp_FloatArray_get(lv_signals, lv_source_filter_cutoff);
      sp_Filter_set_cutoff((sp_Filter *)lv_filter, _t282);
#line 567 "spms1_main.rb"
      mrb_float _t283 = sp_FloatArray_get(lv_signals, lv_source_filter_resonance);
      sp_Filter_set_resonance((sp_Filter *)lv_filter, _t283);
#line 568 "spms1_main.rb"
      mrb_float _t284 = sp_FloatArray_get(lv_signals, lv_source_filter_mod_amount);
      sp_Filter_set_modulation_amount((sp_Filter *)lv_filter, _t284);
#line 569 "spms1_main.rb"
      mrb_float _t285 = sp_FloatArray_get(lv_signals, lv_source_filter_gain);
      sp_Filter_set_gain((sp_Filter *)lv_filter, _t285);
#line 570 "spms1_main.rb"
      mrb_float _t286 = sp_FloatArray_get(lv_signals, lv_source_amp_gain);
      sp_Amp_set_gain((sp_Amp *)lv_amp, _t286);
#line 571 "spms1_main.rb"
      mrb_float _t287 = sp_FloatArray_get(lv_signals, lv_source_env_gen_attack);
      sp_EnvGen_set_attack((sp_EnvGen *)lv_env_gen, _t287);
#line 572 "spms1_main.rb"
      mrb_float _t288 = sp_FloatArray_get(lv_signals, lv_source_env_gen_decay);
      sp_EnvGen_set_decay((sp_EnvGen *)lv_env_gen, _t288);
#line 573 "spms1_main.rb"
      mrb_float _t289 = sp_FloatArray_get(lv_signals, lv_source_env_gen_sustain);
      sp_EnvGen_set_sustain((sp_EnvGen *)lv_env_gen, _t289);
#line 574 "spms1_main.rb"
      mrb_float _t290 = sp_FloatArray_get(lv_signals, lv_source_lfo_rate);
      sp_LFO_set_rate((sp_LFO *)lv_lfo, _t290);
#line 575 "spms1_main.rb"
      mrb_float _t291 = sp_FloatArray_get(lv_signals, lv_source_mixer_1_level_1);
      sp_Mixer_set_level_1((sp_Mixer *)lv_mixer_1, _t291);
#line 576 "spms1_main.rb"
      mrb_float _t292 = sp_FloatArray_get(lv_signals, lv_source_mixer_1_invert_1);
      sp_Mixer_set_invert_1((sp_Mixer *)lv_mixer_1, _t292);
#line 577 "spms1_main.rb"
      mrb_float _t293 = sp_FloatArray_get(lv_signals, lv_source_mixer_1_level_2);
      sp_Mixer_set_level_2((sp_Mixer *)lv_mixer_1, _t293);
#line 578 "spms1_main.rb"
      mrb_float _t294 = sp_FloatArray_get(lv_signals, lv_source_mixer_1_invert_2);
      sp_Mixer_set_invert_2((sp_Mixer *)lv_mixer_1, _t294);
#line 579 "spms1_main.rb"
      mrb_float _t295 = sp_FloatArray_get(lv_signals, lv_source_mixer_2_level_1);
      sp_Mixer_set_level_1((sp_Mixer *)lv_mixer_2, _t295);
#line 580 "spms1_main.rb"
      mrb_float _t296 = sp_FloatArray_get(lv_signals, lv_source_mixer_2_invert_1);
      sp_Mixer_set_invert_1((sp_Mixer *)lv_mixer_2, _t296);
#line 581 "spms1_main.rb"
      mrb_float _t297 = sp_FloatArray_get(lv_signals, lv_source_mixer_2_level_2);
      sp_Mixer_set_level_2((sp_Mixer *)lv_mixer_2, _t297);
#line 582 "spms1_main.rb"
      mrb_float _t298 = sp_FloatArray_get(lv_signals, lv_source_mixer_2_invert_2);
      sp_Mixer_set_invert_2((sp_Mixer *)lv_mixer_2, _t298);
#line 583 "spms1_main.rb"
      mrb_float _t299 = sp_FloatArray_get(lv_signals, lv_source_mixer_3_level_1);
      sp_Mixer_set_level_1((sp_Mixer *)lv_mixer_3, _t299);
#line 584 "spms1_main.rb"
      mrb_float _t300 = sp_FloatArray_get(lv_signals, lv_source_mixer_3_invert_1);
      sp_Mixer_set_invert_1((sp_Mixer *)lv_mixer_3, _t300);
#line 585 "spms1_main.rb"
      mrb_float _t301 = sp_FloatArray_get(lv_signals, lv_source_mixer_3_level_2);
      sp_Mixer_set_level_2((sp_Mixer *)lv_mixer_3, _t301);
#line 586 "spms1_main.rb"
      mrb_float _t302 = sp_FloatArray_get(lv_signals, lv_source_mixer_3_invert_2);
      sp_Mixer_set_invert_2((sp_Mixer *)lv_mixer_3, _t302);
#line 587 "spms1_main.rb"
      mrb_float _t303 = sp_FloatArray_get(lv_signals, lv_source_mixer_4_level_1);
      sp_Mixer_set_level_1((sp_Mixer *)lv_mixer_4, _t303);
#line 588 "spms1_main.rb"
      mrb_float _t304 = sp_FloatArray_get(lv_signals, lv_source_mixer_4_invert_1);
      sp_Mixer_set_invert_1((sp_Mixer *)lv_mixer_4, _t304);
#line 589 "spms1_main.rb"
      mrb_float _t305 = sp_FloatArray_get(lv_signals, lv_source_mixer_4_level_2);
      sp_Mixer_set_level_2((sp_Mixer *)lv_mixer_4, _t305);
#line 590 "spms1_main.rb"
      mrb_float _t306 = sp_FloatArray_get(lv_signals, lv_source_mixer_4_invert_2);
      sp_Mixer_set_invert_2((sp_Mixer *)lv_mixer_4, _t306);
#line 591 "spms1_main.rb"
      mrb_float _t307 = sp_FloatArray_get(lv_signals, lv_source_mixer_5_level_1);
      sp_Mixer_set_level_1((sp_Mixer *)lv_mixer_5, _t307);
#line 592 "spms1_main.rb"
      mrb_float _t308 = sp_FloatArray_get(lv_signals, lv_source_mixer_5_invert_1);
      sp_Mixer_set_invert_1((sp_Mixer *)lv_mixer_5, _t308);
#line 593 "spms1_main.rb"
      mrb_float _t309 = sp_FloatArray_get(lv_signals, lv_source_mixer_5_level_2);
      sp_Mixer_set_level_2((sp_Mixer *)lv_mixer_5, _t309);
#line 594 "spms1_main.rb"
      mrb_float _t310 = sp_FloatArray_get(lv_signals, lv_source_mixer_5_invert_2);
      sp_Mixer_set_invert_2((sp_Mixer *)lv_mixer_5, _t310);
#line 596 "spms1_main.rb"
      lv_i = 0LL;
#line 597 "spms1_main.rb"
      while ((lv_i < cst_AUDIO_BUFFER_WORDS)) {
#line 598 "spms1_main.rb"
        lv_slot = 0LL;
#line 599 "spms1_main.rb"
        while ((lv_slot < cst_MODULES_SIZE)) {
#line 600 "spms1_main.rb"
          lv_module_id = sp_IntArray_get(lv_active_modules, lv_slot);
#line 601 "spms1_main.rb"
          if ((lv_module_id == cst_MODULE_NONE)) {
            break;
          }
#line 603 "spms1_main.rb"
          mrb_int _t311 = lv_module_id;
          if ((_t311 == cst_MODULE_LFO)) {
#line 605 "spms1_main.rb"
            sp_FloatArray_set(lv_signals, cst_SIGNAL_LFO_OUTPUT, sp_LFO_process((sp_LFO *)lv_lfo));
          }
          else if ((_t311 == cst_MODULE_ENV_GEN)) {
#line 607 "spms1_main.rb"
            mrb_float _t312 = sp_FloatArray_get(lv_signals, lv_source_env_gen_gate);
            sp_FloatArray_set(lv_signals, cst_SIGNAL_ENV_GEN_OUTPUT, sp_EnvGen_process((sp_EnvGen *)lv_env_gen, _t312));
          }
          else if ((_t311 == cst_MODULE_OSC)) {
#line 609 "spms1_main.rb"
            mrb_float _t313 = sp_FloatArray_get(lv_signals, lv_source_osc_pitch);
            mrb_float _t314 = sp_FloatArray_get(lv_signals, lv_source_osc_mod);
            sp_FloatArray_set(lv_signals, cst_SIGNAL_OSC_OUTPUT, sp_Osc_process((sp_Osc *)lv_osc, _t313, _t314));
          }
          else if ((_t311 == cst_MODULE_FILTER)) {
#line 611 "spms1_main.rb"
            mrb_float _t315 = sp_FloatArray_get(lv_signals, lv_source_filter_audio);
            mrb_float _t316 = sp_FloatArray_get(lv_signals, lv_source_filter_mod);
            sp_FloatArray_set(lv_signals, cst_SIGNAL_FILTER_OUTPUT, sp_Filter_process((sp_Filter *)lv_filter, _t315, _t316));
          }
          else if ((_t311 == cst_MODULE_AMP)) {
#line 613 "spms1_main.rb"
            mrb_float _t317 = sp_FloatArray_get(lv_signals, lv_source_amp_audio);
            mrb_float _t318 = sp_FloatArray_get(lv_signals, lv_source_amp_mod);
            sp_FloatArray_set(lv_signals, cst_SIGNAL_AMP_OUTPUT, sp_Amp_process((sp_Amp *)lv_amp, _t317, _t318));
          }
          else if ((_t311 == cst_MODULE_MIXER_1)) {
#line 615 "spms1_main.rb"
            mrb_float _t319 = sp_FloatArray_get(lv_signals, lv_source_mixer_1_in_1);
            mrb_float _t320 = sp_FloatArray_get(lv_signals, lv_source_mixer_1_in_2);
            sp_FloatArray_set(lv_signals, cst_SIGNAL_MIXER_1_OUTPUT, sp_Mixer_process((sp_Mixer *)lv_mixer_1, _t319, _t320));
          }
          else if ((_t311 == cst_MODULE_MIXER_2)) {
#line 617 "spms1_main.rb"
            mrb_float _t321 = sp_FloatArray_get(lv_signals, lv_source_mixer_2_in_1);
            mrb_float _t322 = sp_FloatArray_get(lv_signals, lv_source_mixer_2_in_2);
            sp_FloatArray_set(lv_signals, cst_SIGNAL_MIXER_2_OUTPUT, sp_Mixer_process((sp_Mixer *)lv_mixer_2, _t321, _t322));
          }
          else if ((_t311 == cst_MODULE_MIXER_3)) {
#line 619 "spms1_main.rb"
            mrb_float _t323 = sp_FloatArray_get(lv_signals, lv_source_mixer_3_in_1);
            mrb_float _t324 = sp_FloatArray_get(lv_signals, lv_source_mixer_3_in_2);
            sp_FloatArray_set(lv_signals, cst_SIGNAL_MIXER_3_OUTPUT, sp_Mixer_process((sp_Mixer *)lv_mixer_3, _t323, _t324));
          }
          else if ((_t311 == cst_MODULE_MIXER_4)) {
#line 621 "spms1_main.rb"
            mrb_float _t325 = sp_FloatArray_get(lv_signals, lv_source_mixer_4_in_1);
            mrb_float _t326 = sp_FloatArray_get(lv_signals, lv_source_mixer_4_in_2);
            sp_FloatArray_set(lv_signals, cst_SIGNAL_MIXER_4_OUTPUT, sp_Mixer_process((sp_Mixer *)lv_mixer_4, _t325, _t326));
          }
          else if ((_t311 == cst_MODULE_MIXER_5)) {
#line 623 "spms1_main.rb"
            mrb_float _t327 = sp_FloatArray_get(lv_signals, lv_source_mixer_5_in_1);
            mrb_float _t328 = sp_FloatArray_get(lv_signals, lv_source_mixer_5_in_2);
            sp_FloatArray_set(lv_signals, cst_SIGNAL_MIXER_5_OUTPUT, sp_Mixer_process((sp_Mixer *)lv_mixer_5, _t327, _t328));
          }
#line 626 "spms1_main.rb"
          lv_slot = sp_int_add(lv_slot, 1LL);
        }
#line 629 "spms1_main.rb"
        sp_FloatArray_set(lv_audio_buffer, lv_i, sp_FloatArray_get(lv_signals, lv_source_output));
#line 630 "spms1_main.rb"
        lv_i = sp_int_add(lv_i, 1LL);
      }
#line 633 "spms1_main.rb"
      (stop_debug_measure(), (mrb_int)0);
#line 635 "spms1_main.rb"
      for (mrb_int _t330 = 0; _t330 < cst_AUDIO_BUFFER_WORDS; _t330++) {
        lv_i__bp5236 = _t330;
#line 636 "spms1_main.rb"
        (write_to_audio_buffer(((float)(sp_FloatArray_get(lv_audio_buffer, lv_i__bp5236))), ((float)(sp_FloatArray_get(lv_audio_buffer, lv_i__bp5236)))), (mrb_int)0);
      }
    }
    sp_exc_top--;
  }
  else {
    sp_exc_top--;
    sp_gc_nroots = _gcb155;
    if (sp_unwind_kind != SP_UNWIND_NONE) sp_unwind_resume();
    if (!sp_exc_cls_matches((const char *)sp_last_exc_cls, "StopIteration")) sp_raise_cls(sp_exc_cls[sp_exc_top], sp_exc_msg[sp_exc_top]);
  }
  return 0;
}
