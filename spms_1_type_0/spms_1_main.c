/* Generated by Spinel AOT compiler */
#include "sp_runtime.h"
extern int32_t get_sample_rate(void);
extern int32_t get_audio_buffer_words(void);
extern uint8_t get_midi_note_on_pitch(void);
extern uint8_t get_midi_note_on_state(void);
extern uint8_t get_midi_cc_value(uint8_t);
extern void audio_out_write(float, float);
extern void debug_measure_begin(void);
extern void debug_measure_end(void);
static const char *const sp_sym_names[29] = {(&("\xff" "initialize")[1]), (&("\xff" "set_sample_rate")[1]), (&("\xff" "set_waveform")[1]), (&("\xff" "process")[1]), (&("\xff" "pitch_to_freq_fast")[1]), (&("\xff" "poly_blep")[1]), (&("\xff" "set_cutoff")[1]), (&("\xff" "set_modulation_amount")[1]), (&("\xff" "set_resonance")[1]), (&("\xff" "update_coefficients_interleaved")[1]), (&("\xff" "soft_clip")[1]), (&("\xff" "set_gain")[1]), (&("\xff" "set_attack")[1]), (&("\xff" "set_decay")[1]), (&("\xff" "set_sustain")[1]), (&("\xff" "update_coefficients_full")[1]), (&("\xff" "calculate_exp_fast")[1]), (&("\xff" "get_sample_rate")[1]), (&("\xff" "int32")[1]), (&("\xff" "get_audio_buffer_words")[1]), (&("\xff" "get_midi_note_on_pitch")[1]), (&("\xff" "uint8")[1]), (&("\xff" "get_midi_note_on_state")[1]), (&("\xff" "get_midi_cc_value")[1]), (&("\xff" "audio_out_write")[1]), (&("\xff" "float")[1]), (&("\xff" "void")[1]), (&("\xff" "debug_measure_begin")[1]), (&("\xff" "debug_measure_end")[1])};
static const char *sp_dyn_syms[SP_DYN_SYMS_MAX]; static int sp_ndyn = 0;
static const char *sp_sym_to_s(sp_sym id){if(id>=0&&id<29)return sp_sym_names[id];if(id>=29&&id<29+sp_ndyn)return sp_dyn_syms[id-29];return "";}
static sp_sym sp_sym_intern(const char *s){for(int i=0;i<29;i++)if(strcmp(sp_sym_names[i],s)==0)return (sp_sym)i;for(int i=0;i<sp_ndyn;i++)if(strcmp(sp_dyn_syms[i],s)==0)return (sp_sym)(29+i);if(sp_ndyn<SP_DYN_SYMS_MAX){sp_dyn_syms[sp_ndyn]=sp_str_dup_external(s);return (sp_sym)(29+sp_ndyn++);}return (sp_sym)0;}

static const char *sp_class_to_s(sp_Class c){if(sp_class_nil_p(c))return SPL("nil");if(c.name)return c.name;switch(c.cls_id){case 0:return SPL("Spms1");case 1:return SPL("Spms1::Oscillator");case 2:return SPL("Spms1::Filter");case 3:return SPL("Spms1::Amp");case 4:return SPL("Spms1::EnvGen");case 5:return SPL("Spms1::C");case -100:return SPL("Integer");case -101:return SPL("Float");case -102:return SPL("String");case -103:return SPL("Symbol");case -104:return SPL("Array");case -105:return SPL("Hash");case -106:return SPL("Range");case -107:return SPL("Time");case -108:return SPL("Module");case -109:return SPL("Class");case -110:return SPL("NilClass");case -111:return SPL("TrueClass");case -112:return SPL("FalseClass");case -113:return SPL("Numeric");case -114:return SPL("Comparable");case -115:return SPL("Enumerable");case -116:return SPL("Object");case -117:return SPL("BasicObject");case -118:return SPL("Proc");case -119:return SPL("Kernel");case -120:return SPL("IO");case -121:return SPL("File");case -122:return SPL("Exception");case -123:return SPL("StandardError");case -124:return SPL("RuntimeError");case -125:return SPL("TypeError");case -126:return SPL("ArgumentError");case -127:return SPL("NameError");case -128:return SPL("NoMethodError");case -129:return SPL("StopIteration");case -130:return SPL("Math");case -131:return SPL("Complex");case -132:return SPL("IndexError");case -133:return SPL("KeyError");case -134:return SPL("RangeError");case -135:return SPL("FloatDomainError");case -136:return SPL("ZeroDivisionError");case -137:return SPL("FrozenError");case -138:return SPL("IOError");case -139:return SPL("LocalJumpError");case -140:return SPL("NotImplementedError");case -141:return SPL("ScriptError");case -142:return SPL("Rational");case -143:return SPL("Regexp");case -144:return SPL("Enumerator");case -145:return SPL("Struct");case -146:return SPL("Data");case -147:return SPL("SyntaxError");case -148:return SPL("SecurityError");case -149:return SPL("RegexpError");case -150:return SPL("EncodingError");case -151:return SPL("SignalException");case -152:return SPL("Interrupt");case -153:return SPL("ThreadError");case -154:return SPL("FiberError");case -155:return SPL("ClosedQueueError");case -156:return SPL("UncaughtThrowError");case -157:return SPL("NoMatchingPatternError");case -158:return SPL("NoMatchingPatternKeyError");case -159:return SPL("EOFError");case -160:return SPL("Math::DomainError");case -161:return SPL("SystemExit");case -162:return SPL("Signal");case -163:return SPL("Process::Status");default:return "";} }

static const int sp_cls_is_module[6] = {1,0,0,0,0,1};
static int sp_class_is_module_val(sp_Class c){
  if(c.cls_id>=0&&c.cls_id<6)return sp_cls_is_module[c.cls_id];
  return(c.cls_id==-114||c.cls_id==-115||c.cls_id==-119||c.cls_id==-162);
}
static sp_Class sp_class_superclass(sp_Class c){
  switch(c.cls_id){
  case 0: return ((sp_Class){-116});
  case 1: return ((sp_Class){-116});
  case 2: return ((sp_Class){-116});
  case 3: return ((sp_Class){-116});
  case 4: return ((sp_Class){-116});
  case 5: return ((sp_Class){-116});
  default: return ((sp_Class){-116});
  }
}
static sp_Class sp_builtin_superclass(sp_Class c);
static int sp_class_is_ancestor(sp_Class anc, sp_Class desc);
static int sp_class_is_ancestor(sp_Class anc, sp_Class desc){
  sp_Class cur = desc;
  for(int _i=0;_i<46;_i++){
    if(cur.cls_id==anc.cls_id)return 1;
    if(cur.cls_id==-117)break;
    sp_Class next=cur.cls_id>=0?sp_class_superclass(cur):sp_builtin_superclass(cur);
    if(next.cls_id==cur.cls_id)break;
    cur=next;
  }
  return 0;
}
static sp_Class sp_builtin_superclass(sp_Class c){
  if(sp_class_nil_p(c))return SP_CLASS_NIL;
  switch(c.cls_id){
  case -100:case -101:case -131:case -142: return ((sp_Class){-113});
  case -102:case -103:case -104:case -105:case -106:case -107:case -113: return ((sp_Class){-116});
  case -122: return ((sp_Class){-116});
  case -123:case -141: return ((sp_Class){-122});
  case -124:case -125:case -126:case -127:case -132:case -134:case -136:case -138:case -139: return ((sp_Class){-123});
  case -129: return ((sp_Class){-132});
  case -133: return ((sp_Class){-132});
  case -135: return ((sp_Class){-134});
  case -137: return ((sp_Class){-124});
  case -140: return ((sp_Class){-141});
  case -128: return ((sp_Class){-127});
  case -149:case -150:case -153:case -154:case -157:case -160: return ((sp_Class){-123});
  case -147: return ((sp_Class){-141});
  case -148:case -151:case -161: return ((sp_Class){-122});
  case -152: return ((sp_Class){-151});
  case -155: return ((sp_Class){-129});
  case -156: return ((sp_Class){-126});
  case -158: return ((sp_Class){-157});
  case -159: return ((sp_Class){-138});
  case -110:case -111:case -112:case -118:case -145:case -146: return ((sp_Class){-116});
  case -108: return ((sp_Class){-116});
  case -109: return ((sp_Class){-108});
  case -116: return ((sp_Class){-117});
  case -117: return SP_CLASS_NIL;
  default: return ((sp_Class){-116});
  }
}
static int sp_class_lt(sp_Class a,sp_Class b){return a.cls_id!=b.cls_id&&sp_class_is_ancestor(b,a);}
static int sp_class_le(sp_Class a,sp_Class b){return sp_class_is_ancestor(b,a);}
static int sp_class_gt(sp_Class a,sp_Class b){return sp_class_lt(b,a);}
static int sp_class_ge(sp_Class a,sp_Class b){return sp_class_le(b,a);}
#define sp_class_lt3(A,B) ({ sp_Class _cx=(A),_cy=(B); _cx.cls_id==_cy.cls_id?sp_box_bool(0):(sp_class_le(_cx,_cy)?sp_box_bool(1):(sp_class_le(_cy,_cx)?sp_box_bool(0):sp_box_nil())); })
#define sp_class_le3(A,B) ({ sp_Class _cx=(A),_cy=(B); sp_class_le(_cx,_cy)?sp_box_bool(1):(sp_class_le(_cy,_cx)?sp_box_bool(0):sp_box_nil()); })
#define sp_class_gt3(A,B) sp_class_lt3(B,A)
#define sp_class_ge3(A,B) sp_class_le3(B,A)
#define sp_class_cmp3(A,B) ({ sp_Class _cx=(A),_cy=(B); _cx.cls_id==_cy.cls_id?sp_box_int(0):(sp_class_le(_cx,_cy)?sp_box_int(-1):(sp_class_le(_cy,_cx)?sp_box_int(1):sp_box_nil())); })
static sp_PolyArray *sp_class_ancestors(sp_Class c){
  sp_PolyArray *a=sp_PolyArray_new();
  sp_Class cur=c;
  for(int _i=0;_i<26;_i++){
    if(cur.cls_id<0){
      if(cur.cls_id==-114||cur.cls_id==-115||cur.cls_id==-119||cur.cls_id==-130){
        sp_PolyArray_push(a,sp_box_class(cur)); break;
      }
      while(1){
        sp_PolyArray_push(a,sp_box_class(cur));
        if(cur.cls_id==-113) sp_PolyArray_push(a,sp_box_class(((sp_Class){-114})));
        if(cur.cls_id==-104||cur.cls_id==-105||cur.cls_id==-106||cur.cls_id==-144||cur.cls_id==-145) sp_PolyArray_push(a,sp_box_class(((sp_Class){-115})));
        if(cur.cls_id==-102||cur.cls_id==-103) sp_PolyArray_push(a,sp_box_class(((sp_Class){-114})));
        if(cur.cls_id==-116) sp_PolyArray_push(a,sp_box_class(((sp_Class){-119})));
        sp_Class bn=sp_builtin_superclass(cur);
        if(sp_class_nil_p(bn)||bn.cls_id==cur.cls_id)break;
        cur=bn;
      }
      break;
    }
    sp_PolyArray_push(a,sp_box_class(cur));
    switch(cur.cls_id){
    }
    sp_Class next=sp_class_superclass(cur);
    if(next.cls_id==cur.cls_id)break;
    cur=next;
  }
  return a;
}

static sp_PolyArray *sp_class_included_modules(sp_Class c) __attribute__((unused));
static sp_PolyArray *sp_class_included_modules(sp_Class c){
  sp_PolyArray *a=sp_class_ancestors(c); SP_GC_ROOT(a);
  sp_PolyArray *r=sp_PolyArray_new(); SP_GC_ROOT(r);
  for(mrb_int i=0;a&&i<a->len;i++){ sp_Class m={a->data[i].v.i,NULL};
    if(sp_class_is_module_val(m)) sp_PolyArray_push(r,a->data[i]); }
  return r;
}

static int sp_class_le_mod(sp_Class a,sp_Class b){
  /* a<=b: b is an ancestor of a, so b must appear in a's ancestors */
  sp_PolyArray *ancs=sp_class_ancestors(a);
  for(mrb_int _i=0;_i<sp_PolyArray_length(ancs);_i++){
    sp_RbVal v=sp_PolyArray_get(ancs,_i);
    if(v.tag==7&&(int)v.cls_id==b.cls_id)return 1;
  }
  if(b.cls_id<0)return sp_class_is_ancestor(b,a);
  return 0;
}
#undef sp_class_le
#define sp_class_le sp_class_le_mod
#undef sp_class_lt
#define sp_class_lt(a,b) ((a).cls_id!=(b).cls_id&&sp_class_le_mod(a,b))
#undef sp_class_gt
#define sp_class_gt(a,b) ((a).cls_id!=(b).cls_id&&sp_class_le_mod(b,a))
#undef sp_class_ge
#define sp_class_ge(a,b) sp_class_le_mod(b,a)
static sp_Class sp_poly_get_class(sp_RbVal v){
  switch(v.tag){
  case SP_TAG_INT: return ((sp_Class){-100});
  case SP_TAG_STR: return ((sp_Class){-102});
  case SP_TAG_FLT: return ((sp_Class){-101});
  case SP_TAG_BOOL: return v.v.b?((sp_Class){-111}):((sp_Class){-112});
  case SP_TAG_NIL: return ((sp_Class){-110});
  case SP_TAG_SYM: return ((sp_Class){-103});
  case SP_TAG_OBJ: if(v.cls_id>=0)return ((sp_Class){v.cls_id});
    if(v.cls_id>=-12)return ((sp_Class){-104});
    if(v.cls_id>=-20||v.cls_id==-34)return ((sp_Class){-105});
    return ((sp_Class){-116});
  default: return ((sp_Class){-116});
  }
}
static int sp_poly_is_a(sp_RbVal obj,sp_Class klass){
  return sp_class_le(sp_poly_get_class(obj),klass);
}
static const char *sp_user_exc_parent(const char *cls){
  (void)cls;
  return 0;
}
typedef struct sp_Spms1_s sp_Spms1;
typedef struct sp_Oscillator_s sp_Oscillator;
typedef struct sp_Filter_s sp_Filter;
typedef struct sp_Amp_s sp_Amp;
typedef struct sp_EnvGen_s sp_EnvGen;
typedef struct sp_C_s sp_C;
struct sp_Spms1_s {
  mrb_int cls_id;
};
struct sp_Oscillator_s {
  mrb_int cls_id;
  mrb_float iv_sample_rate;
  mrb_float iv_phase;
  mrb_int iv_waveform;
};
struct sp_Filter_s {
  mrb_int cls_id;
  mrb_float iv_sample_rate;
  mrb_float iv_cutoff;
  mrb_float iv_resonance;
  mrb_float iv_modulation_amount;
  mrb_float iv_current_cutoff;
  mrb_float iv_current_resonance;
  mrb_float iv_b0;
  mrb_float iv_b1;
  mrb_float iv_b2;
  mrb_float iv_a1;
  mrb_float iv_a2;
  mrb_float iv_z1;
  mrb_float iv_z2;
  mrb_int iv_interleave_state;
  mrb_float iv_next_b0;
  mrb_float iv_next_b1;
  mrb_float iv_next_a1;
  mrb_float iv_next_a2;
  mrb_int iv_sample_counter;
  mrb_float iv_step_midi_cutoff;
  mrb_float iv_step_omega;
  mrb_float iv_step_q;
  mrb_float iv_step_sin_w;
  mrb_float iv_step_cos_w;
  mrb_float iv_step_inv_denom;
  mrb_float iv_step_two_q;
};
struct sp_Amp_s {
  mrb_int cls_id;
  mrb_float iv_sample_rate;
  mrb_float iv_gain;
};
struct sp_EnvGen_s {
  mrb_int cls_id;
  mrb_float iv_sample_rate;
  mrb_int iv_state;
  mrb_float iv_current_level;
  mrb_float iv_attack;
  mrb_float iv_decay;
  mrb_float iv_sustain;
  mrb_float iv_attack_target;
  mrb_bool iv_was_gate_on;
  mrb_float iv_attack_coef;
  mrb_float iv_decay_coef;
  mrb_int iv_sample_counter;
};
struct sp_C_s {
  mrb_int cls_id;
};

static mrb_float civ_Oscillator_sample_rate = 0.0;
static mrb_float civ_Oscillator_phase = 0.0;
static mrb_int civ_Oscillator_waveform = SP_INT_NIL;
static mrb_float civ_Filter_sample_rate = 0.0;
static mrb_float civ_Filter_cutoff = 0.0;
static mrb_float civ_Filter_resonance = 0.0;
static mrb_float civ_Filter_modulation_amount = 0.0;
static mrb_float civ_Filter_current_cutoff = 0.0;
static mrb_float civ_Filter_current_resonance = 0.0;
static mrb_float civ_Filter_b0 = 0.0;
static mrb_float civ_Filter_b1 = 0.0;
static mrb_float civ_Filter_b2 = 0.0;
static mrb_float civ_Filter_a1 = 0.0;
static mrb_float civ_Filter_a2 = 0.0;
static mrb_float civ_Filter_z1 = 0.0;
static mrb_float civ_Filter_z2 = 0.0;
static mrb_int civ_Filter_interleave_state = SP_INT_NIL;
static mrb_float civ_Filter_next_b0 = 0.0;
static mrb_float civ_Filter_next_b1 = 0.0;
static mrb_float civ_Filter_next_a1 = 0.0;
static mrb_float civ_Filter_next_a2 = 0.0;
static mrb_int civ_Filter_sample_counter = SP_INT_NIL;
static mrb_float civ_Filter_step_midi_cutoff = 0.0;
static mrb_float civ_Filter_step_omega = 0.0;
static mrb_float civ_Filter_step_q = 0.0;
static mrb_float civ_Filter_step_sin_w = 0.0;
static mrb_float civ_Filter_step_cos_w = 0.0;
static mrb_float civ_Filter_step_inv_denom = 0.0;
static mrb_float civ_Filter_step_two_q = 0.0;
static mrb_float civ_Amp_sample_rate = 0.0;
static mrb_float civ_Amp_gain = 0.0;
static mrb_float civ_EnvGen_sample_rate = 0.0;
static mrb_int civ_EnvGen_state = SP_INT_NIL;
static mrb_float civ_EnvGen_current_level = 0.0;
static mrb_float civ_EnvGen_attack = 0.0;
static mrb_float civ_EnvGen_decay = 0.0;
static mrb_float civ_EnvGen_sustain = 0.0;
static mrb_float civ_EnvGen_attack_target = 0.0;
static mrb_bool civ_EnvGen_was_gate_on = 0;
static mrb_float civ_EnvGen_attack_coef = 0.0;
static mrb_float civ_EnvGen_decay_coef = 0.0;
static mrb_int civ_EnvGen_sample_counter = SP_INT_NIL;
static const char *sp_obj_inspect_sw(int cls_id, void *p) __attribute__((cold, noinline));
static const char *sp_obj_to_s_sw(int cls_id, void *p) __attribute__((cold, noinline));
static void sp_Oscillator_initialize(sp_Oscillator *self);
static mrb_float sp_Oscillator_set_sample_rate(sp_Oscillator *self, mrb_float lv_sample_rate);
static mrb_int sp_Oscillator_set_waveform(sp_Oscillator *self, mrb_float lv_value);
static mrb_float sp_Oscillator_process(sp_Oscillator *self, mrb_float lv_pitch_input);
static mrb_float sp_Oscillator_pitch_to_freq_fast(sp_Oscillator *self, mrb_float lv_pitch);
static mrb_float sp_Oscillator_poly_blep(sp_Oscillator *self, mrb_float lv_t, mrb_float lv_dt);
static void sp_Filter_initialize(sp_Filter *self);
static mrb_int sp_Filter_set_sample_rate(sp_Filter *self, mrb_float lv_sample_rate);
static mrb_float sp_Filter_set_cutoff(sp_Filter *self, mrb_float lv_cutoff);
static mrb_float sp_Filter_set_modulation_amount(sp_Filter *self, mrb_float lv_amount);
static mrb_float sp_Filter_set_resonance(sp_Filter *self, mrb_float lv_resonance);
static mrb_float sp_Filter_process(sp_Filter *self, mrb_float lv_audio_input, mrb_float lv_modulation_input);
static mrb_int sp_Filter_update_coefficients_interleaved(sp_Filter *self);
static mrb_float sp_Filter_soft_clip(sp_Filter *self, mrb_float lv_sample);
static void sp_Amp_initialize(sp_Amp *self);
static mrb_float sp_Amp_set_sample_rate(sp_Amp *self, mrb_float lv_sample_rate);
static mrb_float sp_Amp_process(sp_Amp *self, mrb_float lv_audio_input, mrb_float lv_modulation_input);
static void sp_EnvGen_initialize(sp_EnvGen *self);
static mrb_float sp_EnvGen_set_sample_rate(sp_EnvGen *self, mrb_float lv_sample_rate);
static mrb_float sp_EnvGen_set_attack(sp_EnvGen *self, mrb_float lv_value);
static mrb_float sp_EnvGen_set_decay(sp_EnvGen *self, mrb_float lv_value);
static mrb_float sp_EnvGen_set_sustain(sp_EnvGen *self, mrb_float lv_value);
static mrb_float sp_EnvGen_process(sp_EnvGen *self, mrb_float lv_gate_input);
static sp_RbVal sp_EnvGen_update_coefficients_full(sp_EnvGen *self);
static mrb_float sp_EnvGen_calculate_exp_fast(sp_EnvGen *self, mrb_float lv_value);
static sp_Spms1 *sp_Spms1_new(void);
static sp_Oscillator *sp_Oscillator_new(void);
static sp_Filter *sp_Filter_new(void);
static sp_Amp *sp_Amp_new(void);
static sp_EnvGen *sp_EnvGen_new(void);
static sp_C *sp_C_new(void);

static mrb_int cst_SAW = 0;
static mrb_int cst_SQUARE = 0;
static sp_FloatArray * cst_FREQ_TABLE = NULL;
static mrb_float cst_SOFT_CLIP_CEILING = 0.0;
static mrb_float cst_SMOOTHING_TARGET_BLEND = 0.0;
static mrb_int cst_STATE_ATTACK = 0;
static mrb_int cst_STATE_SUSTAIN = 0;
static mrb_int cst_STATE_IDLE = 0;
static sp_FloatArray * cst_EXP_TABLE = NULL;
static mrb_float cst_SAMPLE_RATE = 0.0;
static mrb_int cst_BUFFER_WORDS = 0;

static void sp_mark_user_globals(void) {
  sp_re_mark_globals();
  if (cst_FREQ_TABLE) sp_gc_mark((void *)cst_FREQ_TABLE);
  if (cst_EXP_TABLE) sp_gc_mark((void *)cst_EXP_TABLE);
}

static int sp_poly_is_a(sp_RbVal obj, sp_Class klass);
static void sp_re_init(void) {
  sp_sym_name_fn = sp_sym_to_s;
  sp_user_exc_parent_fn = sp_user_exc_parent;
  sp_poly_is_a_hook = sp_poly_is_a;
  sp_gc_mark_globals_hook = sp_mark_user_globals;
  sp_json_sym_intern_fn = sp_sym_intern;
  sp_obj_inspect_fn = sp_obj_inspect_sw;
  sp_obj_to_s_fn = sp_obj_to_s_sw;
}

SP_POOL_DEFINE(Spms1)
static sp_Spms1 *sp_Spms1_new(void) {
  sp_Spms1 *self = SP_POOL_NEW(Spms1, NULL);
  memset(self, 0, sizeof(*self));
  SP_GC_ROOT(self);
  self->cls_id = 0;
  return self;
}
SP_POOL_DEFINE(Oscillator)
static sp_Oscillator *sp_Oscillator_new(void) {
  sp_Oscillator *self = SP_POOL_NEW(Oscillator, NULL);
  memset(self, 0, sizeof(*self));
  SP_GC_ROOT(self);
  self->cls_id = 1;
  self->iv_waveform = SP_INT_NIL;
  sp_Oscillator_initialize(self);
  return self;
}
SP_POOL_DEFINE(Filter)
static sp_Filter *sp_Filter_new(void) {
  sp_Filter *self = SP_POOL_NEW(Filter, NULL);
  memset(self, 0, sizeof(*self));
  SP_GC_ROOT(self);
  self->cls_id = 2;
  self->iv_interleave_state = SP_INT_NIL;
  self->iv_sample_counter = SP_INT_NIL;
  sp_Filter_initialize(self);
  return self;
}
SP_POOL_DEFINE(Amp)
static sp_Amp *sp_Amp_new(void) {
  sp_Amp *self = SP_POOL_NEW(Amp, NULL);
  memset(self, 0, sizeof(*self));
  SP_GC_ROOT(self);
  self->cls_id = 3;
  sp_Amp_initialize(self);
  return self;
}
SP_POOL_DEFINE(EnvGen)
static sp_EnvGen *sp_EnvGen_new(void) {
  sp_EnvGen *self = SP_POOL_NEW(EnvGen, NULL);
  memset(self, 0, sizeof(*self));
  SP_GC_ROOT(self);
  self->cls_id = 4;
  self->iv_state = SP_INT_NIL;
  self->iv_sample_counter = SP_INT_NIL;
  sp_EnvGen_initialize(self);
  return self;
}
SP_POOL_DEFINE(C)
static sp_C *sp_C_new(void) {
  sp_C *self = SP_POOL_NEW(C, NULL);
  memset(self, 0, sizeof(*self));
  SP_GC_ROOT(self);
  self->cls_id = 5;
  return self;
}
static const char *sp_obj_to_s_sw(int cls_id, void *p) {
  switch (cls_id) {
    default: return NULL;
  }
}
static const char *sp_obj_inspect_sw(int cls_id, void *p) {
  switch (cls_id) {
    case 0: {
      sp_Spms1 *o = (sp_Spms1 *)p; (void)o;
      sp_String *_s = sp_String_new(sp_sprintf("#<Spms1:0x%016llx", (unsigned long long)(uintptr_t)p));
      sp_String_append(_s, ">");
      return _s->data;
    }
    case 1: {
      sp_Oscillator *o = (sp_Oscillator *)p; (void)o;
      sp_String *_s = sp_String_new(sp_sprintf("#<Spms1::Oscillator:0x%016llx", (unsigned long long)(uintptr_t)p));
      sp_String_append(_s, " @sample_rate="); sp_String_append(_s, sp_poly_inspect(sp_box_float(o->iv_sample_rate)));
      sp_String_append(_s, ", @phase="); sp_String_append(_s, sp_poly_inspect(sp_box_float(o->iv_phase)));
      sp_String_append(_s, ", @waveform="); sp_String_append(_s, sp_poly_inspect((o->iv_waveform == SP_INT_NIL ? sp_box_nil() : sp_box_int(o->iv_waveform))));
      sp_String_append(_s, ">");
      return _s->data;
    }
    case 2: {
      sp_Filter *o = (sp_Filter *)p; (void)o;
      sp_String *_s = sp_String_new(sp_sprintf("#<Spms1::Filter:0x%016llx", (unsigned long long)(uintptr_t)p));
      sp_String_append(_s, " @sample_rate="); sp_String_append(_s, sp_poly_inspect(sp_box_float(o->iv_sample_rate)));
      sp_String_append(_s, ", @cutoff="); sp_String_append(_s, sp_poly_inspect(sp_box_float(o->iv_cutoff)));
      sp_String_append(_s, ", @resonance="); sp_String_append(_s, sp_poly_inspect(sp_box_float(o->iv_resonance)));
      sp_String_append(_s, ", @modulation_amount="); sp_String_append(_s, sp_poly_inspect(sp_box_float(o->iv_modulation_amount)));
      sp_String_append(_s, ", @current_cutoff="); sp_String_append(_s, sp_poly_inspect(sp_box_float(o->iv_current_cutoff)));
      sp_String_append(_s, ", @current_resonance="); sp_String_append(_s, sp_poly_inspect(sp_box_float(o->iv_current_resonance)));
      sp_String_append(_s, ", @b0="); sp_String_append(_s, sp_poly_inspect(sp_box_float(o->iv_b0)));
      sp_String_append(_s, ", @b1="); sp_String_append(_s, sp_poly_inspect(sp_box_float(o->iv_b1)));
      sp_String_append(_s, ", @b2="); sp_String_append(_s, sp_poly_inspect(sp_box_float(o->iv_b2)));
      sp_String_append(_s, ", @a1="); sp_String_append(_s, sp_poly_inspect(sp_box_float(o->iv_a1)));
      sp_String_append(_s, ", @a2="); sp_String_append(_s, sp_poly_inspect(sp_box_float(o->iv_a2)));
      sp_String_append(_s, ", @z1="); sp_String_append(_s, sp_poly_inspect(sp_box_float(o->iv_z1)));
      sp_String_append(_s, ", @z2="); sp_String_append(_s, sp_poly_inspect(sp_box_float(o->iv_z2)));
      sp_String_append(_s, ", @interleave_state="); sp_String_append(_s, sp_poly_inspect((o->iv_interleave_state == SP_INT_NIL ? sp_box_nil() : sp_box_int(o->iv_interleave_state))));
      sp_String_append(_s, ", @next_b0="); sp_String_append(_s, sp_poly_inspect(sp_box_float(o->iv_next_b0)));
      sp_String_append(_s, ", @next_b1="); sp_String_append(_s, sp_poly_inspect(sp_box_float(o->iv_next_b1)));
      sp_String_append(_s, ", @next_a1="); sp_String_append(_s, sp_poly_inspect(sp_box_float(o->iv_next_a1)));
      sp_String_append(_s, ", @next_a2="); sp_String_append(_s, sp_poly_inspect(sp_box_float(o->iv_next_a2)));
      sp_String_append(_s, ", @sample_counter="); sp_String_append(_s, sp_poly_inspect((o->iv_sample_counter == SP_INT_NIL ? sp_box_nil() : sp_box_int(o->iv_sample_counter))));
      sp_String_append(_s, ", @step_midi_cutoff="); sp_String_append(_s, sp_poly_inspect(sp_box_float(o->iv_step_midi_cutoff)));
      sp_String_append(_s, ", @step_omega="); sp_String_append(_s, sp_poly_inspect(sp_box_float(o->iv_step_omega)));
      sp_String_append(_s, ", @step_q="); sp_String_append(_s, sp_poly_inspect(sp_box_float(o->iv_step_q)));
      sp_String_append(_s, ", @step_sin_w="); sp_String_append(_s, sp_poly_inspect(sp_box_float(o->iv_step_sin_w)));
      sp_String_append(_s, ", @step_cos_w="); sp_String_append(_s, sp_poly_inspect(sp_box_float(o->iv_step_cos_w)));
      sp_String_append(_s, ", @step_inv_denom="); sp_String_append(_s, sp_poly_inspect(sp_box_float(o->iv_step_inv_denom)));
      sp_String_append(_s, ", @step_two_q="); sp_String_append(_s, sp_poly_inspect(sp_box_float(o->iv_step_two_q)));
      sp_String_append(_s, ">");
      return _s->data;
    }
    case 3: {
      sp_Amp *o = (sp_Amp *)p; (void)o;
      sp_String *_s = sp_String_new(sp_sprintf("#<Spms1::Amp:0x%016llx", (unsigned long long)(uintptr_t)p));
      sp_String_append(_s, " @sample_rate="); sp_String_append(_s, sp_poly_inspect(sp_box_float(o->iv_sample_rate)));
      sp_String_append(_s, ", @gain="); sp_String_append(_s, sp_poly_inspect(sp_box_float(o->iv_gain)));
      sp_String_append(_s, ">");
      return _s->data;
    }
    case 4: {
      sp_EnvGen *o = (sp_EnvGen *)p; (void)o;
      sp_String *_s = sp_String_new(sp_sprintf("#<Spms1::EnvGen:0x%016llx", (unsigned long long)(uintptr_t)p));
      sp_String_append(_s, " @sample_rate="); sp_String_append(_s, sp_poly_inspect(sp_box_float(o->iv_sample_rate)));
      sp_String_append(_s, ", @state="); sp_String_append(_s, sp_poly_inspect((o->iv_state == SP_INT_NIL ? sp_box_nil() : sp_box_int(o->iv_state))));
      sp_String_append(_s, ", @current_level="); sp_String_append(_s, sp_poly_inspect(sp_box_float(o->iv_current_level)));
      sp_String_append(_s, ", @attack="); sp_String_append(_s, sp_poly_inspect(sp_box_float(o->iv_attack)));
      sp_String_append(_s, ", @decay="); sp_String_append(_s, sp_poly_inspect(sp_box_float(o->iv_decay)));
      sp_String_append(_s, ", @sustain="); sp_String_append(_s, sp_poly_inspect(sp_box_float(o->iv_sustain)));
      sp_String_append(_s, ", @attack_target="); sp_String_append(_s, sp_poly_inspect(sp_box_float(o->iv_attack_target)));
      sp_String_append(_s, ", @was_gate_on="); sp_String_append(_s, sp_poly_inspect(sp_box_bool(o->iv_was_gate_on)));
      sp_String_append(_s, ", @attack_coef="); sp_String_append(_s, sp_poly_inspect(sp_box_float(o->iv_attack_coef)));
      sp_String_append(_s, ", @decay_coef="); sp_String_append(_s, sp_poly_inspect(sp_box_float(o->iv_decay_coef)));
      sp_String_append(_s, ", @sample_counter="); sp_String_append(_s, sp_poly_inspect((o->iv_sample_counter == SP_INT_NIL ? sp_box_nil() : sp_box_int(o->iv_sample_counter))));
      sp_String_append(_s, ">");
      return _s->data;
    }
    case 5: {
      sp_C *o = (sp_C *)p; (void)o;
      sp_String *_s = sp_String_new(sp_sprintf("#<Spms1::C:0x%016llx", (unsigned long long)(uintptr_t)p));
      sp_String_append(_s, ">");
      return _s->data;
    }
    default: return "#<Object>";
  }
}
#line 15 "spms_1_oscillator.rb"
static void sp_Oscillator_initialize(sp_Oscillator *self) {
    SP_GC_SAVE();
#line 16 "spms_1_oscillator.rb"
  self->iv_sample_rate = 48000.0;
#line 17 "spms_1_oscillator.rb"
  self->iv_phase = 0.0;
#line 18 "spms_1_oscillator.rb"
  self->iv_waveform = cst_SAW;
}
#line 23 "spms_1_oscillator.rb"
static mrb_float sp_Oscillator_set_sample_rate(sp_Oscillator *self, mrb_float lv_sample_rate) {
    SP_GC_SAVE();
#line 24 "spms_1_oscillator.rb"
  self->iv_sample_rate = lv_sample_rate;
  return 0.0;
}
#line 29 "spms_1_oscillator.rb"
static mrb_int sp_Oscillator_set_waveform(sp_Oscillator *self, mrb_float lv_value) {
    SP_GC_SAVE();
#line 30 "spms_1_oscillator.rb"
  self->iv_waveform = (((lv_value >= 0.5)) ? cst_SQUARE : cst_SAW);
  return 0;
}
#line 36 "spms_1_oscillator.rb"
static mrb_float sp_Oscillator_process(sp_Oscillator *self, mrb_float lv_pitch_input) {
    SP_GC_SAVE();
    mrb_float lv_pitch = 0.0;
    mrb_float lv_freq = 0.0;
    mrb_float lv_current_dt = 0.0;
    mrb_float lv_output = 0.0;
    mrb_float lv_naive_saw = 0.0;
    mrb_float lv_naive_square = 0.0;
    mrb_float lv_blep_0 = 0.0;
    mrb_float lv_phase_05 = 0.0;
    mrb_float lv_blep_05 = 0.0;
#line 38 "spms_1_oscillator.rb"
  lv_pitch = (((lv_pitch_input < -0.5)) ? -0.5 : ((((lv_pitch_input > 0.5)) ? 0.5 : lv_pitch_input)));
#line 41 "spms_1_oscillator.rb"
  mrb_float _t1 = lv_pitch;
  lv_freq = sp_Oscillator_pitch_to_freq_fast((sp_Oscillator *)self, _t1);
#line 44 "spms_1_oscillator.rb"
  lv_current_dt = (lv_freq / self->iv_sample_rate);
#line 45 "spms_1_oscillator.rb"
  lv_output = 0.0;
#line 48 "spms_1_oscillator.rb"
  mrb_int _t2 = self->iv_waveform;
  if ((_t2 == cst_SAW)) {
#line 51 "spms_1_oscillator.rb"
    lv_naive_saw = ((-2.0 * self->iv_phase) + 1.0);
#line 53 "spms_1_oscillator.rb"
    mrb_float _t3 = self->iv_phase;
    mrb_float _t4 = lv_current_dt;
    lv_output = (lv_naive_saw + sp_Oscillator_poly_blep((sp_Oscillator *)self, _t3, _t4));
  }
  else if ((_t2 == cst_SQUARE)) {
#line 57 "spms_1_oscillator.rb"
    lv_naive_square = (((self->iv_phase < 0.5)) ? 1.0 : -1.0);
#line 60 "spms_1_oscillator.rb"
    mrb_float _t5 = self->iv_phase;
    mrb_float _t6 = lv_current_dt;
    lv_blep_0 = sp_Oscillator_poly_blep((sp_Oscillator *)self, _t5, _t6);
#line 63 "spms_1_oscillator.rb"
    lv_phase_05 = (self->iv_phase + 0.5);
#line 64 "spms_1_oscillator.rb"
    if ((lv_phase_05 >= 1.0)) {
#line 65 "spms_1_oscillator.rb"
      lv_phase_05 -= 1.0;
    }
#line 69 "spms_1_oscillator.rb"
    mrb_float _t7 = lv_phase_05;
    mrb_float _t8 = lv_current_dt;
    lv_blep_05 = sp_Oscillator_poly_blep((sp_Oscillator *)self, _t7, _t8);
#line 70 "spms_1_oscillator.rb"
    lv_output = ((lv_naive_square + lv_blep_0) - lv_blep_05);
  }
#line 74 "spms_1_oscillator.rb"
  self->iv_phase += lv_current_dt;
#line 75 "spms_1_oscillator.rb"
  if ((self->iv_phase >= 1.0)) {
#line 76 "spms_1_oscillator.rb"
    self->iv_phase -= 1.0;
  }
#line 80 "spms_1_oscillator.rb"
  return (lv_output * 0.5);
  return 0.0;
}
#line 87 "spms_1_oscillator.rb"
static mrb_float sp_Oscillator_pitch_to_freq_fast(sp_Oscillator *self, mrb_float lv_pitch) {
    SP_GC_SAVE();
    mrb_float lv_midi_pitch = 0.0;
    mrb_int lv_index = 0;
    mrb_float lv_fraction = 0.0;
    mrb_float lv_f0 = 0.0;
    mrb_float lv_f1 = 0.0;
#line 89 "spms_1_oscillator.rb"
  lv_midi_pitch = (((lv_pitch + 0.5)) * 120.0);
#line 90 "spms_1_oscillator.rb"
  lv_index = sp_float_to_i_checked(lv_midi_pitch);
#line 91 "spms_1_oscillator.rb"
  lv_fraction = (lv_midi_pitch - ((mrb_float)(lv_index)));
#line 93 "spms_1_oscillator.rb"
  lv_f0 = sp_FloatArray_get(cst_FREQ_TABLE, lv_index);
#line 94 "spms_1_oscillator.rb"
  lv_f1 = sp_FloatArray_get(cst_FREQ_TABLE, sp_int_add(lv_index, 1LL));
#line 97 "spms_1_oscillator.rb"
  return (lv_f0 + (lv_fraction * ((lv_f1 - lv_f0))));
  return 0.0;
}
#line 104 "spms_1_oscillator.rb"
static mrb_float sp_Oscillator_poly_blep(sp_Oscillator *self, mrb_float lv_t, mrb_float lv_dt) {
    SP_GC_SAVE();
    mrb_float lv_num = 0.0;
#line 105 "spms_1_oscillator.rb"
  if ((lv_t < lv_dt)) {
#line 107 "spms_1_oscillator.rb"
    lv_num = (lv_t / lv_dt);
#line 108 "spms_1_oscillator.rb"
    return (((lv_num + lv_num) - (lv_num * lv_num)) - 1.0);
  }
  else {
    if ((lv_t > (1.0 - lv_dt))) {
#line 111 "spms_1_oscillator.rb"
      lv_num = (((lv_t - 1.0)) / lv_dt);
#line 112 "spms_1_oscillator.rb"
      return ((((lv_num * lv_num) + lv_num) + lv_num) + 1.0);
    }
    else {
#line 115 "spms_1_oscillator.rb"
      return 0.0;
    }
  }
  return 0.0;
}
#line 12 "spms_1_filter.rb"
static void sp_Filter_initialize(sp_Filter *self) {
    SP_GC_SAVE();
#line 13 "spms_1_filter.rb"
  self->iv_sample_rate = 48000.0;
#line 14 "spms_1_filter.rb"
  self->iv_cutoff = 1.0;
#line 15 "spms_1_filter.rb"
  self->iv_resonance = 0.0;
#line 18 "spms_1_filter.rb"
  self->iv_modulation_amount = 0.0;
#line 21 "spms_1_filter.rb"
  self->iv_current_cutoff = 1.0;
#line 22 "spms_1_filter.rb"
  self->iv_current_resonance = 0.0;
#line 25 "spms_1_filter.rb"
  self->iv_b0 = 1.0;
  self->iv_b1 = 0.0;
  self->iv_b2 = 0.0;
#line 26 "spms_1_filter.rb"
  self->iv_a1 = 0.0;
  self->iv_a2 = 0.0;
#line 27 "spms_1_filter.rb"
  self->iv_z1 = 0.0;
  self->iv_z2 = 0.0;
#line 30 "spms_1_filter.rb"
  self->iv_interleave_state = 0LL;
#line 31 "spms_1_filter.rb"
  self->iv_next_b0 = 1.0;
#line 32 "spms_1_filter.rb"
  self->iv_next_b1 = 0.0;
#line 33 "spms_1_filter.rb"
  self->iv_next_a1 = 0.0;
#line 34 "spms_1_filter.rb"
  self->iv_next_a2 = 0.0;
#line 37 "spms_1_filter.rb"
  self->iv_sample_counter = 0LL;
#line 39 "spms_1_filter.rb"
  sp_Filter_update_coefficients_interleaved((sp_Filter *)self);
}
#line 44 "spms_1_filter.rb"
static mrb_int sp_Filter_set_sample_rate(sp_Filter *self, mrb_float lv_sample_rate) {
    SP_GC_SAVE();
#line 45 "spms_1_filter.rb"
  self->iv_sample_rate = lv_sample_rate;
#line 46 "spms_1_filter.rb"
  return sp_Filter_update_coefficients_interleaved((sp_Filter *)self);
  return 0;
}
#line 51 "spms_1_filter.rb"
static mrb_float sp_Filter_set_cutoff(sp_Filter *self, mrb_float lv_cutoff) {
    SP_GC_SAVE();
#line 52 "spms_1_filter.rb"
  self->iv_cutoff = (((lv_cutoff < 0.0)) ? 0.0 : ((((lv_cutoff > 1.0)) ? 1.0 : lv_cutoff)));
  return 0.0;
}
#line 57 "spms_1_filter.rb"
static mrb_float sp_Filter_set_modulation_amount(sp_Filter *self, mrb_float lv_amount) {
    SP_GC_SAVE();
#line 58 "spms_1_filter.rb"
  self->iv_modulation_amount = (((lv_amount < -1.0)) ? -1.0 : ((((lv_amount > 1.0)) ? 1.0 : lv_amount)));
  return 0.0;
}
#line 63 "spms_1_filter.rb"
static mrb_float sp_Filter_set_resonance(sp_Filter *self, mrb_float lv_resonance) {
    SP_GC_SAVE();
#line 64 "spms_1_filter.rb"
  self->iv_resonance = (((lv_resonance < 0.0)) ? 0.0 : ((((lv_resonance > 1.0)) ? 1.0 : lv_resonance)));
  return 0.0;
}
#line 71 "spms_1_filter.rb"
static mrb_float sp_Filter_process(sp_Filter *self, mrb_float lv_audio_input, mrb_float lv_modulation_input) {
    SP_GC_SAVE();
    mrb_float lv_mod = 0.0;
    mrb_float lv_total_cutoff = 0.0;
    mrb_float lv_clamped_cutoff = 0.0;
    mrb_float lv_audio_output = 0.0;
#line 73 "spms_1_filter.rb"
  if ((self->iv_sample_counter == 0LL)) {
#line 75 "spms_1_filter.rb"
    lv_mod = (((lv_modulation_input < 0.0)) ? 0.0 : ((((lv_modulation_input > 1.0)) ? 1.0 : lv_modulation_input)));
#line 76 "spms_1_filter.rb"
    lv_total_cutoff = (self->iv_cutoff + ((lv_mod * self->iv_modulation_amount)));
#line 77 "spms_1_filter.rb"
    lv_clamped_cutoff = (((lv_total_cutoff < 0.0)) ? 0.0 : ((((lv_total_cutoff > 1.0)) ? 1.0 : lv_total_cutoff)));
#line 80 "spms_1_filter.rb"
    self->iv_current_cutoff += (((lv_clamped_cutoff - self->iv_current_cutoff)) * cst_SMOOTHING_TARGET_BLEND);
#line 81 "spms_1_filter.rb"
    self->iv_current_resonance += (((self->iv_resonance - self->iv_current_resonance)) * cst_SMOOTHING_TARGET_BLEND);
#line 84 "spms_1_filter.rb"
    sp_Filter_update_coefficients_interleaved((sp_Filter *)self);
  }
#line 88 "spms_1_filter.rb"
  self->iv_sample_counter = ((sp_int_add(self->iv_sample_counter, 1LL)) & 7LL);
#line 91 "spms_1_filter.rb"
  lv_audio_output = (self->iv_z1 + (self->iv_b0 * lv_audio_input));
#line 92 "spms_1_filter.rb"
  mrb_float _t9 = ((self->iv_z2 + (self->iv_b1 * lv_audio_input)) - (self->iv_a1 * lv_audio_output));
  self->iv_z1 = sp_Filter_soft_clip((sp_Filter *)self, _t9);
#line 93 "spms_1_filter.rb"
  mrb_float _t10 = ((self->iv_b2 * lv_audio_input) - (self->iv_a2 * lv_audio_output));
  self->iv_z2 = sp_Filter_soft_clip((sp_Filter *)self, _t10);
#line 95 "spms_1_filter.rb"
  return lv_audio_output;
  return 0.0;
}
#line 103 "spms_1_filter.rb"
static mrb_int sp_Filter_update_coefficients_interleaved(sp_Filter *self) {
    SP_GC_SAVE();
    mrb_float lv_cutoff_freq = 0.0;
    mrb_float lv_midi_resonance = 0.0;
    mrb_float lv_base_q = 0.0;
    mrb_float lv_raw_b0 = 0.0;
#line 104 "spms_1_filter.rb"
  mrb_int _t11 = self->iv_interleave_state;
  switch (_t11) {
  case 0LL:
  {
#line 107 "spms_1_filter.rb"
    self->iv_step_midi_cutoff = (self->iv_current_cutoff * 127.0);
    break;
  }
  case 1LL:
  {
#line 110 "spms_1_filter.rb"
    lv_cutoff_freq = (440.0 * (sp_float_pow(2.0, ((((self->iv_step_midi_cutoff - 63.0)) * ((1.0 / 12.0)))))));
#line 112 "spms_1_filter.rb"
    self->iv_step_omega = (((2.0 * M_PI) * lv_cutoff_freq) / self->iv_sample_rate);
    break;
  }
  case 2LL:
  {
#line 115 "spms_1_filter.rb"
    lv_midi_resonance = (self->iv_current_resonance * 127.0);
#line 116 "spms_1_filter.rb"
    lv_base_q = 0.70710678118654757;
#line 117 "spms_1_filter.rb"
    self->iv_step_q = (lv_base_q * (sp_float_pow(2.0, ((lv_midi_resonance * ((1.0 / 32.0)))))));
    break;
  }
  case 3LL:
  {
#line 120 "spms_1_filter.rb"
    self->iv_step_sin_w = sin((mrb_float)(self->iv_step_omega));
#line 121 "spms_1_filter.rb"
    self->iv_step_cos_w = cos((mrb_float)(self->iv_step_omega));
    break;
  }
  case 4LL:
  {
#line 124 "spms_1_filter.rb"
    self->iv_step_inv_denom = (1.0 / ((((2.0 * self->iv_step_q)) + self->iv_step_sin_w)));
    break;
  }
  case 5LL:
  {
#line 127 "spms_1_filter.rb"
    self->iv_step_two_q = (2.0 * self->iv_step_q);
#line 128 "spms_1_filter.rb"
    lv_raw_b0 = ((((1.0 - self->iv_step_cos_w)) * 0.5) * self->iv_step_two_q);
#line 129 "spms_1_filter.rb"
    self->iv_next_b0 = (lv_raw_b0 * self->iv_step_inv_denom);
    break;
  }
  case 6LL:
  {
#line 132 "spms_1_filter.rb"
    self->iv_next_b1 = ((((1.0 - self->iv_step_cos_w)) * self->iv_step_two_q) * self->iv_step_inv_denom);
#line 133 "spms_1_filter.rb"
    self->iv_next_a1 = (((-4.0 * self->iv_step_cos_w) * self->iv_step_q) * self->iv_step_inv_denom);
#line 134 "spms_1_filter.rb"
    self->iv_next_a2 = (((self->iv_step_two_q - self->iv_step_sin_w)) * self->iv_step_inv_denom);
    break;
  }
  default: {
#line 137 "spms_1_filter.rb"
    self->iv_b0 = self->iv_next_b0;
#line 138 "spms_1_filter.rb"
    self->iv_b1 = self->iv_next_b1;
#line 139 "spms_1_filter.rb"
    self->iv_b2 = self->iv_next_b0;
#line 140 "spms_1_filter.rb"
    self->iv_a1 = self->iv_next_a1;
#line 141 "spms_1_filter.rb"
    self->iv_a2 = self->iv_next_a2;
  }
  }
#line 145 "spms_1_filter.rb"
  self->iv_interleave_state = ((sp_int_add(self->iv_interleave_state, 1LL)) & 7LL);
  return 0;
}
#line 154 "spms_1_filter.rb"
static mrb_float sp_Filter_soft_clip(sp_Filter *self, mrb_float lv_sample) {
    SP_GC_SAVE();
#line 155 "spms_1_filter.rb"
  if ((lv_sample > cst_SOFT_CLIP_CEILING)) {
#line 156 "spms_1_filter.rb"
    return (((2.0 / 3.0)) * cst_SOFT_CLIP_CEILING);
  }
  else {
    if ((lv_sample < (-cst_SOFT_CLIP_CEILING))) {
#line 158 "spms_1_filter.rb"
      return ((-((2.0 / 3.0))) * cst_SOFT_CLIP_CEILING);
    }
    else {
#line 161 "spms_1_filter.rb"
      return (lv_sample - (((((((lv_sample * ((1.0 / cst_SOFT_CLIP_CEILING)))) * ((lv_sample * ((1.0 / cst_SOFT_CLIP_CEILING))))) * ((lv_sample * ((1.0 / cst_SOFT_CLIP_CEILING)))))) * ((1.0 / 3.0))) * cst_SOFT_CLIP_CEILING));
    }
  }
  return 0.0;
}
#line 5 "spms_1_amp.rb"
static void sp_Amp_initialize(sp_Amp *self) {
    SP_GC_SAVE();
#line 6 "spms_1_amp.rb"
  self->iv_sample_rate = 48000.0;
#line 8 "spms_1_amp.rb"
  self->iv_gain = 1.0;
}
#line 13 "spms_1_amp.rb"
static mrb_float sp_Amp_set_sample_rate(sp_Amp *self, mrb_float lv_sample_rate) {
    SP_GC_SAVE();
#line 14 "spms_1_amp.rb"
  self->iv_sample_rate = lv_sample_rate;
  return 0.0;
}
#line 27 "spms_1_amp.rb"
static mrb_float sp_Amp_process(sp_Amp *self, mrb_float lv_audio_input, mrb_float lv_modulation_input) {
    SP_GC_SAVE();
    mrb_float lv_mod = 0.0;
    mrb_float lv_total_gain = 0.0;
#line 29 "spms_1_amp.rb"
  lv_mod = (((lv_modulation_input < -1.0)) ? -1.0 : ((((lv_modulation_input > 1.0)) ? 1.0 : lv_modulation_input)));
#line 32 "spms_1_amp.rb"
  lv_total_gain = (self->iv_gain * lv_mod);
#line 35 "spms_1_amp.rb"
  return (lv_audio_input * lv_total_gain);
  return 0.0;
}
#line 19 "spms_1_env_gen.rb"
static void sp_EnvGen_initialize(sp_EnvGen *self) {
    SP_GC_SAVE();
#line 20 "spms_1_env_gen.rb"
  self->iv_sample_rate = 48000.0;
#line 21 "spms_1_env_gen.rb"
  self->iv_state = cst_STATE_IDLE;
#line 22 "spms_1_env_gen.rb"
  self->iv_current_level = 0.0;
#line 25 "spms_1_env_gen.rb"
  self->iv_attack = 0.0;
#line 26 "spms_1_env_gen.rb"
  self->iv_decay = 0.0;
#line 27 "spms_1_env_gen.rb"
  self->iv_sustain = 1.0;
#line 30 "spms_1_env_gen.rb"
  self->iv_attack_target = 2.0;
#line 33 "spms_1_env_gen.rb"
  self->iv_was_gate_on = 0;
#line 36 "spms_1_env_gen.rb"
  self->iv_attack_coef = 1.0;
#line 37 "spms_1_env_gen.rb"
  self->iv_decay_coef = 1.0;
#line 40 "spms_1_env_gen.rb"
  self->iv_sample_counter = 0LL;
#line 43 "spms_1_env_gen.rb"
  sp_EnvGen_update_coefficients_full((sp_EnvGen *)self);
}
#line 48 "spms_1_env_gen.rb"
static mrb_float sp_EnvGen_set_sample_rate(sp_EnvGen *self, mrb_float lv_sample_rate) {
    SP_GC_SAVE();
#line 49 "spms_1_env_gen.rb"
  self->iv_sample_rate = lv_sample_rate;
  return 0.0;
}
#line 54 "spms_1_env_gen.rb"
static mrb_float sp_EnvGen_set_attack(sp_EnvGen *self, mrb_float lv_value) {
    SP_GC_SAVE();
#line 55 "spms_1_env_gen.rb"
  self->iv_attack = (((lv_value < 0.0)) ? 0.0 : ((((lv_value > 1.0)) ? 1.0 : lv_value)));
  return 0.0;
}
#line 60 "spms_1_env_gen.rb"
static mrb_float sp_EnvGen_set_decay(sp_EnvGen *self, mrb_float lv_value) {
    SP_GC_SAVE();
#line 61 "spms_1_env_gen.rb"
  self->iv_decay = (((lv_value < 0.0)) ? 0.0 : ((((lv_value > 1.0)) ? 1.0 : lv_value)));
  return 0.0;
}
#line 66 "spms_1_env_gen.rb"
static mrb_float sp_EnvGen_set_sustain(sp_EnvGen *self, mrb_float lv_value) {
    SP_GC_SAVE();
#line 67 "spms_1_env_gen.rb"
  self->iv_sustain = (((lv_value < 0.0)) ? 0.0 : ((((lv_value > 1.0)) ? 1.0 : lv_value)));
  return 0.0;
}
#line 73 "spms_1_env_gen.rb"
static mrb_float sp_EnvGen_process(sp_EnvGen *self, mrb_float lv_gate_input) {
    SP_GC_SAVE();
    mrb_bool lv_is_gate_on = 0;
#line 75 "spms_1_env_gen.rb"
  if ((self->iv_sample_counter == 0LL)) {
#line 76 "spms_1_env_gen.rb"
    lv_is_gate_on = (lv_gate_input >= 0.5);
#line 79 "spms_1_env_gen.rb"
    if ((lv_is_gate_on && (!self->iv_was_gate_on))) {
#line 80 "spms_1_env_gen.rb"
      self->iv_state = cst_STATE_ATTACK;
    }
    else {
      if (((!lv_is_gate_on) && self->iv_was_gate_on)) {
#line 82 "spms_1_env_gen.rb"
        self->iv_state = cst_STATE_SUSTAIN;
      }
    }
#line 85 "spms_1_env_gen.rb"
    self->iv_was_gate_on = lv_is_gate_on;
#line 88 "spms_1_env_gen.rb"
    sp_EnvGen_update_coefficients_full((sp_EnvGen *)self);
#line 91 "spms_1_env_gen.rb"
    mrb_int _t14 = self->iv_state;
    if ((_t14 == cst_STATE_ATTACK)) {
#line 93 "spms_1_env_gen.rb"
      self->iv_current_level += (((self->iv_attack_target - self->iv_current_level)) * self->iv_attack_coef);
#line 94 "spms_1_env_gen.rb"
      if ((self->iv_current_level >= 1.0)) {
#line 95 "spms_1_env_gen.rb"
        self->iv_state = cst_STATE_SUSTAIN;
#line 96 "spms_1_env_gen.rb"
        self->iv_current_level = 1.0;
      }
#line 100 "spms_1_env_gen.rb"
      if (!(self->iv_was_gate_on)) {
#line 101 "spms_1_env_gen.rb"
        self->iv_state = cst_STATE_SUSTAIN;
      }
    }
    else if ((_t14 == cst_STATE_SUSTAIN)) {
#line 105 "spms_1_env_gen.rb"
      if (self->iv_was_gate_on) {
#line 107 "spms_1_env_gen.rb"
        self->iv_current_level += (((self->iv_sustain - self->iv_current_level)) * self->iv_decay_coef);
      }
      else {
#line 110 "spms_1_env_gen.rb"
        self->iv_current_level += (((0.0 - self->iv_current_level)) * self->iv_decay_coef);
#line 113 "spms_1_env_gen.rb"
        if ((self->iv_current_level < 1.0000000000000001e-05)) {
#line 114 "spms_1_env_gen.rb"
          self->iv_state = cst_STATE_IDLE;
#line 115 "spms_1_env_gen.rb"
          self->iv_current_level = 0.0;
        }
      }
    }
    else {
#line 121 "spms_1_env_gen.rb"
      if (self->iv_was_gate_on) {
#line 122 "spms_1_env_gen.rb"
        self->iv_state = cst_STATE_ATTACK;
      }
      else {
#line 124 "spms_1_env_gen.rb"
        self->iv_current_level = 0.0;
      }
    }
  }
#line 130 "spms_1_env_gen.rb"
  self->iv_sample_counter = ((sp_int_add(self->iv_sample_counter, 1LL)) & 7LL);
#line 133 "spms_1_env_gen.rb"
  return self->iv_current_level;
  return 0.0;
}
#line 140 "spms_1_env_gen.rb"
static sp_RbVal sp_EnvGen_update_coefficients_full(sp_EnvGen *self) {
    SP_GC_SAVE();
    mrb_float lv_effective_rate = 0.0;
    mrb_float lv_attack_time = 0.0;
    mrb_float lv_decay_time = 0.0;
#line 141 "spms_1_env_gen.rb"
  lv_effective_rate = (self->iv_sample_rate * ((1.0 / 8.0)));
#line 148 "spms_1_env_gen.rb"
  mrb_float _t15 = self->iv_attack;
  lv_attack_time = (0.093770000000000006 * sp_EnvGen_calculate_exp_fast((sp_EnvGen *)self, _t15));
#line 149 "spms_1_env_gen.rb"
  self->iv_attack_coef = (1.0 / ((lv_attack_time * lv_effective_rate)));
#line 150 "spms_1_env_gen.rb"
  if ((self->iv_attack_coef > 1.0)) {
    self->iv_attack_coef = 1.0;
  }
#line 157 "spms_1_env_gen.rb"
  mrb_float _t16 = self->iv_decay;
  lv_decay_time = (0.028850000000000001 * sp_EnvGen_calculate_exp_fast((sp_EnvGen *)self, _t16));
#line 158 "spms_1_env_gen.rb"
  self->iv_decay_coef = (1.0 / ((lv_decay_time * lv_effective_rate)));
#line 159 "spms_1_env_gen.rb"
  if ((self->iv_decay_coef > 1.0)) {
    self->iv_decay_coef = 1.0;
  }
  return sp_box_nil();
}
#line 164 "spms_1_env_gen.rb"
static mrb_float sp_EnvGen_calculate_exp_fast(sp_EnvGen *self, mrb_float lv_value) {
    SP_GC_SAVE();
    mrb_float lv_v_scale = 0.0;
    mrb_int lv_index = 0;
    mrb_float lv_fraction = 0.0;
    mrb_float lv_e0 = 0.0;
    mrb_float lv_e1 = 0.0;
#line 165 "spms_1_env_gen.rb"
  lv_v_scale = (lv_value * 127.0);
#line 166 "spms_1_env_gen.rb"
  lv_index = sp_float_to_i_checked(lv_v_scale);
#line 167 "spms_1_env_gen.rb"
  lv_fraction = (lv_v_scale - ((mrb_float)(lv_index)));
#line 169 "spms_1_env_gen.rb"
  lv_e0 = sp_FloatArray_get(cst_EXP_TABLE, lv_index);
#line 170 "spms_1_env_gen.rb"
  lv_e1 = sp_FloatArray_get(cst_EXP_TABLE, sp_int_add(lv_index, 1LL));
#line 172 "spms_1_env_gen.rb"
  return (lv_e0 + (lv_fraction * ((lv_e1 - lv_e0))));
  return 0.0;
}
int Spms1_main(int argc,char**argv){
    SP_GC_SAVE();
    sp_re_init();
    mrb_int lv_i = 0;
    sp_Oscillator * lv_oscillator = NULL;
    SP_GC_ROOT(lv_oscillator);
    sp_Filter * lv_filter = NULL;
    SP_GC_ROOT(lv_filter);
    sp_EnvGen * lv_env_gen = NULL;
    SP_GC_ROOT(lv_env_gen);
    sp_Amp * lv_amp = NULL;
    SP_GC_ROOT(lv_amp);
    sp_FloatArray * lv_audio_buffer = NULL;
    SP_GC_ROOT(lv_audio_buffer);
    volatile mrb_float lv_pitch = 0.0;
    volatile mrb_float lv_gate = 0.0;
    volatile mrb_float lv_env_gen_output = 0.0;
    volatile mrb_float lv_oscillator_output = 0.0;
    volatile mrb_float lv_filter_output = 0.0;
    volatile mrb_float lv_amp_output = 0.0;
    mrb_int lv_i__bp1642 = 0;
    mrb_int lv_i__bp1679 = 0;

#line 1 "spms_1_oscillator.rb"
#line 4 "spms_1_oscillator.rb"
#line 5 "spms_1_oscillator.rb"
  cst_SAW = 0LL;
#line 6 "spms_1_oscillator.rb"
  cst_SQUARE = 1LL;
#line 10 "spms_1_oscillator.rb"
  mrb_int _t18 = 129LL;
  if (_t18 < 0) sp_raise_cls("ArgumentError", "negative array size");
  mrb_float _t19 = 0.0;
  sp_FloatArray *_t20 = sp_FloatArray_new();
  SP_GC_ROOT(_t20);
  for (mrb_int _t21 = 0; _t21 < _t18; _t21++) sp_FloatArray_push(_t20, _t19);
  cst_FREQ_TABLE = _t20;
#line 11 "spms_1_oscillator.rb"
  { mrb_int _t22 = 129LL;
    for (lv_i = 0LL; lv_i < _t22; lv_i++) {
#line 12 "spms_1_oscillator.rb"
      sp_FloatArray_set(cst_FREQ_TABLE, lv_i, (440.0 * (sp_float_pow(2.0, ((((((mrb_float)(lv_i)) - 69.0)) * ((1.0 / 12.0))))))));
    }
  }
#line 1 "spms_1_filter.rb"
#line 4 "spms_1_filter.rb"
#line 6 "spms_1_filter.rb"
  cst_SOFT_CLIP_CEILING = 8.0;
#line 10 "spms_1_filter.rb"
  cst_SMOOTHING_TARGET_BLEND = 0.0625;
#line 1 "spms_1_amp.rb"
#line 4 "spms_1_amp.rb"
#line 1 "spms_1_env_gen.rb"
#line 6 "spms_1_env_gen.rb"
#line 8 "spms_1_env_gen.rb"
  cst_STATE_ATTACK = 0LL;
#line 9 "spms_1_env_gen.rb"
  cst_STATE_SUSTAIN = 1LL;
#line 10 "spms_1_env_gen.rb"
  cst_STATE_IDLE = 2LL;
#line 14 "spms_1_env_gen.rb"
  mrb_int _t24 = 129LL;
  if (_t24 < 0) sp_raise_cls("ArgumentError", "negative array size");
  mrb_float _t25 = 0.0;
  sp_FloatArray *_t26 = sp_FloatArray_new();
  SP_GC_ROOT(_t26);
  for (mrb_int _t27 = 0; _t27 < _t24; _t27++) sp_FloatArray_push(_t26, _t25);
  cst_EXP_TABLE = _t26;
#line 15 "spms_1_env_gen.rb"
  { mrb_int _t28 = 129LL;
    for (lv_i = 0LL; lv_i < _t28; lv_i++) {
#line 16 "spms_1_env_gen.rb"
      sp_FloatArray_set(cst_EXP_TABLE, lv_i, sp_float_pow(10.0, ((((((mrb_float)(lv_i)) - 64.0)) * ((1.0 / 32.0))))));
    }
  }
#line 6 "spms_1_main.rb"
#line 7 "spms_1_main.rb"
#line 19 "spms_1_main.rb"
  cst_SAMPLE_RATE = ((mrb_float)(((mrb_int)(get_sample_rate()))));
#line 20 "spms_1_main.rb"
  cst_BUFFER_WORDS = ((mrb_int)(get_audio_buffer_words()));
#line 22 "spms_1_main.rb"
  lv_oscillator = sp_Oscillator_new();
#line 23 "spms_1_main.rb"
  mrb_float _t32 = cst_SAMPLE_RATE;
  sp_Oscillator_set_sample_rate((sp_Oscillator *)lv_oscillator, _t32);
#line 25 "spms_1_main.rb"
  lv_filter = sp_Filter_new();
#line 26 "spms_1_main.rb"
  mrb_float _t34 = cst_SAMPLE_RATE;
  sp_Filter_set_sample_rate((sp_Filter *)lv_filter, _t34);
#line 28 "spms_1_main.rb"
  lv_env_gen = sp_EnvGen_new();
#line 29 "spms_1_main.rb"
  mrb_float _t36 = cst_SAMPLE_RATE;
  sp_EnvGen_set_sample_rate((sp_EnvGen *)lv_env_gen, _t36);
#line 31 "spms_1_main.rb"
  lv_amp = sp_Amp_new();
#line 32 "spms_1_main.rb"
  mrb_float _t38 = cst_SAMPLE_RATE;
  sp_Amp_set_sample_rate((sp_Amp *)lv_amp, _t38);
#line 34 "spms_1_main.rb"
  mrb_int _t40 = cst_BUFFER_WORDS;
  if (_t40 < 0) sp_raise_cls("ArgumentError", "negative array size");
  mrb_float _t41 = 0.0;
  sp_FloatArray *_t42 = sp_FloatArray_new();
  SP_GC_ROOT(_t42);
  for (mrb_int _t43 = 0; _t43 < _t40; _t43++) sp_FloatArray_push(_t42, _t41);
  lv_audio_buffer = _t42;
#line 36 "spms_1_main.rb"
  int _gcb44 = sp_gc_nroots; (void)_gcb44;
  sp_exc_msg[sp_exc_top] = 0; sp_exc_obj[sp_exc_top] = 0; sp_exc_top++;
  if (setjmp(sp_exc_stack[sp_exc_top-1]) == 0) {
    for (;;) {
      lv_pitch = sp_float_nil();
      lv_gate = sp_float_nil();
#line 37 "spms_1_main.rb"
      (debug_measure_begin(), (mrb_int)0);
#line 39 "spms_1_main.rb"
      lv_pitch = ((((mrb_float)(((mrb_int)(get_midi_note_on_pitch())))) * ((1.0 / 120.0))) - 0.5);
#line 40 "spms_1_main.rb"
      lv_gate = ((mrb_float)(((mrb_int)(get_midi_note_on_state()))));
#line 42 "spms_1_main.rb"
      mrb_float _t48 = (((mrb_float)(((mrb_int)(get_midi_cc_value(((uint8_t)(20LL))))))) * ((1.0 / 127.0)));
      sp_Oscillator_set_waveform((sp_Oscillator *)lv_oscillator, _t48);
#line 43 "spms_1_main.rb"
      mrb_float _t50 = (((mrb_float)(((mrb_int)(get_midi_cc_value(((uint8_t)(74LL))))))) * ((1.0 / 127.0)));
      sp_Filter_set_cutoff((sp_Filter *)lv_filter, _t50);
#line 44 "spms_1_main.rb"
      mrb_float _t52 = (((mrb_float)(((mrb_int)(get_midi_cc_value(((uint8_t)(71LL))))))) * ((1.0 / 127.0)));
      sp_Filter_set_resonance((sp_Filter *)lv_filter, _t52);
#line 45 "spms_1_main.rb"
      mrb_float _t54 = (((mrb_float)(((mrb_int)(get_midi_cc_value(((uint8_t)(24LL))))))) * ((1.0 / 127.0)));
      sp_Filter_set_modulation_amount((sp_Filter *)lv_filter, _t54);
#line 46 "spms_1_main.rb"
      mrb_float _t56 = (((mrb_float)(((mrb_int)(get_midi_cc_value(((uint8_t)(73LL))))))) * ((1.0 / 127.0)));
      sp_EnvGen_set_attack((sp_EnvGen *)lv_env_gen, _t56);
#line 47 "spms_1_main.rb"
      mrb_float _t58 = (((mrb_float)(((mrb_int)(get_midi_cc_value(((uint8_t)(75LL))))))) * ((1.0 / 127.0)));
      sp_EnvGen_set_decay((sp_EnvGen *)lv_env_gen, _t58);
#line 48 "spms_1_main.rb"
      mrb_float _t60 = ((((mrb_float)((((sp_int_add(((mrb_int)(get_midi_cc_value(((uint8_t)(30LL))))), 1LL)) >> 1LL))))) * ((1.0 / 64.0)));
      sp_EnvGen_set_sustain((sp_EnvGen *)lv_env_gen, _t60);
#line 50 "spms_1_main.rb"
      for (mrb_int _t62 = 0; _t62 < cst_BUFFER_WORDS; _t62++) {
        lv_i__bp1642 = _t62;
        lv_env_gen_output = sp_float_nil();
        lv_oscillator_output = sp_float_nil();
        lv_filter_output = sp_float_nil();
        lv_amp_output = sp_float_nil();
#line 51 "spms_1_main.rb"
        mrb_float _t63 = lv_gate;
        lv_env_gen_output = sp_EnvGen_process((sp_EnvGen *)lv_env_gen, _t63);
#line 52 "spms_1_main.rb"
        mrb_float _t64 = lv_pitch;
        lv_oscillator_output = sp_Oscillator_process((sp_Oscillator *)lv_oscillator, _t64);
#line 53 "spms_1_main.rb"
        mrb_float _t65 = lv_oscillator_output;
        mrb_float _t66 = lv_env_gen_output;
        lv_filter_output = sp_Filter_process((sp_Filter *)lv_filter, _t65, _t66);
#line 54 "spms_1_main.rb"
        mrb_float _t67 = lv_filter_output;
        mrb_float _t68 = lv_env_gen_output;
        lv_amp_output = sp_Amp_process((sp_Amp *)lv_amp, _t67, _t68);
#line 56 "spms_1_main.rb"
        sp_FloatArray_set(lv_audio_buffer, lv_i__bp1642, lv_amp_output);
      }
#line 59 "spms_1_main.rb"
      (debug_measure_end(), (mrb_int)0);
#line 61 "spms_1_main.rb"
      for (mrb_int _t70 = 0; _t70 < cst_BUFFER_WORDS; _t70++) {
        lv_i__bp1679 = _t70;
#line 62 "spms_1_main.rb"
        (audio_out_write(((float)(sp_FloatArray_get(lv_audio_buffer, lv_i__bp1679))), ((float)(sp_FloatArray_get(lv_audio_buffer, lv_i__bp1679)))), (mrb_int)0);
      }
    }
    sp_exc_top--;
  }
  else {
    sp_exc_top--;
    sp_gc_nroots = _gcb44;
    if (sp_unwind_kind != SP_UNWIND_NONE) sp_unwind_resume();
    if (!sp_exc_cls_matches((const char *)sp_last_exc_cls, "StopIteration")) sp_raise_cls(sp_exc_cls[sp_exc_top], sp_exc_msg[sp_exc_top]);
  }
  return 0;
}
